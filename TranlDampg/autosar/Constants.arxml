AUTOSAR XML (schema 314)
package /Constant
  10 x constant specification:
    D_FALSE_CNT_LGC
      value:
        boolean literal D_FALSE_CNT_LGC: type=Boolean, value=false
    D_LOASTATEINIT_CNT_ENUM
      value:
        integer literal D_LOASTATEINIT_CNT_ENUM: type=LOA_State_enum, value=0
    D_MTRTRQCMDHILMT_MTRNM_F32
      value:
        real literal D_MTRTRQCMDHILMT_MTRNM_F32: type=Float, value=8.8
    D_MTRTRQCMDLOLMT_MTRNM_F32
      value:
        real literal D_MTRTRQCMDLOLMT_MTRNM_F32: type=Float, value=-8.8
    D_ONE_CNT_S8
      value:
        integer literal D_ONE_CNT_S8: type=SInt8, value=1
    D_ONE_CNT_U8
      value:
        integer literal D_ONE_CNT_U8: type=UInt8, value=1
    D_ONE_ULS_F32
      value:
        real literal D_ONE_ULS_F32: type=Float, value=1
    D_TRUE_CNT_LGC
      value:
        boolean literal D_TRUE_CNT_LGC: type=Boolean, value=true
    D_ZERO_CNT_S8
      value:
        integer literal D_ZERO_CNT_S8: type=SInt8, value=0
    D_ZERO_ULS_F32
      value:
        real literal D_ZERO_ULS_F32: type=Float, value=0
