AUTOSAR XML (schema 3.1.0)
package /TMS570PSFC66
  bsw implementation Fee_Implementation: code-generator=cMICROSAR, programming-language=C, sw-major-version=2, sw-minor-version=6, sw-patch-version=0, vendor-id=44, ar-major-version=1, ar-minor-version=2, ar-patch-version=2
  ecu parameter definition AUTOSARParameterDefinition: module=Fee
  module definition Fee [0..1]: refined-module-def=Fee, variants pre-compile  # Flash EEPROM Emulation Configuration
    container FeePublishedInformation  # Fee container. It contains additional published information.
      integer FeeBlockOverhead: 24..24, set at pre-compile, origin=AUTOSAR_ECUC V2.0.2, default-value=24  # Block overhead in bytes
      float FeeMaximumBlockingTime: 600.0..600.0, set at pre-compile, origin=AUTOSAR_ECUC V2.0.2, default-value=600.0  # Maximum Blocking Time in uS
      integer FeePageOverhead: 0..0, set at pre-compile, origin=AUTOSAR_ECUC V2.0.2, default-value=0  # Page overhead in bytes - for our methods, there is none.
      integer FeeVirtualSectorOverhead: 16..16, set at pre-compile, origin=TEXAS_INSTRUMENTS_ECUC V2.0.2, default-value=16  # Virtual Sector overhead in bytes.
      function name FeeCancelApi: set at pre-compile, origin=Vector Informatik, default-value=Fee_Cancel  # Determines the API service name of the Fee which is used to cancel a current job.
      function name FeeEraseImmediateBlockApi: set at pre-compile, origin=Vector Informatik, default-value=Fee_EraseImmediateBlock  # Determines the API service name of the Fee which is used to erase a block on the Flash which is configured to hold high priority data.
      function name FeeGetJobResultApi: set at pre-compile, origin=Vector Informatik, default-value=Fee_GetJobResult  # Determines the API service name of the Fee which is used to get the result of the last requested job.
      function name FeeGetStatusApi: set at pre-compile, origin=Vector Informatik, default-value=Fee_GetStatus  # Determines the API service name of the Fee which is used to get the current status of the Fee.
      function name FeeInvalidateBlockApi: set at pre-compile, origin=Vector Informatik, default-value=Fee_InvalidateBlock  # Determines the API service name of the Fee which is used to invalidate a block on the Flash.
      function name FeeReadApi: set at pre-compile, origin=Vector Informatik, default-value=Fee_Read  # Determines the API service name of the Fee which is used to read data from the Flash.
      function name FeeSetModeApi: set at pre-compile, origin=Vector Informatik, default-value=Fee_SetMode  # Determines the API service name of the Fee which is used to set the mode of the Fls driver.
      function name FeeWriteApi: set at pre-compile, origin=Vector Informatik, default-value=Fee_Write  # Determines the API service name of the Fee which is used to write data to the Flash.
      string FeeIncludeFile: set at pre-compile, origin=Vector Informatik, default-value=Fee.h  # Determines the include file of the Fee which declares the API service names.
    container FeeGeneral  # FeeGeneral Configuration configuration. It contains general device options.
      boolean FeeDevErrorDetect: set at pre-compile, origin=AUTOSAR_ECUC V2.0.2, default-value=false  # Indicates if Development Error Detection is enabled.
      integer FeeDeviceIndex: 0..0, set at pre-compile, origin=TEXAS_INSTRUMENTS_ECUC V2.0.2, default-value=0  # Instance ID of this module. Should always be 0.
      function name FeeNvmJobEndNotification: set at pre-compile, origin=AUTOSAR_ECUC V2.0.2, default-value=NvM_JobEndNotification  # Job End callback function.
      function name FeeNvmJobErrorNotification: set at pre-compile, origin=AUTOSAR_ECUC V2.0.2, default-value=NvM_JobErrorNotification  # Job Error callback function.
      boolean FeePollingMode: set at pre-compile, origin=AUTOSAR_ECUC V2.0.2, default-value=true  # Indicates if polling mode is enabled.
      boolean FeeVersionInfoApi: set at pre-compile, origin=AUTOSAR_ECUC V2.0.2, default-value=true  # Indicates if the user can use the function Fee_GetVersionInfo().
      boolean FeeEnableErrorCorrection: set at pre-compile, origin=TEXAS_INSTRUMENTS_ECUC V2.0.2, default-value=false  # Enable error correction.
      integer FeeVirtualPageSize: 8..8, set at pre-compile, origin=AUTOSAR_ECUC V2.0.2, default-value=8  # Defines the virtual page size. Our implementation is currently a static 8 byte Page Size.
      float FeeFrequency: 10.0..180.0, set at pre-compile, origin=TEXAS_INSTRUMENTS_ECUC V2.0.2, default-value=160.0  # Input Frequency in MHz
      boolean FeeCRCEnable: set at pre-compile, origin=Texas Instruments, default-value=false  # CRC Enable | Pre-processor switch to enable the CRC blocks. STD_ON: CRC for blocks is enabled STD_OFF: CRC disabled
      boolean FeeWriteCounterSave: set at pre-compile, origin=Texas Instruments, default-value=false  # Write Counter Save | FEE_FALSH_WRITE_COUNTER_SAVE is set to STD_ON if block wirte counter save is enabled else it is set to STD_OFF
      integer FeeNumberOfVirtualSectors: 0..16, set at pre-compile, origin=Texas Instruments, default-value=0  # Number Of Virtual Sectors | Defines the number of Virtual Sectors used for FEE when FEE_GENERATE_DEVICEANDVIRTUALSECTORSTRUC = STD_ON.
      integer FeeNumberOfVirtualSectorsEEP1: 0..14, set at pre-compile, origin=Texas Instruments, default-value=0  # Number Of Virtual Sectors EEP1 | Defines the number of Virtual Sectors used for EEP1.
      integer FeeNumberOfUnconfiguredBlocksToCopy: 0..65534, set at pre-compile, origin=Texas Instruments, default-value=0  # Number Of Unconfigured Blocks To Copy | Indicates the number of valid blocks which are not configured but need to be copied during Virtual Sector swap.
      integer FeeNumberOfEightByteWrites: 1..255, set at pre-compile, origin=Texas Instruments, default-value=1  # Number of Eight Byte Writes | Indicates the number of 8 byte writes to perform in a main function..
      boolean FeeCheckBank7Access: set at pre-compile, origin=Texas Instruments, default-value=false  # Check Bank7 Access | Pre processor switch to enable EEPROM address range check during read/write.
      boolean FeeGenerateDeviceandvirtualsectorstruc: set at pre-compile, origin=Texas Instruments, default-value=false  # Generate Device And Virtual Sector Struc | Pre processor switch to enable/disable generation of Device and Virtual sector structures.
      enumeration FeeVirtualsectorSize: {VS_4, VS_8, VS_12, VS_16, VS_32}, set at pre-compile, origin=Texas Instruments, default-value=VS_4  # Virtual Sector Size | Macro to indicate the required virtual sector size in kilo bytes. This macro is only used when FEE_GENERATE_DEVICEANDVIRTUALSECTORSTRUC is STD_ON. Based on FEE_VIRTUALSECTOR_SIZE and FEE_NUMBER_OF_VIRTUAL_SECTORS, elements of the structure Fee_VirtualSectorConfiguration will be populated during runtime.
      enumeration FeePhysicalsectorSize: {PS_4, PS_16}, set at pre-compile, origin=Texas Instruments, default-value=PS_4  # Physical Sector Size | Macro to indicate the physical sector size on the device. This macro is only used when FEE_GENERATE_DEVICEANDVIRTUALSECTORSTRUC is STD_OFF. This parameter is used to select device specific files.
    container FeeSectorConfiguration [0..16]  # Fee Virtual Sector Configuration container.
      integer FeeSectorNumber: 1..16, set at pre-compile, origin=AUTOSAR_ECUC V2.0.2, default-value=1  # Used to assign a number to the Virtual Sector.
      integer FeeSectorBank: 7..7, set at pre-compile, origin=AUTOSAR_ECUC V2.0.2, default-value=7  # Sector's Bank - Bank used for the virtual sector. Sector Bank 0 is not allowed!
      integer FeeSectorStart: 0.., set at pre-compile, origin=AUTOSAR_ECUC V2.0.2, default-value=0  # Virtual Sectors start sector. End Sector must be greater or at least equal to start sector!
      integer FeeSectorEnd: 0.., set at pre-compile, origin=AUTOSAR_ECUC V2.0.2, default-value=0  # Virtual Sectors end sector. End Sector must be greater or at least equal to start sector!
      string FeeSectorName: set at pre-compile, origin=TEXAS_INSTRUMENTS_ECUC V2.0.2, symbolic-name-value=true, default-value=FeeSectorConfiguration_0  # The user-defined name is assigned to a number starting from 0x1. FeeVirtualSectorNumber is set to the number assigned to the Virtual Sector name.
    container FeeBlockConfiguration [1..*]  # FeeBlock Configuration container. It contains Flash EEPROM Emulation block information.
      integer FeeBlockNumber: 1..65534, set at pre-compile, origin=AUTOSAR_ECUC V2.0.2, default-value=1  # Datasetselctionbits are encrypted in this ID.
      integer FeeBlockSize: 1..65534, set at pre-compile, origin=AUTOSAR_ECUC V2.0.2, default-value=8  # Block's Size - Actual number of bits used is reduced by number of bits used for dataset.
      boolean FeeImmediateData: set at pre-compile, origin=AUTOSAR_ECUC V2.0.2, default-value=false  # Indicates if the block is used for immediate data.
      integer FeeNumberOfWriteCycles: 1..4294967295, set at pre-compile, origin=AUTOSAR_ECUC V2.0.2, default-value=1  # Number of write cycles this block requires.
      string FeeBlockName: set at pre-compile, origin=TEXAS_INSTRUMENTS_ECUC V2.0.2, symbolic-name-value=true, default-value=Fee_BlockConfiguration_1  # The user-defined name is assigned a number starting from 0x1. FeeBlockNumber is set to the number assigned to the Block name.
      integer FeeDeviceIndex: 0..0, set at pre-compile, origin=TEXAS_INSTRUMENTS_ECUC V2.0.2, default-value=0  # Indicates the device index. This will always be 0.
      integer FeeBlockConfiguration: 1..65534, set at pre-compile, origin=TEXAS_INSTRUMENTS_ECUC V2.0.2, default-value=1  # Block Number | FEE Block Number - 0 and 0xFFFE values are not allowed
      integer FeeDataset: 1..255, set at pre-compile, origin=AUTOSAR_ECUC V2.0.2, default-value=1  # Number of DataSets for this Block.
      integer FeeEEPNumber: 0..1, set at pre-compile, origin=Texas Instruments, default-value=0  # Number indicating into which EEP does the block go. 0: Block will be configured on EEP1 1: Block will be configured on EEP2
    container FeeTypes  # FeeTypes Configuration container. It contains TI Fee/Flash specific information.
      enumeration FeeFlashErrCorrHandlingType: {Fee_None, Fee_Fix}, set at pre-compile, origin=TEXAS_INSTRUMENTS_ECUC V2.0.2, default-value=Fee_None  # indicates desired action to bit errors.
    container FeeFlashConfiguration: multiple-configuration-container=true  # This Container is the base of multiple configuration sets. It defines the Flash structure of the device.
      enumeration FeeDeviceName: {TMS570LS05xx, TMS570LS07xx, TMS570LS09xx, TMS570LS11xx, TMS570LS12xx}, set at pre-compile, origin=TEXAS_INSTRUMENTS_ECUC V2.0.2, default-value=TMS570LS05xx  # Device name.
