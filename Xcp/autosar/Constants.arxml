AUTOSAR XML (schema 314)
package /Constant
  constant specification C_INIT_TUNINGSESSIONADDRPTRENUM
    value:
      integer literal C_INIT_TUNINGSESSIONADDRPTRENUM: type=TuningSessionAddrPtrEnum, value=255
  constant specification D_ZERO_CNT_U16
    value:
      integer literal D_ZERO_CNT_U16: type=UInt16, value=0
  constant specification D_ZERO_CNT_U32
    value:
      integer literal D_ZERO_CNT_U32: type=UInt32, value=0
