AUTOSAR XML (schema 314)
package /PortInterface
  sender receiver interface Count_Cnt_u16
    data Cnt_u16: sw-calibration-access=READ-ONLY, type=UInt16
  sender receiver interface Count_Cnt_u32
    data Cnt_u32: sw-calibration-access=READ-ONLY, type=UInt32
  sender receiver interface TuningSessionActPtr
    data Cnt_u8: sw-calibration-access=READ-ONLY, type=TuningSessionAddrPtrEnum
