AUTOSAR XML (schema 314)
standard types defined: UInt16, UInt32, Float
