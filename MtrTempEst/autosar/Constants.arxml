AUTOSAR XML (schema 314)
package /Constant
  constant specification D_100MS_SEC_F32
    value:
      real literal D_100MS_SEC_F32: type=Float, value=0.1
  constant specification D_FALSE_CNT_LGC
    value:
      boolean literal D_FALSE_CNT_LGC: type=Boolean, value=false
  constant specification D_ZERO_ULS_F32
    value:
      real literal D_ZERO_ULS_F32: type=Float, value=0
