AUTOSAR XML (schema 314)
standard types defined: Boolean, Float
