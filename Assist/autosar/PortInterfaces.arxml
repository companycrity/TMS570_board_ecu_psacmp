AUTOSAR XML (schema 314)
package /PortInterface
  client server interface FltInjection_SCom
    operation FltInjection
      arg SignalPath_Uls_f32: type=Float, direction=INOUT
      arg LocationKey_Cnt_enum: type=FltInjectionLocType, direction=IN
  6 x sender receiver interface:
    Enable_Cnt_lgc
      data Cnt_lgc: sw-calibration-access=READ-ONLY, type=Boolean
    HwTrq_HwNm_f32
      data HwNm_f32: sw-calibration-access=READ-ONLY, type=Float
    MtrTrq_MtrNm_f32
      data MtrNm_f32: sw-calibration-access=READ-ONLY, type=Float
    ScaleFactor_Uls_f32
      data Uls_f32: sw-calibration-access=READ-ONLY, type=Float
    UnityScalar_Uls_f32
      data Uls_f32: sw-calibration-access=READ-ONLY, type=Float
    VehSpd_Kph_f32
      data Kph_f32: sw-calibration-access=READ-ONLY, type=Float
