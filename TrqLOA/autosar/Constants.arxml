AUTOSAR XML (schema 314)
package /Constant
  6 x constant specification:
    D_2MS_SEC_F32
      value:
        real literal D_2MS_SEC_F32: type=Float, value=0.002
    D_FALSE_CNT_LGC
      value:
        boolean literal D_FALSE_CNT_LGC: type=Boolean, value=false
    D_ONE_ULS_F32
      value:
        real literal D_ONE_ULS_F32: type=Float, value=1
    D_PIOVR180_ULS_F32
      value:
        real literal D_PIOVR180_ULS_F32: type=Float, value=0.0174532925199
    D_VEHWHLBASEINIT_MM_F32
      value:
        real literal D_VEHWHLBASEINIT_MM_F32: type=Float, value=3000
    D_ZERO_ULS_F32
      value:
        real literal D_ZERO_ULS_F32: type=Float, value=0
