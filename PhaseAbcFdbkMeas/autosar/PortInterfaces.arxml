AUTOSAR XML (schema 314)
package /PortInterface
  client server interface Get_PhaseFdbk
    operation PhaseFdbk
  sender receiver interface Count_Cnt_u32
    data Cnt_u32: sw-calibration-access=READ-ONLY, type=UInt32
