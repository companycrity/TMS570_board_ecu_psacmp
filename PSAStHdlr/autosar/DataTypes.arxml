AUTOSAR XML (schema 314)
standard types defined: Boolean, SInt16, SInt32, SInt8, UInt16, UInt32, UInt8, Double, Float
package /DataType
  9 x integer type:
    NTCNumber:
      compu {1=NTC_Num_FlashWrapperLgcFlt, 2=NTC_Num_FlashECCCorr, 3=NTC_Num_FlashECCMemFlt, 4=NTC_Num_FlashCRCMemFault, 6=NTC_Num_NvMBlkDftActA, 7=NTC_Num_NvMBlkDftActB, 8=NTC_Num_NvMBlkDftActC, 9=NTC_Num_CurrentSensorCalOutOfRange, 10=NTC_Num_EEPROMDiag, 11=NTC_Num_EEPROMDiagMtrStr, 12=NTC_Num_PriSnsrTrqStorFlt, 13=NTC_Num_EEPROMDiagPosTrimStr, 14=NTC_Num_SecSnsrTrqStorFlt, 15=NTC_Num_EEPROMDiagPolarityStr, 16=NTC_Num_RAMDiag_GeneralFlt, 17=NTC_Num_RAMDiag_WrprLgcFlt, 18=NTC_Num_RAMDiag_ECCCorrIndFlt, 19=NTC_Num_RAMDiag_ECCMemFlt, 20=NTC_Num_RAMDiag_CRCMemFlt, 23=NTC_Num_RAMDiag_VIMRamFlt, 24=NTC_Num_RAMDiag_NHET1RamFlt, 25=NTC_Num_RAMDiag_NHET2RamFlt, 26=NTC_Num_RAMDiag_ADC1RamFlt, 27=NTC_Num_RAMDiag_DCANRamFault, 28=NTC_Num_RAMDiag_ADC2RamFlt, 29=NTC_Num_RAMDiag_HETTU1RamFlt, 30=NTC_Num_RAMDiag_HETTU2RamFlt, 32=NTC_Num_CPU_RegVer, 33=NTC_Num_CPU_CoreInitFlt, 34=NTC_Num_CPU_CoreRunTimeFlt, 35=NTC_Num_CPU_ClockMon, 36=NTC_Num_CPU_eFuseFlt, 37=NTC_Num_CPU_MPUViolation, 40=NTC_Num_CPU_FactPrcsErr, 41=NTC_Num_PropExeDiag_InitDiag, 42=NTC_Num_PrgFlwDeadlnFlt, 43=NTC_Num_PropExeDiag_RunTimeDiag, 44=NTC_Num_PropExeDiag_COPTimeout, 48=NTC_Num_PropExeDiag_PrefetchAbort, 49=NTC_Num_PropExeDiag_DataAbort, 50=NTC_Num_PerDiag_ADC1Flt, 51=NTC_Num_PerDiag_ADC2Flt, 52=NTC_Num_PerDiag_ADCCrossChkFlt, 53=NTC_Num_PerDiag_IllegalAccess, 54=NTC_Num_PerDiag_DMAFlt, 55=NTC_Num_PeripheralStartupFlt, 63=NTC_Num_PerDiag_CPUWarning, 64=NTC_Num_TmpMonFunc, 65=NTC_Num_TmpMonRunTimeFlt, 66=NTC_Num_PowerRelayInitFlt, 67=NTC_Num_PrechargeFailure, 68=NTC_Num_PowerRelayRunFlt, 69=NTC_Num_Thermistor, 70=NTC_Num_RefSupplyVltg, 71=NTC_Num_TrcvrInterfaceFlt, 72=NTC_Num_CPUSupplyOvervoltage, 76=NTC_Num_GateDrvFltInProcess, 77=NTC_Num_GateDrvFlt, 78=NTC_Num_OnStateSingleFET, 79=NTC_Num_OnStateMultiFET, 80=NTC_Num_PhaseVoltageVerf, 81=NTC_Num_PhaseDscnt, 82=NTC_Num_DigPhaseVoltageVerf, 83=NTC_Num_PhaseDscntFailedDisable, 84=NTC_Num_CurrentMeas1, 85=NTC_Num_CurrentMeas2, 86=NTC_Num_CurrentMeasCrossChk, 87=NTC_Num_PDSupplyOverVoltage, 88=NTC_Num_ChargePumpUnderVoltage, 96=NTC_Num_HwTrqSensor, 97=NTC_Num_AnaVsDigHwTrq, 98=NTC_Num_TrqSensorRecoveryFlt, 100=NTC_Num_TrqSensorScaleInvalid, 101=NTC_Num_T1vsT2, 102=NTC_Num_T1OutofRange, 103=NTC_Num_T2OutofRange, 104=NTC_Num_DigT1vsT2, 105=NTC_Num_DigT1OutofRange, 106=NTC_Num_DigT2OutofRange, 107=NTC_Num_RedT1vsT2, 108=NTC_Num_HWACrossChecks, 109=NTC_Num_HWASnsrCommFault, 110=NTC_Num_HWASensorRel, 111=NTC_Num_HWASensorAbs, 112=NTC_Num_PriMSB_SinCosCorr, 113=NTC_Num_SecMSB_SinCosCorr, 114=NTC_Num_PriVsSec_SinCosCorr, 115=NTC_Num_DigMSBFlt, 116=NTC_Num_MtrVelFlt, 117=NTC_Num_HWAtoMtrAngleCorr, 118=NTC_Num_RedPriVsSec_SinCosCorr, 128=NTC_Num_TurnCntr_PosLoss, 129=NTC_Num_TurnCntr_MicroProcFlt, 130=NTC_Num_TurnCntr_SensorPosFlt, 131=NTC_Num_TurnCntr_SpiComFlt, 132=NTC_Num_TurnCntr_HighQuiescCur, 133=NTC_Num_TurnCntr_MainResets, 134=NTC_Num_TurnCntr_PosLossNotSpdDep, 144=NTC_Num_KinematicIntDiag, 145=NTC_Num_HighFriction, 148=NTC_Num_DutyCycleExceeded, 149=NTC_Num_AbsTempThermLimit, 160=NTC_Num_LatchActive, 168=NTC_Num_OpTrqVsHwTrq, 169=NTC_Num_CurrentReas, 170=NTC_Num_LoaRpdShutdn, 176=NTC_Num_OpVoltage, 177=NTC_Num_ExVoltageLow, 178=NTC_Num_ReducedAsstLowVoltage, 180=NTC_Num_ExVoltageHigh, 181=NTC_Num_OpVoltageOvrMax, 182=NTC_Num_BattTransOverVolt, 184=NTC_Num_IgnConfDiag, 185=NTC_Num_TurnCntr_LowBattery, 191=NTC_Num_EEPROMCloseFailed, 192=NTC_Num_SigPath1CrossChk, 193=NTC_Num_SigPath2CrossChk, 194=NTC_Num_SigPath3CrossChk, 195=NTC_Num_SigPath4CrossChk, 196=NTC_Num_SigPath5CrossChk, 197=NTC_Num_DampingFWReached, 198=NTC_Num_AssistFWReached, 199=NTC_Num_ReturnFWReached, 200=NTC_Num_DampingFWFltMode, 201=NTC_Num_AssistFWFltMode, 202=NTC_Num_VBICFltMode, 203=NTC_Num_StaMdsSysC, 204=NTC_NUM_SysFailureForRotVel, 205=NTC_NUM_SysFailForRedntRotVel, 206=NTC_Num_SysFailureForTrqSnsr, 207=NTC_Num_SysFailureForRedTrqSnsr, 209=NTC_NUM_SysFailureForCtrlVolt, 223=NTC_Num_GlblSgnlOvrwrtDet, 224..255=NTC_Num_VLF_00..NTC_Num_VLF_31, 256=NTC_Num_BusOffCh1, 257=NTC_Num_BusOffCh1NodeMute, 258=NTC_Num_Node1AAbsent, 259=NTC_Num_Node1AFaulty, 260=NTC_Num_Node1BAbsent, 261=NTC_Num_Node1BFaulty, 262=NTC_Num_Node1CAbsent, 263=NTC_Num_Node1CFaulty, 264=NTC_Num_Node1DAbsent, 265=NTC_Num_Node1DFaulty, 266=NTC_Num_Node1EAbsent, 267=NTC_Num_Node1EFaulty, 268=NTC_Num_Node1FAbsent, 269=NTC_Num_Node1FFaulty, 270=NTC_Num_Node1GAbsent, 271=NTC_Num_Node1GFaulty, 272=NTC_Num_BusOffCh2, 273=NTC_Num_Node2AAbsent, 274=NTC_Num_Node2AFaulty, 275=NTC_Num_Node2BAbsent, 276=NTC_Num_Node2BFaulty, 277=NTC_Num_Node2CAbsent, 278=NTC_Num_Node2CFaulty, 279=NTC_Num_Node2DAbsent, 280=NTC_Num_Node2DFaulty, 281=NTC_Num_Node2EAbsent, 282=NTC_Num_Node2EFaulty, 283=NTC_Num_Node2FAbsent, 284=NTC_Num_Node2FFaulty, 285=NTC_Num_Node2GAbsent, 286=NTC_Num_Node2GFaulty, 288=NTC_Num_InvalidMsg_M, 289=NTC_Num_MissingMsg_M, 290=NTC_Num_CRCFltMsg_M, 291=NTC_Num_PgrsCntFltMsg_M, 292=NTC_Num_DataRngFltMsg_M, 293=NTC_Num_DataRateFltMsg_M, 294=NTC_Num_DataOtherFltMsg_M, 295=NTC_Num_DataOther2FltMsg_M, 296=NTC_Num_InvalidMsg_N, 297=NTC_Num_MissingMsg_N, 298=NTC_Num_CRCFltMsg_N, 299=NTC_Num_PgrsCntFltMsg_N, 300=NTC_Num_DataRngFltMsg_N, 301=NTC_Num_DataRateFltMsg_N, 302=NTC_Num_DataOtherFltMsg_N, 303=NTC_Num_DataOtherFlt2Msg_N, 304=NTC_Num_InvalidMsg_O, 305=NTC_Num_MissingMsg_O, 306=NTC_Num_CRCFltMsg_O, 307=NTC_Num_PgrsCntFltMsg_O, 308=NTC_Num_DataRngFltMsg_O, 309=NTC_Num_DataRateFltMsg_O, 310=NTC_Num_DataOtherFltMsg_O, 312=NTC_Num_InvalidMsg_P, 313=NTC_Num_MissingMsg_P, 314=NTC_Num_CRCFltMsg_P, 315=NTC_Num_PgrsCntFltMsg_P, 316=NTC_Num_DataRngFltMsg_P, 317=NTC_Num_DataRateFltMsg_P, 318=NTC_Num_DataOtherFltMsg_P, 320=NTC_Num_InvalidMsg_Q, 321=NTC_Num_MissingMsg_Q, 322=NTC_Num_CRCFltMsg_Q, 323=NTC_Num_PgrsCntFltMsg_Q, 324=NTC_Num_DataRngFltMsg_Q, 325=NTC_Num_DataRateFltMsg_Q, 326=NTC_Num_DataOtherFltMsg_Q, 328=NTC_Num_InvalidMsg_R, 329=NTC_Num_MissingMsg_R, 330=NTC_Num_CRCFltMsg_R, 331=NTC_Num_PgrsCntFltMsg_R, 332=NTC_Num_DataRngFltMsg_R, 333=NTC_Num_DataRateFltMsg_R, 334=NTC_Num_DataOtherFltMsg_R, 335=NTC_Num_DataOtherFlt2Msg_R, 336=NTC_Num_InvalidMsg_S, 337=NTC_Num_MissingMsg_S, 338=NTC_Num_CRCFltMsg_S, 339=NTC_Num_PgrsCntFltMsg_S, 340=NTC_Num_DataRngFltMsg_S, 341=NTC_Num_DataRateFltMsg_S, 342=NTC_Num_DataOtherFltMsg_S, 344=NTC_Num_InvalidMsg_T, 345=NTC_Num_MissingMsg_T, 346=NTC_Num_CRCFltMsg_T, 347=NTC_Num_PgrsCntFltMsg_T, 348=NTC_Num_DataRngFltMsg_T, 349=NTC_Num_DataRateFltMsg_T, 350=NTC_Num_DataOtherFltMsg_T, 352=NTC_Num_InvalidMsg_U, 353=NTC_Num_MissingMsg_U, 354=NTC_Num_CRCFltMsg_U, 355=NTC_Num_PgrsCntFltMsg_U, 356=NTC_Num_DataRngFltMsg_U, 357=NTC_Num_DataRateFltMsg_U, 358=NTC_Num_DataOtherFltMsg_U, 360=NTC_Num_InvalidMsg_V, 361=NTC_Num_MissingMsg_V, 362=NTC_Num_CRCFltMsg_V, 363=NTC_Num_PgrsCntFltMsg_V, 364=NTC_Num_DataRngFltMsg_V, 365=NTC_Num_DataRateFltMsg_V, 366=NTC_Num_DataOtherFltMsg_V, 368=NTC_Num_InvalidMsg_W, 369=NTC_Num_MissingMsg_W, 370=NTC_Num_CRCFltMsg_W, 371=NTC_Num_PgrsCntFltMsg_W, 372=NTC_Num_DataRngFltMsg_W, 373=NTC_Num_DataRateFltMsg_W, 374=NTC_Num_DataOtherFltMsg_W, 376=NTC_Num_InvalidMsg_X, 377=NTC_Num_MissingMsg_X, 378=NTC_Num_CRCFltMsg_X, 379=NTC_Num_PgrsCntFltMsg_X, 380=NTC_Num_DataRngFltMsg_X, 381=NTC_Num_DataRateFltMsg_X, 382=NTC_Num_DataOtherFltMsg_X, 384=NTC_Num_InvalidMsg_Y, 385=NTC_Num_MissingMsg_Y, 386=NTC_Num_CRCFltMsg_Y, 387=NTC_Num_PgrsCntFltMsg_Y, 388=NTC_Num_DataRngFltMsg_Y, 389=NTC_Num_DataRateFltMsg_Y, 390=NTC_Num_DataOtherFltMsg_Y, 392=NTC_Num_InvalidMsg_Z, 393=NTC_Num_MissingMsg_Z, 394=NTC_Num_CRCFltMsg_Z, 395=NTC_Num_PgrsCntFltMsg_Z, 396=NTC_Num_DataRngFltMsg_Z, 397=NTC_Num_DataRateFltMsg_Z, 398=NTC_Num_DataOtherFltMsg_Z, 399=NTC_Num_DSTXORActive, 400=NTC_Num_InvalidMsg_AA, 401=NTC_Num_MissingMsg_AA, 402=NTC_Num_CRCFltMsg_AA, 403=NTC_Num_PgrsCntFltMsg_AA, 404=NTC_Num_DataRngFltMsg_AA, 405=NTC_Num_DataRateFltMsg_AA, 406=NTC_Num_DataOtherFltMsg_AA, 408=NTC_Num_InvalidMsg_AB, 409=NTC_Num_MissingMsg_AB, 410=NTC_Num_CRCFltMsg_AB, 411=NTC_Num_PgrsCntFltMsg_AB, 412=NTC_Num_DataRngFltMsg_AB, 413=NTC_Num_DataRateFltMsg_AB, 414=NTC_Num_DataOtherFltMsg_AB, 416=NTC_Num_InvalidMsg_AC, 417=NTC_Num_MissingMsg_AC, 418=NTC_Num_CRCFltMsg_AC, 419=NTC_Num_PgrsCntFltMsg_AC, 420=NTC_Num_DataRngFltMsg_AC, 421=NTC_Num_DataRateFltMsg_AC, 422=NTC_Num_DataOtherFltMsg_AC, 424=NTC_Num_InvalidMsg_AD, 425=NTC_Num_MissingMsg_AD, 426=NTC_Num_CRCFltMsg_AD, 427=NTC_Num_PgrsCntFltMsg_AD, 428=NTC_Num_DataRngFltMsg_AD, 429=NTC_Num_DataRateFltMsg_AD, 430=NTC_Num_DataOtherFltMsg_AD, 432=NTC_Num_InvalidMsg_AE, 433=NTC_Num_MissingMsg_AE, 434=NTC_Num_CRCFltMsg_AE, 435=NTC_Num_PgrsCntFltMsg_AE, 436=NTC_Num_DataRngFltMsg_AE, 437=NTC_Num_DataRateFltMsg_AE, 438=NTC_Num_DataOtherFltMsg_AE, 440=NTC_Num_InvalidMsg_AF, 441=NTC_Num_MissingMsg_AF, 442=NTC_Num_CRCFltMsg_AF, 443=NTC_Num_PgrsCntFltMsg_AF, 444=NTC_Num_DataRngFltMsg_AF, 445=NTC_Num_DataRateFltMsg_AF, 446=NTC_Num_DataOtherFltMsg_AF, 448=NTC_Num_InvalidMsg_AG, 449=NTC_Num_MissingMsg_AG, 450=NTC_Num_CRCFltMsg_AG, 451=NTC_Num_PgrsCntFltMsg_AG, 452=NTC_Num_DataRngFltMsg_AG, 453=NTC_Num_DataRateFltMsg_AG, 454=NTC_Num_DataOtherFltMsg_AG, 456=NTC_Num_InvalidMsg_AH, 457=NTC_Num_MissingMsg_AH, 458=NTC_Num_CRCFltMsg_AH, 459=NTC_Num_PgrsCntFltMsg_AH, 460=NTC_Num_DataRngFltMsg_AH, 461=NTC_Num_DataRateFltMsg_AH, 462=NTC_Num_DataOtherFltMsg_AH, 464=NTC_Num_InvalidMsg_ParkAssistParallel (For C1XX), 465=NTC_Num_FlexrayCommunicationError, 466=NTC_Num_InvalidMsg_AI, 467=NTC_Num_MissingMsg_AI, 472=NTC_Num_InvalidMsg_AJ, 473=NTC_Num_MissingMsg_AJ, 480=NTC_Num_InvalidMsg_AK, 481=NTC_Num_MissingMsg_AK, 489=NTC_Num_MissingMsg_AL, 496=NTC_Num_SysConsistencyVerf, 497=NTC_Num_ConfigMisMatch, 498=NTC_Num_CalNotPrgmd, 499=NTC_Num_TunSetNotPrgmd, 501=NTC_Num_EOLVehTunNtPerf, 502=NTC_Num_MtrSensorNotTrimmed, 504=NTC_Num_HWASensorNotTrimmed, 505=NTC_Num_HWASensorTrimNoAttempt, 506=NTC_Num_TrqSensorScaleNotSet, 507=NTC_Num_TrqSensorNotTrimmed, 509=NTC_Num_DigTrqSensorScaleNotSet, 510=NTC_Num_DigTrqSensorNotTrimmed, 500=NTC_Num_EEPROMtoFeeCpyError, 171=NTC_Num_LoaCtrldShutdn, 172=NTC_Num_LoaMgr_HwTqIdptSigTooLow, 173=NTC_Num_LoaMgr_MotAgIdptSigTooLow, 174=NTC_Num_LoaMgr_MotCurrIdptSigTooLow, 175=NTC_Num_LoaMgr_IvtrIdptSigTooLow, 508=NTC_Num_AnaHWDiffTqOfstNotTrmd, 511=NTC_Num_SENTHWDiffTqOfstNotTrmd, 73=NTC_Num_BattVltgMeasdCorrlnFlt, 74=NTC_Num_IvtrPwrDiscnctFailr, 92=NTC_Num_Inv2GateDrvFltInProcess, 93=NTC_Num_Inv2GateDrvFlt, 94=NTC_Num_Inv2OnStateSingleFET, 75=NTC_Num_PowerRelayInit2Flt, 161=NTC_Num_LimpHomeIgnitionCounter, 90=NTC_Num_Ivtr2PwrDiscnctFailr, 91=NTC_Num_SysVltgCorrlnFlt, 22=NTC_Num_PLLSlipNrcvrl, 327=NTC_Num_DataOtherFlt2Msg_Q, 95=NTC_Num_EcuIdnFlt, 127=NTC_Num_ImcArbrFault, 482=NTC_Num_MissingMsg_AM, 483=NTC_Num_InvalidMsg_AM, 484=NTC_Num_CRCFltMsg_AM, 485=NTC_Num_PgrsCntFltMsg_AM, 486=NTC_Num_DataRngFltMsg_AM, 488=NTC_Num_InvalidMsg_AL, 492=NTC_Num_DataRngFltMsg_AL, 494=NTC_Num_DataOtherFltMsg_AL, 135=NTC_Num_TurnCntr_SpiDataFlt, 150=NTC_Num_EcuCrossChk, 167=NTC_Num_AgCompDiagc, 151=NTC_Num_ImcSigArbHighOffsetCorrection, 152=NTC_Num_EcuConfigMismatch, 500=NTC_Num_PHAPosnSnsrVsPwrpkDataWrong, 503=NTC_Num_PHAScratchPadTrf, 125=NTC_Num_IMCLossOfCom}
      lower-limit=0
      upper-limit=511
    NxtrDiagMgrStatus: compu {0=NTC_STATUS_PASSED, 1=NTC_STATUS_FAILED, 2=NTC_STATUS_PREPASSED, 3=NTC_STATUS_PREFAILED}, lower-limit=0, upper-limit=255
    PsaApaSt_Cnt_enum: compu {0=PSAAPAST_UNAVL, 1=PSAAPAST_AVL, 2=PSAAPAST_CTRLPRGS, 3=PSAAPAST_DFCT}, lower-limit=0, upper-limit=3
    PsaApaTranCause_Cnt_enum: compu {0=PSAAPATRANCAUSE_NOINTRPT, 1=PSAAPATRANCAUSE_DRVRINTV, 2=PSAAPATRANCAUSE_VEHSPDHI, 3=PSAAPATRANCAUSE_AGLERR, 4=PSAAPATRANCAUSE_MTRSTALL, 5=PSAAPATRANCAUSE_UNUSED, 6=PSAAPATRANCAUSE_THERMLIM, 7=PSAAPATRANCAUSE_OTHERERR}, lower-limit=0, upper-limit=7
    PsaEpsSt_Cnt_enum: compu {0=PSAEPSST_UNAVL, 1=PSAEPSST_AVL, 2=PSAEPSST_DFCT}, lower-limit=0, upper-limit=2
    PsaEpsStLxa_Cnt_enum: compu {0=PSAEPSSTLXA_UNAUTHD, 1=PSAEPSSTLXA_AUTHD, 2=PSAEPSSTLXA_AVL, 3=PSAEPSSTLXA_ACTV, 4=PSAEPSSTLXA_DFCT}, lower-limit=0, upper-limit=4
    PsaLxaSt_Cnt_enum: compu {0=PSALXAST_UNAVL, 1=PSALXAST_UNSELD, 2=PSALXAST_SELD, 3=PSALXAST_AUTHD, 4=PSALXAST_ACTV, 5=PSALXAST_DFCT, 6=PSALXAST_COLLRISK}, lower-limit=0, upper-limit=6
    SInt4: lower-limit=-8, upper-limit=7  # SInt4 represents integers with a minimum value of -8 and a maximum value of 7. The order-relation on SInt4 is: x < y if y - x is positive. SInt4 has a lexical representation consisting of an optional sign followed by a finite-length sequence of decimal digits (#x30-#x39). If the sign is omitted, "+" is assumed. For example: -1, 0, 2, +4.
    UInt4: lower-limit=0, upper-limit=15  # UInt4 represents integers with a minimum value of 0 and a maximum value of 15. The order-relation on UInt4 is: x < y if y - x is positive. UInt4 has a lexical representation consisting of a finite-length sequence of decimal digits (#x30-#x39). For example: 1, 0, 12, +10.
  record type DiagSettings_Str
    record element Threshold: type=UInt16
    record element PStep: type=UInt16
    record element NStep: type=UInt16
