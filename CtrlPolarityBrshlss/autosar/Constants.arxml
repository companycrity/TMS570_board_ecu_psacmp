AUTOSAR XML (schema 314)
package /Constant
  constant specification D_NEGONE_CNT_S8
    value:
      integer literal D_NEGONE_CNT_S8: type=SInt8, value=-1
  constant specification D_ONE_CNT_S8
    value:
      integer literal D_ONE_CNT_S8: type=SInt8, value=1
  constant specification D_ZERO_CNT_S8
    value:
      integer literal D_ZERO_CNT_S8: type=SInt8, value=0
