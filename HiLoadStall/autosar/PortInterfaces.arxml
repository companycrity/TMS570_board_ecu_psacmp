AUTOSAR XML (schema 314)
package /PortInterface
  sender receiver interface Enable
    data Cnt_lgc: sw-calibration-access=READ-ONLY, type=Boolean
  sender receiver interface MtrTrq
    data MtrNm_f32: sw-calibration-access=READ-ONLY, type=Float
  sender receiver interface MtrVel
    data MtrRadpS_f32: sw-calibration-access=READ-ONLY, type=Float
