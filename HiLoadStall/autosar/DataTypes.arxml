AUTOSAR XML (schema 314)
standard types defined: Boolean, UInt8, Float
