AUTOSAR XML (schema 314)
standard types defined: Boolean, UInt16, UInt32, Float
