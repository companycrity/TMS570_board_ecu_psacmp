AUTOSAR XML (schema 314)
package /Constant
  5 x constant specification:
    D_FALSE_CNT_LGC
      value:
        boolean literal D_FALSE_CNT_LGC: type=Boolean, value=false
    D_MANUFMODEINIT_CNT_ENUM
      value:
        integer literal D_MANUFMODEINIT_CNT_ENUM: type=ManufModeType, value=0
    D_NEGONE_CNT_S16
      value:
        integer literal D_NEGONE_CNT_S16: type=SInt16, value=-1
    D_ONE_ULS_F32
      value:
        real literal D_ONE_ULS_F32: type=Float, value=1
    D_ZERO_ULS_F32
      value:
        real literal D_ZERO_ULS_F32: type=Float, value=0
