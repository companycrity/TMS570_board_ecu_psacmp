AUTOSAR XML (schema 314)
package /ModeDclrGroup
  mode declaration group StaMd_Mode: initial-mode=WARMINIT  # EPS System State mode declaration
    4 x mode:
      DISABLE
      OFF
      OPERATE
      WARMINIT
package /PortInterface
  client server interface NxtrDiagMgr
    4 x operation, all with possible-error=E_NOT_OK:
      GetNTCActive
        arg NTC_Cnt_T_enum: type=NTCNumber, direction=IN
        arg NTCActive_Ptr_T_lgc: type=Boolean, direction=OUT
      GetNTCFailed
        arg NTC_Cnt_T_enum: type=NTCNumber, direction=IN
        arg NTCFailed_Ptr_T_lgc: type=Boolean, direction=OUT
      GetNTCStatus
        arg NTC_Cnt_T_enum: type=NTCNumber, direction=IN
        arg Status_Ptr_T_u08: type=UInt8, direction=OUT
      SetNTCStatus
        arg NTC_Cnt_T_enum: type=NTCNumber, direction=IN
        arg Param_Cnt_T_u08: type=UInt8, direction=IN
        arg Status_Cnt_T_enum: type=NxtrDiagMgrStatus, direction=IN
    error E_NOT_OK: error-code=1
  10 x sender receiver interface:
    Count_Cnt_u08
      data Cnt_u08: sw-calibration-access=READ-ONLY, type=UInt8
    Current_Amp_f32
      data Amp_f32: sw-calibration-access=READ-ONLY, type=Float
    MtrPos_Rev_f32
      data Rev_f32: sw-calibration-access=READ-ONLY, type=Float
    MtrTrq_MtrNm_f32
      data MtrNm_f32: sw-calibration-access=READ-ONLY, type=Float
    MtrVel_MtrRadpS_f32
      data MtrRadpS_f32: sw-calibration-access=READ-ONLY, type=Float
    MtrVltConstant_VpRadpS_f32
      data VpRadpS_f32: sw-calibration-access=READ-ONLY, type=Float
    Resistance_Ohm_f32
      data Ohm_f32: sw-calibration-access=READ-ONLY, type=Float
    SystemState
      mode declaration group prototype Mode: type=StaMd_Mode
    UnityScalar_Uls_f32
      data Uls_f32: sw-calibration-access=READ-ONLY, type=Float
    Voltage_Volt_f32
      data Volt_f32: sw-calibration-access=READ-ONLY, range raw >0..<31, type=Float  # This signal is intended to communicate any type voltage signal measured by the ecu. This signal has a lower limit of 0 which reequires users of the signal to provide divide by 0 protection if it is used as a denominator in a calculation. See Vecu port prototype if a port with a lower limit is desired.
