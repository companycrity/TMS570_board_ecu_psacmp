AUTOSAR XML (schema 314)
package /Constant
  6 x constant specification:
    D_FALSE_CNT_LGC
      value:
        boolean literal D_FALSE_CNT_LGC: type=Boolean, value=false
    D_ONE_CNT_U32
      value:
        integer literal D_ONE_CNT_U32: type=UInt32, value=1
    D_TRUE_CNT_LGC
      value:
        boolean literal D_TRUE_CNT_LGC: type=Boolean, value=true
    D_ZERO_CNT_U16
      value:
        integer literal D_ZERO_CNT_U16: type=UInt16, value=0
    D_ZERO_CNT_U32
      value:
        integer literal D_ZERO_CNT_U32: type=UInt32, value=0
    D_ZERO_CNT_U8
      value:
        integer literal D_ZERO_CNT_U8: type=UInt8, value=0
