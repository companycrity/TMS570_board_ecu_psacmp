AUTOSAR XML (schema 314)
package /ComponentType
  complex device driver component type Cd_uDiag
    require port NxtrDiagMgr: required-com-specs=[GetNTCActive, GetNTCFailed, GetNTCStatus, SetNTCStatus], required-interface=NxtrDiagMgr
  internal behavior Cd_uDiag_InternalBehavior: component=Cd_uDiag, port-api-option{enable-take-address=false, indirect-api=false, port=NxtrDiagMgr}
    7 x timing event:
      TMT_uDiagECC_Per: start-on-event=uDiagECC_Per, period=0.01
      TMT_uDiagLossOfExec_Per2: start-on-event=uDiagLossOfExec_Per2, period=0.001
      TMT_uDiagLossOfExec_Per3: start-on-event=uDiagLossOfExec_Per3, period=0.004
      uDiagPeriphStartup_InitEvent: start-on-event=uDiagPeriphStartup_Init, period=0
      uDiagResetHandler_InitEvent: start-on-event=uDiagResetHandler_Init, period=0
      TMT_uDiagStaticRegs_Per: start-on-event=uDiagStaticRegs_Per, period=0.1
      TMT_uDiagVIM_Per: start-on-event=uDiagVIM_Per, period=0.01
    7 x runnable:
      uDiagECC_Per
      uDiagLossOfExec_Per2
      uDiagLossOfExec_Per3
        sync call SC_NxtrDiagMgr_SetNTCStatus: operation=NxtrDiagMgr.SetNTCStatus, timeout=0
      uDiagPeriphStartup_Init
        sync call SC_NxtrDiagMgr_SetNTCStatus: operation=NxtrDiagMgr.SetNTCStatus, timeout=0
      uDiagResetHandler_Init
        sync call SC_NxtrDiagMgr_SetNTCStatus: operation=NxtrDiagMgr.SetNTCStatus, timeout=0
      uDiagStaticRegs_Per
      uDiagVIM_Per
  swc implementation Cd_uDiag_Implementation: behavior=Cd_uDiag_InternalBehavior
    code-descriptors:
      code Code: type=SRC
