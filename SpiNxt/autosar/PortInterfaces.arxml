AUTOSAR XML (schema 321)
package /PortInterface
  client server interface Spi_Ch: is-service=true
    operation SetupEB
      arg SrcDataBufferPtr: type=Spi_DataPtr, direction=IN
      arg DesDataBufferPtr: type=Spi_DataPtr, direction=IN
      arg Length: type=Spi_NumberOfDataType, direction=IN
  client server interface Spi_Notification: is-service=true
    operation JobEnd
    operation SequenceEnd
  client server interface Spi_Seq: is-service=true
    operation AsyncTransmit
    operation GetSequenceResult: possible-error=[SPI_SEQ_CANCELLED, SPI_SEQ_FAILED, SPI_SEQ_PENDING]
    error SPI_SEQ_CANCELLED: error-code=3
    error SPI_SEQ_FAILED: error-code=2
    error SPI_SEQ_PENDING: error-code=1
