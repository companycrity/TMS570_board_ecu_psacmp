AUTOSAR XML (schema 321)
package /DataType
  array type Spi_DataPtr  # DataPtr Type to be used by WriteBlock, ReadBlock and RestoreBlockDefaults operations. This type is used for all NVRAM blocks
    element Spi_DataPtr: type=Spi_DataType, max-number-of-elements=65535
  4 x integer type, all with lower-limit=0:
    Spi_ChannelType: upper-limit=255
    Spi_DataType: upper-limit=255
    Spi_NumberOfDataType: upper-limit=65535
    Spi_SequenceType: upper-limit=255
