AUTOSAR XML (schema 3.1.2)
package /NEXTEER_DEF
  ecu parameter definition AUTOSARParameterDefinition: module=DiagMgr
  module definition DiagMgr [0..1]: variants post-build/pre-compile  # Configuration of the Nexteer DiagMgr (Diagnostic Event Manager) module.
    container DiagMgrConfigSet: multiple-configuration-container=true  # This container contains the configuration parameters and sub containers of the Nexteer DiagMgr module supporting multiple configuration sets. This container is a MultipleConfigurationContainer, i.e. this container and its sub-containers exist once per configuration set.
      container DiagMgrEventParameter [0..65535]  # This container contains the configuaration (parameters) for events. Note that this container definition does not explicitly define a symbolic name parameter. Instead, the short name of the container will be used in the Ecu Configuration Description to specify the symbolic name of the DEM_EVENT_NAME.
        integer DiagMgrEventID: 1..65535, set at pre-compile, symbolic-name-value=true  # Unique identifier of an EVENT, this parameter should not be changeable by user, because the EventId should be generated by DEM itself to prevent gaps and multiple use of an Id. max = 255 For small ECUs with < 255 different events and a limited RAM, the events should be sequentially ordered beginning with 1 and no gaps in between. max = 65535 For ECUs with > 255 different events, the events should be sequentially ordered beginning with 1 and no gaps in between.
        integer DiagMgrNTC: 1..512, set at post-build in variant post-build / pre-compile in variant pre-compile  # Nexteer Trouble Code
        enumeration DiagMgrEventKind: {DIAGMGR_EVENT_KIND_BSW, DIAGMGR_EVENT_KIND_SWC}  # This container contains the configuaration (parameters) for DiagMgrEventType. This parameter is used to distinguish between SW-C and BSW events. SW-C events are for DiagMgr_SetEventStatus API and BSW events are for DiagMgr_ReportErrorStatus API.
        reference OsApplicationRef: destination=OsApplication  # This defines the Application which determines/provides the Event status (i.e. runs the associated diagnostic algorithm).
    container DiagMgrGeneral  # This container contains the configuration (parameters) of the Nexteer DiagMgr
      string DiagMgrCPEnable [0..255]: origin=NEXTEER  # This container contains the configuaration (parameters) for the DiagMgr watchdog checkpoints.
      boolean DiagMgrIsMtoProgram: set at pre-compile, default-value=0  # Is this a Magnasteer Torque Overlay (MTO) Program? true: Use Diff. Pressure and Coil Current for Snapshop Param1 and Param2 respectively. false: Use HwTrq and MtrTrq for Snapshot Param1 and Param2 respectively.
      boolean DiagMgrDevErrorDetect: set at pre-compile  # Activate/Deactivate the Development Error Detection and Notification. true: Development Error Detection and Notification activated false: Development Error Detection and Notification deactivated
      boolean DiagMgrVersionInfoApi: set at pre-compile  # Activate/Deactivate the version information API. true: version information activated false: version information deactivated
      float DiagMgrRecoverPeriod: 0.002..10, set at pre-compile, symbolic-name-value=true  # Cyclic fail action recovery processing period in seconds (i.e. the periodic rate at which the recovery determination process is triggered).
      float DiagMgrFailPeriod: 0.002..10, set at pre-compile, symbolic-name-value=true  # Cyclic fail action conslidation processing period in seconds (i.e. the periodic rate at which the failure reaction process is triggered).
      float DiagMgrDemIfPeriod: 0.002..10, set at pre-compile, symbolic-name-value=true  # Cyclic Dem interface processing period in seconds (i.e. the periodic rate at which the event statuses are forwarded to the Dem).
      integer NumOfDemEvents: set at pre-compile, origin=Nexteer, default-value=0  # Number of DEM events configured
      integer NumOfInverters: 1..2, set at pre-compile, origin=Nexteer, default-value=2  # Number of Inverters
      reference DiagMgrDemIfOsAppRef: destination=OsApplication  # This defines the Application which forwards event statuses to the Dem Interface.
      reference DiagMgrFailActionOsAppRef: destination=OsApplication  # This defines the Application which consolidates the fail action of all the DiagMgr application specific data structures into the overall system failure response.
    container CommonPublishedInformation  # Common container, aggregated by all modules. It contains published information about vendor and versions.
      integer ArMajorVersion: set at published-information, origin=Nexteer, default-value=3  # Major version number of AUTOSAR specification on which the appropriate implementation is based on.
      integer ArMinorVersion: set at published-information, origin=Nexteer, default-value=2  # Minor version number of AUTOSAR specification on which the appropriate implementation is based on.
      integer ArPatchVersion: set at published-information, origin=Nexteer, default-value=0  # Patch level version number of AUTOSAR specification on which the appropriate implementation is based on.
      integer SwMajorVersion: set at published-information, origin=Nexteer, default-value=0  # Major version number of the vendor specific implementation of the module.
      integer SwMinorVersion: set at published-information, origin=BMW GroupNexteer, default-value=0  # Minor version number of the vendor specific implementation of the module. The numbering is vendor specific.
      integer SwPatchVersion: set at published-information, origin=Nexteer, default-value=0  # Patch level version number of the vendor specific implementation of the module. The numbering is vendor specific.
      integer ModuleId: set at published-information, origin=Nexteer, default-value=0  # Module ID of this module from Module List
      integer VendorId: set at published-information, origin=Nexteer, default-value=0  # Vendor ID of the dedicated implementation of this module according to the AUTOSAR vendor list
      string VendorApiInfix [0..1]: set at published-information, origin=Nexteer
