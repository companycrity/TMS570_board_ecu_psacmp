AUTOSAR XML (schema 314)
package /ModeDclrGroup
  mode declaration group StaMd_Mode: initial-mode=WARMINIT  # EPS System State mode declaration
    4 x mode:
      DISABLE
      OFF
      OPERATE
      WARMINIT
package /PortInterface
  sender receiver interface BoolStatusFlag_Cnt_lgc
    data Cnt_lgc: sw-calibration-access=READ-ONLY, type=Boolean
  sender receiver interface SystemState
    mode declaration group prototype Mode: type=StaMd_Mode
