AUTOSAR XML (schema 314)
standard types defined: Boolean, UInt16, UInt32, Float
package /DataType
  integer type TuningSessionAddrPtrEnum: compu {0=TUN_SESSION_PTR_PERS, 1=TUN_SESSION_PTR_SETS, 2=TUN_SESSION_PTR_COMMON, 3=TUN_SESSION_PTR_SETANDPER, 4=TUN_SESSION_PTR_SETANDPERANDCOMMON, 16=TUN_SESSION_PTR_CUSTSEG, 255=TUN_SESSION_PTR_DISABLED}, lower-limit=0, upper-limit=255
