AUTOSAR XML (schema 314)
package /Constant
  constant specification D_2MS_SEC_F32
    value:
      real literal D_2MS_SEC_F32: type=Float, value=0.002
  constant specification D_ONE_ULS_F32
    value:
      real literal D_ONE_ULS_F32: type=Float, value=1
  constant specification D_ZERO_ULS_F32
    value:
      real literal D_ZERO_ULS_F32: type=Float, value=0
