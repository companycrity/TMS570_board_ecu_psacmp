AUTOSAR XML (schema 314)
standard types defined: UInt16, UInt8, Float
