AUTOSAR XML (schema 314)
package /PortInterface
  sender receiver interface HwTrq
    data HwNm_f32: sw-calibration-access=READ-ONLY, type=Float
  sender receiver interface MtrTrq
    data MtrNm_f32: sw-calibration-access=READ-ONLY, type=Float
  sender receiver interface VehSpd
    data Kph_f32: sw-calibration-access=READ-ONLY, type=Float
