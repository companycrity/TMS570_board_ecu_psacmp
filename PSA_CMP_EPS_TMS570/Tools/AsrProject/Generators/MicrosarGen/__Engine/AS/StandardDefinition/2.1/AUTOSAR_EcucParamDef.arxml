[part 1 of 3: package /AUTOSAR]
AUTOSAR XML (schema 2.1.5)
# The material contained in this specification is protected by copyright and other types
# of Intellectual Property Rights. The commercial exploitation of the material contained
# in this specification requires a license to such Intellectual Property Rights.
# This specification may be utilized or reproduced without any modification, in any form
# or by any means, for informational purposes only.
# For any other purpose, no part of the specification may be utilized or reproduced, in
# any form or by any means, without permission in writing from the publisher.
# exemplary items are licensed under the same rules as applicable to the AUTOSAR
package /AUTOSAR
  ecu parameter definition AUTOSARParameterDefinition: module=[Adc, CNm, Can, CanIf, CanNm, CanTp, CanTrcv, Com, ComM, Crc, Dcm, Dem, Det, Dio, Ea, EcuC, EcuM, Eep, Fee, Fim, Fls, Fr, FrIf, FrNm, FrTp, FrTrcv, Gpt, IPduMplex, Icu, IoHwAbstraction, Lin, LinIf, LinTp, Mcu, MemIf, Nm, NvM, Os, PduR, Port, Pwm, RamTst, Rte, SchM, Spi, Wdg, WdgIf, WdgM]
  module definition Adc [0..1]  # Configuration of the Adc (Analog Digital Conversion) module.
    container AdcConfigSet  # This is the base container that contains the post-build selectable configuration parameters
      container AdcHwUnit [1..*]  # This container contains the Driver configuration (parameters) depending on grouping of channels This container could contain HW specific parameters which are not defined in the Standardized Module Definition. They must be added in the Vendor Specific Module Definition.
        integer AdcClockSource [0..1]: 0.., origin=AUTOSAR_ECUC V1.0.0  # The ADC module specific clock input for the conversion unit can statically be configured to select different clock sources if provided by hardware.
        integer AdcHwUnitId: origin=AUTOSAR_ECUC V1.1.0  # Numeric ID of the HW Unit. This symbolic nam allows accessing Hw Unit data.
        integer AdcPrescale [0..1]: 0.., origin=AUTOSAR_ECUC V1.0.0  # Optional ADC module specific clock prescale factor, if supported by hardware.
        container AdcChannel [1..*]  # This container contains the channel configuration (parameters) depending on the hardware capability. The organization of this data structure could contain dependencies to the microcontroller so this is left up to the implementer and its location is left up to the configuration. Note: Since a AdcChannel can be part of several AdcGroups, this container is not realized as a subcontainer of AdcGroup but instead as a subcontainer of AdcHwUnit.
          integer AdcChannelConvTime [0..1]: 0.., origin=AUTOSAR_ECUC V1.0.0  # Configuration of conversion time, including sample time (in clockcycles) for each channel, if supported by hardware .
          integer AdcChannelId: 0.., origin=AUTOSAR_ECUC V1.0.0, symbolic-name-value=true  # Channel Id of the ADC channel. This value will be assigned to the symbolic name derived of the AdcChannel container short name.
          integer AdcChannelRefVoltsrcHigh [0..1]: origin=AUTOSAR_ECUC V1.0.0  # Upper reference voltage source for each channel (optional)
          integer AdcChannelRefVoltsrcLow [0..1]: origin=AUTOSAR_ECUC V1.0.0  # Lower reference voltage source for each channel (optional)
          integer AdcChannelResolution [0..1]: 0.., origin=AUTOSAR_ECUC V1.0.0  # Channel resolution in bits (optional)
        container AdcGroup [1..*]  # This container contains the Group configuration (parameters).
          enumeration AdcGroupAccessMode: {AdcAccessModeSingle, AdcAccessModeStreaming}, origin=AUTOSAR_ECUC V1.1.0  # Type of access mode to group conversion results.
          enumeration AdcGroupConversionMode: {AdcConvModeContinuous, AdcConvModeOneshot}, origin=AUTOSAR_ECUC V1.0.0  # Conversion mode of the channel group.
          integer AdcGroupId: 0.., origin=AUTOSAR_ECUC V1.0.0, symbolic-name-value=true  # Channel Id of the ADC channel group This value will be assigned to the symbolic name derived of the AdcChannelGroup container short name.
          integer AdcGroupPriority: 0..255, origin=AUTOSAR_ECUC V1.1.0  # Priority level of the group
          enumeration AdcGroupTriggSrc: {AdcTriggSrcHw, AdcTriggSrcSw}, origin=AUTOSAR_ECUC V1.0.0  # Triggering source for oneshot conversion:
          enumeration AdcHwTrigSignal: {AdcHwTrigBothEdge, AdcHwTrigFallingEdge, AdcHwTrigRisingEdge}, origin=AUTOSAR_ECUC V1.1.0  # Configures on which edge of the hardware trigger signal the driver should reach, i.e. start the conversion (only if supported by the ADC hardware)
          integer AdcHwTrigTimer: origin=AUTOSAR_ECUC V1.1.0  # Reload value of the ADC module embedded timer (only if supported by hardware)
          function name AdcNotification [0..1]: origin=AUTOSAR_ECUC V1.0.0  # Callback function for each group
          enumeration AdcStreamingBufferMode: {AdcStreamBufferCircular, AdcStreamBufferLinear}, origin=AUTOSAR_ECUC V1.1.0  # Configure streaming buffer as "linear buffer" (i.e. the ADC Driver stops the conversion as soon as the stream buffer is full) or as "ring buffer" (wraps around if the end of the stream buffer is reached).
          integer AdcStreamingBufferPointer [0..1]: origin=AUTOSAR_ECUC V1.1.0  # Pointer to data buffer (destination for conversion results) in case of streaming access mode
          integer AdcStreamingNumSamples: origin=AUTOSAR_ECUC V1.1.0  # Number of ADC values to be acquired per channel in streaming access mode.
          reference def AdcGroupDefinition: lower-multiplicity=0, upper-multiplicity=*, origin=AUTOSAR_ECUC V1.0.0, destination=AdcChannel  # Assignment of channels to a channel group. For each AdcChannel that should belong to the group, a reference needs to be defined.
    container AdcGeneral  # General configuration (parameters) of the ADC Driver software module.
      boolean AdcDeInitApi: origin=AUTOSAR_ECUC V1.0.0  # Adds / removes the service Adc_DeInit() from the code.
      boolean AdcDevErrorDetect: origin=AUTOSAR_ECUC V1.0.0  # Switches the Development Error Detection and Notification ON or OFF.
      boolean AdcEnableStartStopGroupApi: origin=AUTOSAR_ECUC V1.0.0  # Adds / removes the services Adc_StartGroupConversion() and Adc_StopGroupConversion() from the code.
      boolean AdcGrpNotifCapability: origin=AUTOSAR_ECUC V1.0.0  # Determines, if the group notification mechanism is available at runtime.
      integer AdcGrpPriorityImpLevel: origin=AUTOSAR_ECUC V1.1.0  # Determines the number of available priority levels (255 means a full support of the priority mechanism support, 0 means that the priority mechanism is not available at all, any other value means a partial support of the priority mechanism).
      boolean AdcHwTriggerApi: origin=AUTOSAR_ECUC V1.0.0  # Adds / removes the services Adc_EnableHardwareTrigger() and Adc_DisableHardwareTrigger() from the code.
      boolean AdcVersionInfoApi: origin=AUTOSAR_ECUC V1.0.0  # Adds / removes the service Adc_GetVersionInfo() from the code.
    container AdcPublishedInformation  # Additional published parameters not covered by CommonPublishedInformation container. Note that these parameters do not have any configuration class setting, since they are published information.
      boolean AdcChannelValueSigned: implementation-config-class=PUBLISHED-INFORMATION, origin=AUTOSAR_ECUC V1.0.0  # Information whether the result value of the ADC driver has sign information (true) or not (false). If the result shall be interpreted as signed value it shall apply to C-language rules.
      boolean AdcGroupFirstChannelFixed: implementation-config-class=PUBLISHED-INFORMATION, origin=AUTOSAR_ECUC V1.0.0  # Information whether the first channel of an ADC Channel group can be configured (false) or is fixed (true) to a value determined by the ADC HW Unit.
      integer AdcMaxChannelResolution: implementation-config-class=PUBLISHED-INFORMATION, origin=AUTOSAR_ECUC V1.0.0  # Maximum Channel resolution in bits (does not specify accuracy).
    container CommonPublishedInformation  # Common container, aggregated by all modules. It contains published information about vendor and versions.
      integer ArMajorVersion: implementation-config-class=PUBLISHED-INFORMATION, origin=AUTOSAR_ECUC V1.0.0  # Major version number of AUTOSAR specification on which the appropriate implementation is based on.
      integer ArMinorVersion: implementation-config-class=PUBLISHED-INFORMATION, origin=AUTOSAR_ECUC V1.0.0  # Minor version number of AUTOSAR specification on which the appropriate implementation is based on.
      integer ArPatchVersion: implementation-config-class=PUBLISHED-INFORMATION, origin=AUTOSAR_ECUC V1.0.0  # Patch level version number of AUTOSAR specification on which the appropriate implementation is based on.
      integer ModuleId: implementation-config-class=PUBLISHED-INFORMATION, origin=AUTOSAR_ECUC V1.0.0  # Module ID of this module from Module List
      integer SwMajorVersion: implementation-config-class=PUBLISHED-INFORMATION, origin=AUTOSAR_ECUC V1.0.0  # Major version number of the vendor specific implementation of the module. The numbering is vendor specific.
      integer SwMinorVersion: implementation-config-class=PUBLISHED-INFORMATION, origin=AUTOSAR_ECUC V1.0.0  # Minor version number of the vendor specific implementation of the module. The numbering is vendor specific.
      integer SwPatchVersion: implementation-config-class=PUBLISHED-INFORMATION, origin=AUTOSAR_ECUC V1.0.0  # Patch level version number of the vendor specific implementation of the module. The numbering is vendor specific.
      string VendorApiInfix [0..1]: implementation-config-class=PUBLISHED-INFORMATION, origin=AUTOSAR_ECUC V1.0.0  # In driver modules which can be instantiated several times on a single ECU, BSW00347 requires that the name of APIs is extended by the VendorId and a vendor specific name. This parameter is used to specify the vendor specific name. In total, the implementation specific name is generated as follows: <ModuleName>_>VendorId>_<VendorApiInfix><Api name from SWS>. E.g. assuming that the VendorId of the implementor is 123 and the implementer chose a VendorApiInfix of "v11r456" a api name Can_Write defined in the SWS will translate to Can_123_v11r456Write. This parameter is mandatory for all modules with upper multiplicity > 1. It shall not be used for modules with upper multiplicity =1.
      integer VendorId: implementation-config-class=PUBLISHED-INFORMATION, origin=AUTOSAR_ECUC V1.0.0  # Vendor ID of the dedicated implementation of this module according to the AUTOSAR vendor list
  module definition CNm [0..1]  # The Can Generic Nm Module.
    container CNmGlobalConfig  # This container contains all global configuration parameters of CAN Generic NM configured from the NM Module perspective.
      derived boolean CNmBusLoadReductionEnabled: origin=AUTOSAR_ECUC V1.1.0  # Pre-processor switch for enabling busload reduction support. calculationFormula = If(CNmPassiveModeEnabled == False) then Equal(NmPassiveModeEnabled) else Equal(False)
      derived boolean CNmBusSynchronizationEnabled: origin=AUTOSAR_ECUC V1.1.0  # Pre-processor switch for enabling bus synchronization support. This feature is required for gateway nodes only. calculationFormula = If (CNmPassiveModeEnabled == True) then Equal(False) else Equal(False or True)
      integer CNmCanNmConfigPtr: origin=AUTOSAR_ECUC V1.1.0  # Pointer to configuration of CanNm
      derived boolean CNmComControlEnabled: origin=AUTOSAR_ECUC V1.1.0  # Pre-processor switch for enabling the Communication Control support. calculationformula = Equal(NmComControlEnabled)
      boolean CNmDevErrorDetect: origin=AUTOSAR_ECUC V1.1.0  # Pre-processor switch for enabling development error detection support.
      derived boolean CNmImmediateRestartEnabled: origin=AUTOSAR_ECUC V1.1.0  # Pre-processor switch for enabling the asynchronous transmission of a NM-message upon bus-communication request in Prepare-Bus-Sleep mode. calculationFormula = If{CNmPassiveModeEnabled == True} then Equal(False) else Equal(True or False)
      derived boolean CNmNodeDetectionEnabled: origin=AUTOSAR_ECUC V1.1.0  # Pre-processor switch for enabling the node detection support. calculationFormula = If (CNmNodeIdEnabled == True) then Equal(NmNodeDetectionEnabled) else Equal(False)
      boolean CNmNodeIdEnabled: origin=AUTOSAR_ECUC V1.1.0  # Pre-processor switch for enabling the source node identifier.
      integer CNmNumberOfChannels: 1..255, origin=AUTOSAR_ECUC V1.1.0  # Number of NM channels allowed within one ECU.
      derived boolean CNmPassiveModeEnabled: origin=AUTOSAR_ECUC V1.1.0  # Pre-processor switch for enabling support of the Passive Mode. calculationFormula = Equal(NmPassiveModeEnabled)
      derived boolean CNmPduRxIndicationEnabled: origin=AUTOSAR_ECUC V1.1.0  # Pre-processor switch for enabling the PDU Rx Indication. calculationFormula = Equal(NmPduRxIndicationEnabled)
      derived boolean CNmRemoteSleepIndEnabled: origin=AUTOSAR_ECUC V1.1.0  # Pre-processor switch for enabling remote sleep indication support. This feature is required for gateway nodes only. calculationFormula = If (CNmPassiveModeEnabled == False) then Equal(NmRemoteSleepIndEnabled) else Equal(False)
      derived boolean CNmStateChangeIndEnabled: origin=AUTOSAR_ECUC V1.1.0  # Pre-processor switch for enabling the CAN Generic NM state change notification. calculationFormula = Equal(NmStateChangeIdEnabled)
      derived boolean CNmUserDataEnabled: origin=AUTOSAR_ECUC V1.1.0  # Pre-processor switch for enabling user data support. calculationFormula = Equal(NmUserDataEnabled)
      boolean CNmVersionInfoApi: origin=AUTOSAR_ECUC V1.1.0  # Pre-processor switch for enabling version info API support.
      container CNmChannelConfig [1..*]  # This container contains the channel specific configuration parameter of the CNm.
        derived boolean CNmBusLoadReductionActive: origin=AUTOSAR_ECUC V1.1.0  # It determines if bus load reduction for the respective NM channel is active or not. calculationFormula = If(CNmBusLoadReductionEnabled == False) then DontCare else Equal(True or False)
        boolean CNmChannelActive: origin=AUTOSAR_ECUC V1.1.0  # It determines if the respective NM channel is active or not. Indicates whether a particular NM-channel shall be initialized (TRUE) or not (FALSE)
        derived integer CNmChannelId: 0..254, origin=AUTOSAR_ECUC V1.1.0  # Channel identifier configured for the respective AUTOSAR NM cluster. It is used by referring to the respective NM channel handle. It must be unique for each AUTOSAR NM cluster within one ECU. calculationFormula = Equal(NmChannelId)
        derived integer CNmInstanceId: 7680..7934, origin=AUTOSAR_ECUC V1.1.0  # Instance identifier configured for the respective AUTOSAR NM cluster. It is defined as follows: most significant byte = NM_MODULE_ID, least significant byte = NM_CHANNEL_ID It is used by reporting of development errors to DET. It must be unique for each AUTOSAR NM cluster within one ECU. calculationFormula = Equal(NmInstanceId)
        integer CNmRemoteSleepIndTime: 1..65535, origin=AUTOSAR_ECUC V1.1.0  # Timeout for Remote Sleep Indication. It defines the time [ms] how long it shall take to recognize that all other nodes are ready to sleep. Typically it should be equal to: n * CanNmMsgCycleTime, where n denotes the number of NM-Messages that are normally sent before Remote Sleep Indication is detected. The value of n decremented by one determines the amount of lost NM-Messages that can be tolerated by the Remote Sleep Indication procedure. The value 0 denotes that no Remote Sleep Indication functionality is configured.
        integer CNmRepeatMessageTime: 0..65535, origin=AUTOSAR_ECUC V1.1.0  # Timeout for Repeat Message State. It defines the time [ms] how long the NM shall stay in the Repeat Message State. Typically it should be equal to: n * CanNmMsgCycleTime, where n denotes the number of NM-Messages that are normally sent in the Repeat Message State. The value of n decremented by one determines the amount of lost NM-Messages that can be tolerated by the node detection procedure. The value 0 denotes that no Repeat Message State is configured. It means that Repeat Message State is transient what implicates that it is left immediately after entrance and in result no start-up stability is guaranteed and no node detection procedure is possible.
        integer CNmTimeoutTime: 1..65535, origin=AUTOSAR_ECUC V1.1.0  # Network Timeout for NM-Messages. It denotes the time [ms] how long the NM shall stay in the Network Mode before transition into Prepare Bus-Sleep Mode shall take place. It shall be equal for all nodes in the cluster. It shall be greater than CanNmMsgCycleTime. Typically it should be equal to: n * CanNmMsgCycleTime, where n denotes the number of NM-Message cycle times in the Ready Sleep State before transition into the Bus-Sleep Mode is initiated. The value of n decremented by one determines the amount of lost NM-Messages that can be tolerated by the coordination algorithm.
        integer CNmWaitBusSleepTime: 1..65535, origin=AUTOSAR_ECUC V1.1.0  # Timeout for bus calm down phase. It denotes the time [ms] how long the NM shall stay in the Prepare Bus-Sleep Mode before transition into Bus-Sleep Mode shall take place. It shall be equal for all nodes in the cluster. It shall be long enough to make all Tx-buffer empty. The value 0 denotes that no Prepare Bus-Sleep State is configured. It means that Prepare Bus-Sleep State is transient what implicates that it is left immediately after entrance and in result if NM-Timeout Timer expires the Bus-Sleep Mode is entered directly.
    container CommonPublishedInformation  # Common container, aggregated by all modules. It contains published information about vendor and versions.
      integer ArMajorVersion: implementation-config-class=PUBLISHED-INFORMATION, origin=AUTOSAR_ECUC V1.0.0  # Major version number of AUTOSAR specification on which the appropriate implementation is based on.
      integer ArMinorVersion: implementation-config-class=PUBLISHED-INFORMATION, origin=AUTOSAR_ECUC V1.0.0  # Minor version number of AUTOSAR specification on which the appropriate implementation is based on.
      integer ArPatchVersion: implementation-config-class=PUBLISHED-INFORMATION, origin=AUTOSAR_ECUC V1.0.0  # Patch level version number of AUTOSAR specification on which the appropriate implementation is based on.
      integer ModuleId: implementation-config-class=PUBLISHED-INFORMATION, origin=AUTOSAR_ECUC V1.0.0  # Module ID of this module from Module List
      integer SwMajorVersion: implementation-config-class=PUBLISHED-INFORMATION, origin=AUTOSAR_ECUC V1.0.0  # Major version number of the vendor specific implementation of the module. The numbering is vendor specific.
      integer SwMinorVersion: implementation-config-class=PUBLISHED-INFORMATION, origin=AUTOSAR_ECUC V1.0.0  # Minor version number of the vendor specific implementation of the module. The numbering is vendor specific.
      integer SwPatchVersion: implementation-config-class=PUBLISHED-INFORMATION, origin=AUTOSAR_ECUC V1.0.0  # Patch level version number of the vendor specific implementation of the module. The numbering is vendor specific.
      string VendorApiInfix [0..1]: implementation-config-class=PUBLISHED-INFORMATION, origin=AUTOSAR_ECUC V1.0.0  # In driver modules which can be instantiated several times on a single ECU, BSW00347 requires that the name of APIs is extended by the VendorId and a vendor specific name. This parameter is used to specify the vendor specific name. In total, the implementation specific name is generated as follows: <ModuleName>_>VendorId>_<VendorApiInfix><Api name from SWS>. E.g. assuming that the VendorId of the implementor is 123 and the implementer chose a VendorApiInfix of "v11r456" a api name Can_Write defined in the SWS will translate to Can_123_v11r456Write. This parameter is mandatory for all modules with upper multiplicity > 1. It shall not be used for modules with upper multiplicity =1.
      integer VendorId: implementation-config-class=PUBLISHED-INFORMATION, origin=AUTOSAR_ECUC V1.0.0  # Vendor ID of the dedicated implementation of this module according to the AUTOSAR vendor list
  module definition Can  # This container holds the configuration of a single CAN Driver.
    container CanConfigSet
      container CanController [1..*]  # This container contains the configuration parameters of the CAN controller(s).
        enumeration CanBusoffProcessing: {Interrupt, Polling}, origin=AUTOSAR_ECUC V1.0.0  # Enables / disables API Can_MainFunction_BusOff() for handling busoff events in polling mode.
        boolean CanControllerActivation: origin=AUTOSAR_ECUC V1.0.0  # Defines if a CAN controller is used in the configuration.
        integer CanControllerBaudRate: origin=AUTOSAR_ECUC V1.0.0  # Specify the baud rate of the controller.
        integer CanControllerId: origin=AUTOSAR_ECUC V1.0.0, symbolic-name-value=true  # This parameter provides the controller ID which is unique in a given CAN Driver. The value for this parameter starts with 0 and continue without any gaps.
        integer CanControllerPropSeg: origin=AUTOSAR_ECUC V1.1.0
        integer CanControllerSeg1: origin=AUTOSAR_ECUC V1.0.0  # Specifies TSEG1
        integer CanControllerSeg2: origin=AUTOSAR_ECUC V1.0.0  # Specifies TSEG2
        float CanControllerTimeQuanta: origin=AUTOSAR_ECUC V1.0.0  # Specifies the time quanta for the controller. The calculation of the resulting prescaler value depending on module clocking and time quanta shall be done offline Hardware specific.
        enumeration CanRxProcessing: {Interrupt, Polling}, origin=AUTOSAR_ECUC V1.0.0  # Enables / disables API Can_MainFunction_Read() for handling PDU reception events in polling mode.
        enumeration CanTxProcessing: {Interrupt, Polling}, origin=AUTOSAR_ECUC V1.0.0  # Enables / disables API Can_MainFunction_Write() for handling PDU transmission events in polling mode.
        enumeration CanWakeupProcessing: {Interrupt, Polling}, origin=AUTOSAR_ECUC V1.0.0  # Enables / disables API Can_MainFunction_Wakeup() for handling wakeup events in polling mode.
        container CanFilterMask [0..*]  # This container contains the configuration (parameters) of the CAN Filter Mask(s).
          integer CanFilterMaskValue: origin=AUTOSAR_ECUC V1.0.0  # Describes a mask for hardware-based filtering of CAN identifiers It shall be distinguished between - Standard identifier mask - Extended identifier mask.
      container CanHardwareObject [1..*]  # This container contains the configuration (parameters) of CAN Hardware Objects.
        enumeration CanIdType: {Extended, Mixed, Standard}, origin=AUTOSAR_ECUC V1.0.0  # Specifies whether the IdValue is of type - standard identifier - extended identifier - mixed mode
        integer CanIdValue: origin=AUTOSAR_ECUC V1.0.0  # Specifies (together with the filter mask)- the identifiers range that passes the hardware filter for of RX objects.
        integer CanObjectId: origin=AUTOSAR_ECUC V1.0.0, symbolic-name-value=true  # Holds the handle ID of HRH or HTH. The value of this parameter is unique in a given CAN Driver, and it should start with 0 and continue without any gaps. The HRH and HTH Ids are defined under two different name-spaces. Therefore the IDs of HRH/HTH can overlap.
        enumeration CanObjectType: {Receive, Transmit}, origin=AUTOSAR_ECUC V1.0.0  # Specifies if the HardwareObject is used as Transmit or as Receive object
        reference def CanControllerRef: lower-multiplicity=1, upper-multiplicity=1, origin=AUTOSAR_ECUC V1.0.0, destination=CanController  # Reference to CAN Controller to which the HOH is associated to.
        reference def CanFilterMaskRef: lower-multiplicity=1, upper-multiplicity=1, origin=AUTOSAR_ECUC V1.0.0, destination=CanFilterMask  # Reference to the filter mask that is used for hardware filtering togerther with the CAN_ID_VALUE
    container CanGeneral  # This container contains the parameters related each CAN Driver Unit.
      boolean CanDevErrorDetection: origin=AUTOSAR_ECUC V1.0.0  # Switches the Development Error Detection and Notification ON or OFF.
      boolean CanHardwareCancellation: origin=AUTOSAR_ECUC V1.0.0  # Specifies if hardware cancellation shall be supported.ON or OFF
      boolean CanMultiplexedTransmission: origin=AUTOSAR_ECUC V1.0.0  # Specifies if multiplexed transmission shall be supported.ON or OFF
      integer CanTimeoutDurationFactor: origin=AUTOSAR_ECUC V1.0.0  # Specifies the maximum number of loops for blocking function until a timeout is raised in short term wait loops.
      integer CanUnusedBitValue [0..1]: origin=AUTOSAR_ECUC V1.0.0  # Set unused bits to a defined value.
      boolean CanVersionInfoApi: origin=AUTOSAR_ECUC V1.0.0  # Switches the Can_GetVersionInfo() API ON or OFF.
      reference def CanCpuClockRef: lower-multiplicity=1, upper-multiplicity=1, origin=AUTOSAR_ECUC V1.1.0, destination=McuClockReferencePoint  # Reference to the CPU clock configuration, which is set in the MCU driver configuration
    container CommonPublishedInformation  # Common container, aggregated by all modules. It contains published information about vendor and versions.
      integer ArMajorVersion: implementation-config-class=PUBLISHED-INFORMATION, origin=AUTOSAR_ECUC V1.0.0  # Major version number of AUTOSAR specification on which the appropriate implementation is based on.
      integer ArMinorVersion: implementation-config-class=PUBLISHED-INFORMATION, origin=AUTOSAR_ECUC V1.0.0  # Minor version number of AUTOSAR specification on which the appropriate implementation is based on.
      integer ArPatchVersion: implementation-config-class=PUBLISHED-INFORMATION, origin=AUTOSAR_ECUC V1.0.0  # Patch level version number of AUTOSAR specification on which the appropriate implementation is based on.
      integer ModuleId: implementation-config-class=PUBLISHED-INFORMATION, origin=AUTOSAR_ECUC V1.0.0  # Module ID of this module from Module List
      integer SwMajorVersion: implementation-config-class=PUBLISHED-INFORMATION, origin=AUTOSAR_ECUC V1.0.0  # Major version number of the vendor specific implementation of the module. The numbering is vendor specific.
      integer SwMinorVersion: implementation-config-class=PUBLISHED-INFORMATION, origin=AUTOSAR_ECUC V1.0.0  # Minor version number of the vendor specific implementation of the module. The numbering is vendor specific.
      integer SwPatchVersion: implementation-config-class=PUBLISHED-INFORMATION, origin=AUTOSAR_ECUC V1.0.0  # Patch level version number of the vendor specific implementation of the module. The numbering is vendor specific.
      string VendorApiInfix [0..1]: implementation-config-class=PUBLISHED-INFORMATION, origin=AUTOSAR_ECUC V1.0.0  # In driver modules which can be instantiated several times on a single ECU, BSW00347 requires that the name of APIs is extended by the VendorId and a vendor specific name. This parameter is used to specify the vendor specific name. In total, the implementation specific name is generated as follows: <ModuleName>_>VendorId>_<VendorApiInfix><Api name from SWS>. E.g. assuming that the VendorId of the implementor is 123 and the implementer chose a VendorApiInfix of "v11r456" a api name Can_Write defined in the SWS will translate to Can_123_v11r456Write. This parameter is mandatory for all modules with upper multiplicity > 1. It shall not be used for modules with upper multiplicity =1.
      integer VendorId: implementation-config-class=PUBLISHED-INFORMATION, origin=AUTOSAR_ECUC V1.0.0  # Vendor ID of the dedicated implementation of this module according to the AUTOSAR vendor list
  module definition CanIf [0..1]  # This container includes all necessary configuration sub-containers according the CAN Interface configuration structure.
    container CanIfControllerConfig [1..*]  # This container contains the configuration (parameters) of all addressed CAN controllers by each underlying CAN driver.
      reference def CanIfDriverNameRef: lower-multiplicity=1, upper-multiplicity=1, origin=AUTOSAR_ECUC V1.0.0, destination=CanIfDriverConfig  # Refers to the CAN Driver Name to which the controller belongs to. This parameter refers to CanIfDriverConfig container.
      reference def CanIfNetworkIdRef: lower-multiplicity=1, upper-multiplicity=1, origin=AUTOSAR_ECUC V1.0.0, destination=CanIfNetworkConfig  # Reference to CanIfNetworkConfig container. This parameter refers to the Network Id to which the current controller belongs to. Note that more than one controllers can be connected to same CAN Network.
      symbolic name reference CanIfCanControllerSymRef: origin=AUTOSAR_ECUC V1.0.0, destination=CanController  # Reference to the CanIfControllerConfig. Refers to Handle ID of controller. Unique inside a given CAN Driver. The value of this parameter should start with 0 and continue without any gaps. The Handle Ids for controller are defined in CAN Driver Configuration. Those handle Ids are referred through this parameter
    container CanIfDispatchConfig [0..1]  # Holds: Call-out functions for CANIF with respect to Network. This call-out functions defined in this container are common to all the configured networks.
      function name CanIfBusoffNotifFun: origin=AUTOSAR_ECUC V1.0.0  # The call-out function invoked by CANIF after receiving busoff notification from CAN Driver. If this parameter is empty no call-out function is provided.
      function name CanIfWakeupNotifFun: origin=AUTOSAR_ECUC V1.0.0  # The call-out function invoked by CANIF after receiving wakeup notification from CAN Driver. If this parameter is empty no call-out function is provided.
      function name CanIfWakeupValidNotifFun: origin=AUTOSAR_ECUC V1.0.0  # The call-out function invoked by CANIF at first reception of L-PDU after wakeup. If this parameter is empty no call-out function is provided.
    container CanIfDriverConfig [1..*]  # Configuration parameters for all the undelying CAN driver are aggregated under this container.
      boolean CanIfBusoffNotifFun: origin=AUTOSAR_ECUC V1.0.0  # Whenever value of this parameter is set to TRUE, a call-out function for 'Controller Busoff Notification' , is provided to CAN Driver. The syntax of call -out function will be: CanIf_ControllerBusOff_<CAN Driver Name>. Whenever value of this parameter is set to FALSE, no call-out function is provided.
      string CanIfDriverName: origin=AUTOSAR_ECUC V1.0.0  # Name of CAN driver. The value of this parameter can be found in the "CommonPublishedInformation" of the corresponding CAN driver's configuration description.
      boolean CanIfReceiveIndFun: origin=AUTOSAR_ECUC V1.0.0  # Whenever value of this parameter is set to TRUE, a call-out function for 'Receive Indication', is provided to CAN Driver. The syntax of call -out function will be: CanIf_RxIndication_<CAN Driver Name>. Whenever value of this parameter is set to FALSE, no call-out function is provided.
      boolean CanIfTransmitCancFun: origin=AUTOSAR_ECUC V1.0.0  # Whenever value of this parameter is set to TRUE, a call-out function for 'Transmit Cancellation' , is provided to CAN Driver. The syntax of call -out function will be: CanIf_CancelTxConfirmation_<CAN Driver Name>. Whenever value of this parameter is set to FALSE, no call-out function is provided.
      boolean CanIfTxConfirmation: origin=AUTOSAR_ECUC V1.0.0  # Whenever value of this parameter is set to TRUE, a call-out function for 'Transmit Confirmation', is provided to CAN Driver. The syntax of call -out function will be: CanIf_TxConfirmation_<CAN Driver Name>. Whenever value of this parameter is set to FALSE, no call-out function is provided.
      boolean CanIfWakeupNotifFun: origin=AUTOSAR_ECUC V1.0.0  # Whenever value of this parameter is set to TRUE, a call-out function for 'Controller Wakeup Notification' , is provided to CAN Driver. The syntax of call -out function will be: CanIf_ControllerWakeup_<CAN Driver Name>. Whenever value of this parameter is set to FALSE, no call-out function is provided.
      reference def CanIfDriverRef: lower-multiplicity=1, upper-multiplicity=1, origin=AUTOSAR_ECUC V1.0.0, destination=CanGeneral  # CAN Interface Driver Reference. This reference can be used to get any information (Ex. Driver Name, Vendor ID) from the CAN driver. The CAN Driver name can be derived from the ShortName of the CAN driver module. Ref: Bug# 13687
      container CanIfHrhConfig [0..*]  # This container contains parameters specific to HRH.
        enumeration CanIfHrhType: {BasicCan, FullCan}, origin=AUTOSAR_ECUC V1.0.0  # Defines the HRH type i.e, whether its a BasicCan or FullCan.
        boolean CanIfSoftwareFilterHrh: origin=AUTOSAR_ECUC V1.0.0  # Enables/Disables the software filtering for this particular HRH.
        reference def CanIfCanControllerHrhIdRef: lower-multiplicity=1, upper-multiplicity=1, origin=AUTOSAR_ECUC V1.0.0, destination=CanIfControllerConfig  # Reference to controller Id to which the HRH belongs to. A controller can contain one or more HRHs. The parameter refers to "CanIfCanControllerSymRef" parameter in "CanIfControllerConfig" container.
        symbolic name reference CanIfHrhIdSymRef: origin=AUTOSAR_ECUC V1.0.0, destination=CanHardwareObject  # The parameter refers to a particular HRH object in the CAN Driver Module configuration. The HRH id is unique in a given CAN Driver. The HRH Ids are defined in the CAN Driver Module and hence it is derived from CAN Driver Configuration.
        container CanIfHrhListConfigSet
          container CanIfHrhListConfig [0..1]  # Defines the parameters required for configuraing list of CANIDs for a given same HRH.
            integer CanIfHrhListCanId [1..*]: origin=AUTOSAR_ECUC V1.0.0  # Every instance of this parameter holds single CAN ID. Since there can be more than one CANID assigned to same HRH, the lowermultiplicity is 1 and uppermultiplicity is *. Note that for every CANID mentioned with this parameter should have corresponding entry in the "CanIfRxPduConfig" container.
        container CanIfHrhRangeConfigSet
          container CanIfHrhRangeConfig [0..*]  # Defines the parameters required for configuraing multiple CANID ranges for a given same HRH.
            integer CanIfRxPduLowerCanId: origin=AUTOSAR_ECUC V1.0.0  # While configuring a CANID RANGEs, the lower CANID is assigned to this parameter. The upper CANID of the corresponding RANGE is assigned to parameter CanIfRxPduUpperCanId. Exa 1: If the CANID range is 0x500 to 0x510, then CanIfRxPduLowerCanId = 0x500 and CanIfRxPduUpperCanId = 0x510 Note that for every CANID mentioned in RANGE, should have corresponding entry in the "CanIfRxPduConfig" container. Exa 2: Considering "Exa 1", there should be entry for every CANID which lies between 0x500 to 0x510 in "CanIfRxPduConfig" container.
            integer CanIfRxPduUpperCanId: origin=AUTOSAR_ECUC V1.0.0  # While configuring a RANGE, the upperl CANID is assigned to this parameter. The lower CANID of the corresponding RANGE is assigned to parameter CanIfRxPduLowerCanId. Note that for every CANID mentioned in RANGE, should have corresponding entry in the "CanIfRxPduConfig" container.
      container CanIfHthConfig [0..*]  # This container contains parameters related to each HTH.
        enumeration CanIfHthType: {BasicCan, FullCan}, origin=AUTOSAR_ECUC V1.0.0  # This parameter defines the type of HTH i.e, "BasicCan" or "FullCan".
        reference def CanIfCanControllerHthIdRef: lower-multiplicity=1, upper-multiplicity=1, origin=AUTOSAR_ECUC V1.0.0, destination=CanIfControllerConfig  # Reference to controller Id to which the HTH belongs to. A controller can contain one or more HTHs. The parameter refers to "CanIfCanControllerSymRef" parameter in "CanIfControllerConfig" container.
        symbolic name reference CanIfHthIdSymRef: origin=AUTOSAR_ECUC V1.0.0, destination=CanHardwareObject  # The parameter refers to a particular HTH object in the CAN Driver Module configuration. The HTH id is unique in a given CAN Driver. The HTH Ids are defined in the CAN Driver Module and hence it is derived from CAN Driver Configuration.
    container CanIfInitConfigSet
      container CanIfInitConfig [1..*]  # This container contains parameters required for specific configuration setup.
        string CanIfConfigSet: origin=AUTOSAR_ECUC V1.0.0  # Selects the CAN Interface specific configuration setup.
        container CanIfRxPduConfig [0..*]  # This container contains the configuration (parameters) of each receive CAN L-PDU.
          integer CanIfCanRxPduCanId: origin=AUTOSAR_ECUC V1.0.0  # CAN Identifier of Receive CAN L-PDUs used by the CAN Interface. Exa: Software Filtering.
          integer CanIfCanRxPduDlc: origin=AUTOSAR_ECUC V1.0.0  # Data Length code of received CAN L-PDUs used by the CAN Interface. Exa: DLC check.
          integer CanIfCanRxPduId: origin=AUTOSAR_ECUC V1.0.0, symbolic-name-value=true  # ECU wide unique, symbolic handle for receive CAN L-PDU. The CanIfRxPduId is configurable.
          boolean CanIfReadRxPduData: origin=AUTOSAR_ECUC V1.0.0  # Enables and disables the Rx buffering for reading of received L-PDU data.
          boolean CanIfReadRxPduNotifyStatus: origin=AUTOSAR_ECUC V1.0.0  # Enables / Disables receive indication for each receive CAN L-PDU for reading its' notification status.
          enumeration CanIfRxPduIdCanIdType: {Extended, Standard}, origin=AUTOSAR_ECUC V1.0.0  # The parameter defines the CANID type. The value of this parameter shall be used for validating CANID of Rx L-PDUs.
          function name CanIfRxPduRxIndiCallOutFun: origin=AUTOSAR_ECUC V1.0.0  # Name of target indication services to target upper layers (PduR, CanNm and CanTp). If parameter is not configured no call-out function is configured in the upper layer for this Rx L-PDU.
          enumeration CanIfRxPduRxIndiUser: {CanNm, CanTp, PduR}, origin=AUTOSAR_ECUC V1.0.0  # This parameter defines the type of the receive indication call-outs called to the corresponding upper layer the used TargetRxPduId belongs to.
          integer CanIfRxTargetPduID: origin=AUTOSAR_ECUC V1.0.0  # This parameter holds the PDU handle Id which will be passed to upper layers during receive indication. The PDU handle Id defined for CanIfCanRxPduId parameter and target PDU handle ID need not be same. The target pdu hadle IDs of L-PDUs belonging to PduR and CanTp module should be unique. The target pdu hadle ID of L-PDUs belonging to CanNm module should be same as its Network Id.
          reference def CanIfCanRxPduHrhRef: lower-multiplicity=1, upper-multiplicity=1, origin=AUTOSAR_ECUC V1.0.0, destination=CanIfHrhConfig  # The HRH to which Rx L-PDU belongs to, is referred through this parameter.
          reference def CanIfCanRxPduIdNetworkRef: lower-multiplicity=1, upper-multiplicity=1, origin=AUTOSAR_ECUC V1.0.0, destination=CanIfNetworkConfig  # Reference to the CAN network ID to which the receive CAN L-PDU belongs to.
          reference def PduIdRef: lower-multiplicity=1, upper-multiplicity=1, origin=AUTOSAR_ECUC V1.0.0, destination=Pdu  # Reference to the "global" Pdu structure to allow harmonization of handle IDs in the COM-Stack.
        container CanIfTxPduConfig [0..*]  # This container contains the configuration (parameters) of each transmit CAN L-PDU.
          integer CanIfCanTxDynamicPduId: origin=AUTOSAR_ECUC V1.0.0  # ECU wide unique, symbolic handle number for dynamic transmit CAN L-PDU. The CanIfCanTxDynamicPduId is configurable. The handle Ids for DYNAMIC PDUs will start after handle Ids of STATIC PDUs.
          integer CanIfCanTxPduCanId: origin=AUTOSAR_ECUC V1.0.0  # CAN Identifier of transmit CAN L-PDUs. Used by the CAN Interface and CAN Driver Modules for CAN L-PDU transmission.
          integer CanIfCanTxPduDlc: origin=AUTOSAR_ECUC V1.0.0  # Data Length Code of transmit CAN L-PDUs. Used CAN Interface and CAN Driver Modules for CAN L-PDU transmission.
          integer CanIfCanTxPduId: origin=AUTOSAR_ECUC V1.0.0, symbolic-name-value=true  # ECU wide unique, symbolic handle for transmit CAN L-PDU. The CanIfCanTxPduId is configurable at pre-compile and post-built time.
          enumeration CanIfCanTxPduType: {Dynamic, Static}, origin=AUTOSAR_ECUC V1.0.0  # Defines the type of each transmit CAN L-PDU.
          boolean CanIfReadTxPduNotifyStatus: origin=AUTOSAR_ECUC V1.0.0  # Enables and disables the API for reading the notification status of transmit L-PDUs.
          enumeration CanIfTxPduIdCanIdType: {Extended, Standard}, origin=AUTOSAR_ECUC V1.0.0  # The parameter decides the CANID type. The value of this parameter shall be used for validating the input parameter in CanIf_SetDynamicTxId() API.
          function name CanIfTxPduTxConfirmCallOut: origin=AUTOSAR_ECUC V1.0.0  # Name of target confirmation services to target upper layers (PduR, CanNm and CanTp. If parameter is not configured then no call-out function is provided by the upper layer for this Tx L-PDU.
          integer CanIfTxTargetPduId: origin=AUTOSAR_ECUC V1.0.0  # This parameter holds the PDU handle Id which will be passed to upper layers during transmission confirmation. The PDU handle Id defined for CanIfCanTxPduId parameter and target PDU handle ID need not be same. The target pdu hadle IDs of L-PDUs belonging to PduR and CanTp module should be unique. The target pdu hadle ID of L-PDUs belonging to CanNm module should be same as its Network Id.
          enumeration CanIfTxUserType: {CanNm, CanTp, PduR}, origin=AUTOSAR_ECUC V1.0.0  # This parameter defines the type of the transmit confirmation call-out called to the corresponding upper layer the used TargetTxPduId belongs to.
          reference def CanIfCanTxPduHthRef: lower-multiplicity=1, upper-multiplicity=1, origin=AUTOSAR_ECUC V1.0.0, destination=CanIfHthConfig  # Handle, that defines the hardware object or the pool of hardware objects configured for transmission. The parameter refers HTH Id, to which the L-PDU belongs to.
          reference def CanIfCanTxPduIdNetworkRef: lower-multiplicity=1, upper-multiplicity=1, origin=AUTOSAR_ECUC V1.0.0, destination=CanIfNetworkConfig  # This parameter holds the NETWORK ID to which this PDU belongs to.
          reference def PduIdRef: lower-multiplicity=1, upper-multiplicity=1, origin=AUTOSAR_ECUC V1.0.0, destination=Pdu  # Reference to the "global" Pdu structure to allow harmonization of handle IDs in the COM-Stack.
      container CanIfInitControllerConfig [0..*]  # This container contains the references to the configuration setup of each underlying CAN driver.
        string CanIfControllerRefConfig: origin=AUTOSAR_ECUC V1.0.0  # References the corresponding CAN Controller configuration setup the corresponding CAN driver.
      container CanIfInitDriverConfig [1..*]  # This container contains the references to the configuration setup of each underlying CAN driver.
        string CanIfDriverRefConfig: origin=AUTOSAR_ECUC V1.0.0  # Reference to the CAN controller specific configuration setup.
      container CanIfInitNetworkConfig [0..*]  # This container contains the references to the configuration setup of each underlying CAN driver.
        string CanIfControllerConfigSet: origin=AUTOSAR_ECUC V1.0.0  # Selects the CAN controller specific configuration setup of the CAN Interface.
    container CanIfNetworkConfig [1..*]  # This container contains parameter required for configuring Network.
      enumeration CanIfNetworkEvent: {EcumWkSourceAllSources, EcumWkSourceExternalWdg, EcumWkSourceInternalReset, EcumWkSourceInternalWdg, EcumWkSourcePower, EcumWkSourceReset}, origin=AUTOSAR_ECUC V1.0.0  # Defines different types of sources for controller wakeup.
      integer CanIfNetworkId: origin=AUTOSAR_ECUC V1.0.0, symbolic-name-value=true  # This parameter holds the handle Id value. The value for Network ID should start with 0 and continue without any gaps. The value of Network Id is unique across the system.
    container CanIfPrivateConfig  # This container contains the private configuration (parameters) of the CAN Interface.
      boolean CanIfDlcCheck: origin=AUTOSAR_ECUC V1.0.0  # Enables or Disables the DLC check. Whenever this parameter is set to TRUE, the DLC of received L-PDU is validated against the pre-defined DLC. The Rx L-PDU is passed to upper layer only when it passes the DLC check. Where as when the value of this parameter is FALSE, all the received L-PDUs are passed to <user> without any DLC check.
      integer CanIfNumberOfTxBuffers: origin=AUTOSAR_ECUC V1.0.0  # Defined the number of L-PDU elements for the transmit buffering. The Tx L-PDU buffers shall be used to store an L-PDU once for each different L-PDU handle.
      enumeration CanIfSoftwareFilterType: {Binary, Linear}, origin=AUTOSAR_ECUC V1.0.0  # This parameter provides different types of software filter methods that can be implemted in the CANIF. The value of this parameter is vendor specific.
    container CanIfPublicConfig  # This container contains the public configuration (parameters) of the CAN Interface.
      boolean CanIfDevErrorDetect: origin=AUTOSAR_ECUC V1.0.0  # Enables and disables the development error detection and notification mechanism.
      function name CanIfDlcErrNotifFun: origin=AUTOSAR_ECUC V1.0.0  # Holds: The call-out function name which will be invoked by CANIF whenever DLC Check fails. The function confgured is common to all the receive L-Pdus. If parameter is not configured, no call-out function is provided.
      integer CanIfNumOfCanHwUnits: origin=AUTOSAR_ECUC V1.0.0  # Holds: Number of served CAN hardware units.
      integer CanIfNumOfCanRxPduIds: origin=AUTOSAR_ECUC V1.0.0  # Total number of CanRxPduIds to be handled.
      integer CanIfNumOfCanTxPduIds: origin=AUTOSAR_ECUC V1.0.0  # Total number of CanTxPduIds to be handled.
      integer CanIfNumOfDynamicCanTxPduIds: origin=AUTOSAR_ECUC V1.0.0  # Total number of CanTxPduIds to be handled.
      integer CanIfNumOfNetworks: origin=AUTOSAR_ECUC V1.0.0  # Number of served CAN networks.
      boolean CanIfPollingBusoff: origin=AUTOSAR_ECUC V1.0.0  # Selects polling mode for BusOff events for each underlying CAN driver.
      boolean CanIfPollingReceive: origin=AUTOSAR_ECUC V1.0.0  # Selects polling mode for receive events for each underlying CAN driver.
      boolean CanIfPollingTransmit: origin=AUTOSAR_ECUC V1.0.0  # Selects polling mode for transmit events for each underlying CAN driver.
      boolean CanIfPollingWakeup: origin=AUTOSAR_ECUC V1.0.0  # Selects polling mode for wakeup events for each underlying CAN driver.
      boolean CanIfReadRxPduDataApi: origin=AUTOSAR_ECUC V1.0.0  # Enables / Disables the API CanIf_ReadRxPduData() for reading received L-PDU data.
      boolean CanIfReadRxPduNotifStatusApi: origin=AUTOSAR_ECUC V1.0.0  # Enables / Disables the API CanIf_ReadRxNotifStatus() for reading the notification status of receive L-PDUs.
      boolean CanIfReadTxPduNotifStatusApi: origin=AUTOSAR_ECUC V1.0.0  # Enables / Disables the API CanIf_ReadTxNotifStatus() for reading the notification status of transmit L-PDUs.
      boolean CanIfSetDynamicTxIdApi: origin=AUTOSAR_ECUC V1.0.0  # Enables / Disables the API CanIf_SetDynamicTxId(), for reconfiguring CAN ID of Dynamic Transmit L-PDUs.
      boolean CanIfVersionInfoApi: origin=AUTOSAR_ECUC V1.0.0  # Enables / Disables the API CanIf_GetVersionInfo(), for reading the version information of CAN Interface module.
      boolean CanIfWakeupSupportApi: origin=AUTOSAR_ECUC V1.0.0  # Enables / Disables the API, for 'wakeup notification'. When value of this parameter is set to FALSE, no call-out functions will be provided to CAN Driver Module. If it is set to TRUE, CANIF provides call-out functions for each underlying CAN Driver,
    container CommonPublishedInformation  # Common container, aggregated by all modules. It contains published information about vendor and versions.
      integer ArMajorVersion: implementation-config-class=PUBLISHED-INFORMATION, origin=AUTOSAR_ECUC V1.0.0  # Major version number of AUTOSAR specification on which the appropriate implementation is based on.
      integer ArMinorVersion: implementation-config-class=PUBLISHED-INFORMATION, origin=AUTOSAR_ECUC V1.0.0  # Minor version number of AUTOSAR specification on which the appropriate implementation is based on.
      integer ArPatchVersion: implementation-config-class=PUBLISHED-INFORMATION, origin=AUTOSAR_ECUC V1.0.0  # Patch level version number of AUTOSAR specification on which the appropriate implementation is based on.
      integer ModuleId: implementation-config-class=PUBLISHED-INFORMATION, origin=AUTOSAR_ECUC V1.0.0  # Module ID of this module from Module List
      integer SwMajorVersion: implementation-config-class=PUBLISHED-INFORMATION, origin=AUTOSAR_ECUC V1.0.0  # Major version number of the vendor specific implementation of the module. The numbering is vendor specific.
      integer SwMinorVersion: implementation-config-class=PUBLISHED-INFORMATION, origin=AUTOSAR_ECUC V1.0.0  # Minor version number of the vendor specific implementation of the module. The numbering is vendor specific.
      integer SwPatchVersion: implementation-config-class=PUBLISHED-INFORMATION, origin=AUTOSAR_ECUC V1.0.0  # Patch level version number of the vendor specific implementation of the module. The numbering is vendor specific.
      string VendorApiInfix [0..1]: implementation-config-class=PUBLISHED-INFORMATION, origin=AUTOSAR_ECUC V1.0.0  # In driver modules which can be instantiated several times on a single ECU, BSW00347 requires that the name of APIs is extended by the VendorId and a vendor specific name. This parameter is used to specify the vendor specific name. In total, the implementation specific name is generated as follows: <ModuleName>_>VendorId>_<VendorApiInfix><Api name from SWS>. E.g. assuming that the VendorId of the implementor is 123 and the implementer chose a VendorApiInfix of "v11r456" a api name Can_Write defined in the SWS will translate to Can_123_v11r456Write. This parameter is mandatory for all modules with upper multiplicity > 1. It shall not be used for modules with upper multiplicity =1.
      integer VendorId: implementation-config-class=PUBLISHED-INFORMATION, origin=AUTOSAR_ECUC V1.0.0  # Vendor ID of the dedicated implementation of this module according to the AUTOSAR vendor list
  module definition CanNm [0..1]  # The Can Nm module
    container CanNmFeatureConfig  # This container contains parameter which enables or disables optional features of the CanNm.
      derived boolean CanNmBusLoadReductionEnabled: origin=AUTOSAR_ECUC V1.1.0  # Enable/disable the bus load reduction mechanism. calculationFormula = If(CanNmPassiveModeEnabled == False) then Equal(NmBusLoadReductionEnabled) else Equal(False)
      boolean CanNmDevErrorDetect: origin=AUTOSAR_ECUC V1.1.0  # Enable/disable the development error detection.
      derived boolean CanNmImmediateTxconfEnabled: origin=AUTOSAR_ECUC V1.1.0  # Enable/disable the immediate tx confirmation, i.e. transmission confirmation to CNm is raised at the transmission request. calculationFormula = If(CanNmPassiveModeEnabled == False) then Equal(True or False) else Equal(False)
      derived boolean CanNmNodeDetectionEnabled: origin=AUTOSAR_ECUC V1.1.0  # Enable/disable the node detection functionality. calculationFormula = If(CanNmPassiveModeEnabled == False) then Equal(NmNodeDetectionEnabled) else Equal(False)
      derived boolean CanNmPassiveModeEnabled: origin=AUTOSAR_ECUC V1.1.0  # Enable/disable the passive mode, i.e. nodes which have this switch enabled must not send NM messages, but they shall receive and process NM messages. calculationFormula = Equal(NmPassiveModeEnabled)
      derived boolean CanNmUserDataEnabled: origin=AUTOSAR_ECUC V1.1.0  # Enable/disable the user data support. calculationFormula = Equal(NmUserDataEnabled)
      boolean CanNmVersionInfoApi: origin=AUTOSAR_ECUC V1.1.0  # Enable/disable the function CanNm_GetVersionInfo.
      container CanNmGlobalConfig  # This container contains the global configuration parameter of the CanNm. The parameters and the parameters of the sub containers shall be mapped to the C data type CanNm_ConfigType (for parameters where it is possible) which is passed to the CanNm_Init function. This container is a MultipleConfigurationContainer (only for variant 3), i.e. this container and its sub-containers exit once per configuration set.
        integer CanNmNumberOfChannels: 1..255, origin=AUTOSAR_ECUC V1.1.0  # Number of CanNm channels
        enumeration CanNmPduCbvPosition: {CanNmPduByte0, CanNmPduByte1, CanNmPduOff}, origin=AUTOSAR_ECUC V1.1.0  # Defines the position of the control bit vector within the NM PDU. The value of the parameter represents the location of the control bit vector in the NM PDU (CanNmPduByte0 means byte 0, CanNmPduByte1 means byte 1, CanNmPduOff means source node identifier is not part of the NM PDU)
        integer CanNmPduLength: 0..8, origin=AUTOSAR_ECUC V1.1.0  # Defines the length of the NM PDU.
        enumeration CanNmPduNidPosition: {CanNmPduByte0, CanNmPduByte1, CanNmPduOff}, origin=AUTOSAR_ECUC V1.1.0  # Defines the position of the source node identifier within the NM PDU. The value of the parameter represents the location of the source node identifier in the NM PDU (CanNMPduByte0 means byte 0, CanNmPduByte1 means byte 1, CanNmPduOff means source node identifier is not part of the NM PDU)
        integer CanNmUserDataLentgh: 0..8, origin=AUTOSAR_ECUC V1.1.0  # The difference between CanNmPduLength and applied standardized bytes (source node identifier and control bit vector) within the NM PDU.
        container CanNmChannelConfig [1..*]  # This container contains the channel specific configuration parameter of the CanNm.
          boolean CanNmBusLoadReductionActive: origin=AUTOSAR_ECUC V1.1.0  # Indicates whether the bus load reduction mechanism shall be enabled (True) or disabled (False) for a particular NM-channel. This parameter is only valid if CanNmBusLoadReductionEnabled = True and CanNmPassiveModeEnabled = False Otherwise it is not used.
          boolean CanNmChannelActive: origin=AUTOSAR_ECUC V1.1.0  # Indicates whether a particular NM-channel shall be initialized (TRUE) or not (FALSE).
          integer CanNmMsgCycleOffset: 0.., origin=AUTOSAR_ECUC V1.1.0  # Time offset in the periodic transmission node. It determines the start delay of the transmission. This parameter is only valid if CanNmPassiveModeEnabled is False. Otherwise this parameter is not used.
          integer CanNmMsgCycleTime: 0.., origin=AUTOSAR_ECUC V1.1.0  # Period of a NM-message. It determines the periodic rate in the "periodic transmission mode with bus load reduction" and is the basis for transmit scheduling in the "periodic transmission mode without bus load reduction". This parameter is only valid if CanNmPassiveModeEnabled is False. Otherwise this parameter is not used.
          integer CanNmMsgReducedtime: 0.., origin=AUTOSAR_ECUC V1.1.0  # Node specific bus cycle time in the periodic transmission mode with bus load reduction. This parameter is only valid if CanNmBusLoadReductionEnabled == True and CanNmBusLoadReductionActive == True and CanNmPassiveModeEnabled == False Otherwise this parameter is not used.
          integer CanNmMsgTimeoutTime: 0.., origin=AUTOSAR_ECUC V1.1.0  # Transmission Timeout of NM-message. If there is no transmission confirmation by the CAN Interface within this timeout, the CANNM module shall give an error notification. This parameter is only valid if CanNmPassiveModeEnabled is False. Otherwise it is not used.
          integer CanNmNodeId: 0.., origin=AUTOSAR_ECUC V1.1.0  # Node identifier of local node. This parameter is only valid if CanNmPassiveModeEnabled = False and CanNmNodeDetectionEnabled = True Otherwise it is not used.
          symbolic name reference CanNmChannelHandle: origin=AUTOSAR_ECUC V1.1.0, destination=CanIfNetworkConfig  # Channel identifier configured for the respective instance of the NM. The CanNmChannelHandle shall be encoded in the canNmRxPduId parameter which is passed to CanNm_RxIndication() function called by the CanIf. The CanNmChannelHandle shall be encoded in the canNmTxPduId which is passed to CanNm_TxConfirmation() function called by the CanIf.
          container CanNmTxPdu  # This container contains the CanNmTxPduId and the CanNmTxPduRef.
            integer CanNmTxPduId: 0.., origin=AUTOSAR_ECUC V1.1.0  # L-PDU handle of the NM PDU to be transmitted by CanIf_Transmit and passed to CanNm_TxConfirmation by the CanIf. This handle specifies the corresponding CAN frame ID and implicitly the CAN driver instance as well as the corresponding CAN controller device. This parameter is only valid if CanNmPassiveModeEnabled = False. Otherwise it is not used.
            reference def CanNmTxPduRef: lower-multiplicity=1, upper-multiplicity=1, origin=AUTOSAR_ECUC V1.1.0, destination=Pdu  # The reference to the common PDU structure.
    container CommonPublishedInformation  # Common container, aggregated by all modules. It contains published information about vendor and versions.
      integer ArMajorVersion: implementation-config-class=PUBLISHED-INFORMATION, origin=AUTOSAR_ECUC V1.0.0  # Major version number of AUTOSAR specification on which the appropriate implementation is based on.
      integer ArMinorVersion: implementation-config-class=PUBLISHED-INFORMATION, origin=AUTOSAR_ECUC V1.0.0  # Minor version number of AUTOSAR specification on which the appropriate implementation is based on.
      integer ArPatchVersion: implementation-config-class=PUBLISHED-INFORMATION, origin=AUTOSAR_ECUC V1.0.0  # Patch level version number of AUTOSAR specification on which the appropriate implementation is based on.
      integer ModuleId: implementation-config-class=PUBLISHED-INFORMATION, origin=AUTOSAR_ECUC V1.0.0  # Module ID of this module from Module List
      integer SwMajorVersion: implementation-config-class=PUBLISHED-INFORMATION, origin=AUTOSAR_ECUC V1.0.0  # Major version number of the vendor specific implementation of the module. The numbering is vendor specific.
      integer SwMinorVersion: implementation-config-class=PUBLISHED-INFORMATION, origin=AUTOSAR_ECUC V1.0.0  # Minor version number of the vendor specific implementation of the module. The numbering is vendor specific.
      integer SwPatchVersion: implementation-config-class=PUBLISHED-INFORMATION, origin=AUTOSAR_ECUC V1.0.0  # Patch level version number of the vendor specific implementation of the module. The numbering is vendor specific.
      string VendorApiInfix [0..1]: implementation-config-class=PUBLISHED-INFORMATION, origin=AUTOSAR_ECUC V1.0.0  # In driver modules which can be instantiated several times on a single ECU, BSW00347 requires that the name of APIs is extended by the VendorId and a vendor specific name. This parameter is used to specify the vendor specific name. In total, the implementation specific name is generated as follows: <ModuleName>_>VendorId>_<VendorApiInfix><Api name from SWS>. E.g. assuming that the VendorId of the implementor is 123 and the implementer chose a VendorApiInfix of "v11r456" a api name Can_Write defined in the SWS will translate to Can_123_v11r456Write. This parameter is mandatory for all modules with upper multiplicity > 1. It shall not be used for modules with upper multiplicity =1.
      integer VendorId: implementation-config-class=PUBLISHED-INFORMATION, origin=AUTOSAR_ECUC V1.0.0  # Vendor ID of the dedicated implementation of this module according to the AUTOSAR vendor list
  module definition CanTp [0..1]  # Configuration of the CanTp (CAN Transport Protocol) module.
    container CanTpGeneral  # This container contains the general configuration parameters of the CanTp module.
      boolean CanTpDevErrorDetect: origin=AUTOSAR_ECUC V1.0.0  # Switches the Development Error Detection and Notification ON or OFF
      integer CanTpMainFunctionPeriod: 0..255, origin=AUTOSAR_ECUC V1.1.0  # Allow to configure the time for the MainFunction (in ms). Please note: This configuration value shall be equal to the value in the ScheduleManger module.
    container CanTpRxNSdu [0..*]  # The following parameters needs to be configured for each CAN N-SDU that the CanTp module shall receive.
      enumeration CanTpAddressingFormat: {CanTpExtended, CanTpStandard}, origin=AUTOSAR_ECUC V1.1.0  # Declares which communication addressing mode is supported for this Rx N-SDU. Enum values: CanTpStandard. To use normal addressing format. CanTpExtended. To use extended addressing format.
      integer CanTpBs: origin=AUTOSAR_ECUC V1.0.0  # Sets the maximum number of N-PDUs the CanTp receiver allows the sender to send, before waiting for an authorization to continue transmission of the following N-PDUs.For further details on this parameter value see ISO 15765-2 specification. Note: For reasons of buffer length, the CAN Transport Layer can adapt the BS value within the limit of this maximum BS
      integer CanTpNar: origin=AUTOSAR_ECUC V1.1.0  # Value in ms of the N_Ar timeout. N_Ar is the time for transmission of a CAN frame (any N_PDU) on the receiver side.
      integer CanTpNbr: origin=AUTOSAR_ECUC V1.0.0  # Value in ms of the performance requirement for (N_Br + N_Ar). N_Br is the elapsed time between the receiving indication of a FF or CF or the transmit confirmation of a FC, until the transmit request of the next FC.
      integer CanTpNcr: origin=AUTOSAR_ECUC V1.0.0  # Value in ms of the N_Cr timeout. N_Cr is the time until reception of the next Consecutive Frame N_PDU.
      integer CanTpRxChannel: 0.., origin=AUTOSAR_ECUC V1.1.0  # Link to the Rx connection channel, which has to be used for receiving this N-PDU.
      integer CanTpRxDl: origin=AUTOSAR_ECUC V1.0.0  # Data Length Code of this RxNsdu. In case of variable message length, this value indicates the minimum data length. Depending on SF or FF N-SDU the value will be limited to 7 (6 for an extended addressing format) and 4095 respectively.
      integer CanTpRxNSduId: 0.., origin=AUTOSAR_ECUC V1.0.0  # Unique identifier to a structure that contains all useful information to process reception of a Rx N-SDU.
      enumeration CanTpRxPaddingActivation: {CanTpOff, CanTpOn}, origin=AUTOSAR_ECUC V1.1.0  # Defines if the receive frame uses padding or not. Definition of enumeration values: CanTpOn: The N-PDU received uses padding for SF, FC and the last CF. (N-PDU length is always 8 bytes) CanTpOff: The N-PDU received does not use padding for SF, CF and the last CF. (N-PDU length is dynamic)
      enumeration CanTpRxTaType: {CanTpFunctional, CanTpPhysical}, origin=AUTOSAR_ECUC V1.0.0  # Declares the communication type of this Rx N-SDU.
      integer CanTpRxWftMax: origin=AUTOSAR_ECUC V1.1.0  # This parameter indicates how many Flow Control wait N-PDUs can be consecutively transmitted by the receiver. It is local to the node and is not transmitted inside the FC protocol data unit. CanTpRxWftMax is used to avoid sender nodes being potentially hooked-up in case of a temporarily reception inability on the part of the receiver nodes, whereby the sender could be waiting continuously.
      integer CanTpSTmin: origin=AUTOSAR_ECUC V1.1.0  # Sets the duration of the minimum time the CanTp sender shall wait between the transmissions of two CF N-PDUs. For further details on this parameter value see ISO 15765-2 specification.
      reference def CanTpRxNSduRef: lower-multiplicity=1, upper-multiplicity=1, origin=AUTOSAR_ECUC V1.1.0, destination=Pdu
      container CanTpNSa [0..1]  # Contains the parameters needed to configure each RxNSdu or TxNSdu with CanTpAddressingFormat set to CanTpExtended.
        integer CanTpNSa: origin=AUTOSAR_ECUC V1.1.0  # If an RxNSdu ora TxNSdu is configured for extended addressing format, this parameter contains the transport protocol source address's value.
      container CanTpNTa [0..1]  # The following parameters need to be configured for each RxNsdu or TxNsdu with the CanTpAddressingFormat set to CanTpExtended.
        integer CanTpNTa: origin=AUTOSAR_ECUC V1.0.0  # If an RxNsdu or a TxNsdu is configured for extended addressing format, this parameter contains the transport protocol target address's value.
      container CanTpRxNPdu  # Used for grouping of the ID of a PDU and the Reference to a PDU.
        integer CanTpRxNPduId: 0.., origin=AUTOSAR_ECUC V1.1.0, symbolic-name-value=true  # The N-PDU identifier attached to the RxNsdu is identified by CanTpRxNSduId. Each RxNsdu identifier is linked to only one SF/FF/CF N-PDU identifier. Nevertheless, in the case of extended addressing format, the same N-PDU identifier can be used for several N-SDU identifiers. The distinction is made by the N_TA value (first data byte of SF or FF frames).
        reference def CanTpRxNPduRef: lower-multiplicity=1, upper-multiplicity=1, origin=AUTOSAR_ECUC V1.1.0, destination=Pdu  # Reference to a Pdu in the COM-Stack.
      container CanTpTxFcNPdu  # Used for grouping of the ID of a PDU and the Reference to a PDU.
        integer CanTpTxFcNPduId: 0.., origin=AUTOSAR_ECUC V1.1.0  # The N-PDU identifier attached to the FC N-PDU of this RxNSdu is identified by CanTpRxNSduId. Each RxNSdu identifier is linked to only one Tx FC N-PDU identifier. But, in case of extended addressing mode, the same FC N-PDU identifier can be used for several N-SDU identifiers. The distinction is done on the N_TA value (first data byte of SF or FF frames).
        reference def CanTpTxFcNPduRef: lower-multiplicity=1, upper-multiplicity=1, origin=AUTOSAR_ECUC V1.1.0, destination=Pdu  # Reference to a Pdu in the COM-Stack.
    container CanTpTxNSdu [0..*]  # The following parameters needs to be configured for each CAN N-SDU that the CanTp module shall transmitt.
      enumeration CanTpAddressingMode: {CanTpExtended, CanTpStandard}, origin=AUTOSAR_ECUC V1.1.0  # Declares which communication addressing format is supported for this TxNsdu. Definition of Enumeration values: CanTpStandard to use normal addressing format. CanTpExtended to use extended addressing format (the N_TA container of this TxNsdu will be used).
      integer CanTpNas: origin=AUTOSAR_ECUC V1.0.0  # Value in ms of the N_As timeout. N_As is the time for transmission of a CAN frame (any N_PDU) on the part of the sender.
      integer CanTpNbs: origin=AUTOSAR_ECUC V1.0.0  # Value in ms of the N_Bs timeout. N_Bs is the time of transmission until reception of the next Flow Control N_PDU.
      integer CanTpNcs: origin=AUTOSAR_ECUC V1.0.0  # Value in ms of the performance requirement of (N_Cs + N_As). N_Cs is the time which elapses between the transmit request of a CF N-PDU until the transmit request of the next CF N-PDU.
      integer CanTpTxChannel: origin=AUTOSAR_ECUC V1.0.0  # Link to the connection channel which has to be used for transmission of this N-PDU.
      integer CanTpTxDl: origin=AUTOSAR_ECUC V1.0.0  # Data Length Code of this TxNsdu. In case of variable length message, this value indicates the minimum data length.
      integer CanTpTxNSduId: 0.., origin=AUTOSAR_ECUC V1.0.0, symbolic-name-value=true  # Unique identifier to a structure that contains all useful information to process the transmission of a TxNsdu.
      enumeration CanTpTxPaddingActivation: {CanTpOff, CanTpOn}, origin=AUTOSAR_ECUC V1.1.0  # Defines if the transmit frame use padding or not. Definition of Enumeration values: CanTpOn The transmit N-PDU uses padding for SF, FC and the last CF. (N-PDU length is always 8 bytes) CanTpOff The transmit N-PDU does not use padding for SF, CF and the last CF. (N-PDU length is dynamic)
      enumeration CanTpTxTaType: {CanTpFunctional, CanTpPhysical}, origin=AUTOSAR_ECUC V1.1.0  # Declares the communication type of this TxNsdu. Enumeration values: CanTpPhysical. Used for 1:1 communication. CanTpFunctional. Used for 1:n communication.
      reference def CanTpTxNSduRef: lower-multiplicity=1, upper-multiplicity=1, origin=AUTOSAR_ECUC V1.1.0, destination=Pdu  # Reference to a Pdu in the COM-Stack.
      container CanTpNSa [0..1]  # Contains the parameters needed to configure each RxNSdu or TxNSdu with CanTpAddressingFormat set to CanTpExtended.
        integer CanTpNSa: origin=AUTOSAR_ECUC V1.1.0  # If an RxNSdu ora TxNSdu is configured for extended addressing format, this parameter contains the transport protocol source address's value.
      container CanTpNTa [0..1]  # The following parameters need to be configured for each RxNsdu or TxNsdu with the CanTpAddressingFormat set to CanTpExtended.
        integer CanTpNTa: origin=AUTOSAR_ECUC V1.0.0  # If an RxNsdu or a TxNsdu is configured for extended addressing format, this parameter contains the transport protocol target address's value.
      container CanTpRxFcNPdu  # Used for grouping of the ID of a PDU and the Reference to a PDU.
        integer CanTpRxFcNPduId: 0.., origin=AUTOSAR_ECUC V1.1.0, symbolic-name-value=true  # N-PDU identifier attached to the FC N-PDU of this TxNsdu identified by CanTpTxNSduId. Each TxNsdu identifier is linked to one Rx FC N-PDU identifier only. However, in the case of extended addressing format, the same FC N-PDU identifier can be used for several N-SDU identifiers. The distinction is made by means of the N_TA value (first data byte of FC frames).
        reference def CanTpRxFcNPduRef: lower-multiplicity=1, upper-multiplicity=1, origin=AUTOSAR_ECUC V1.1.0, destination=Pdu  # Reference to a Pdu in the COM-Stack.
      container CanTpTxNPdu  # Used for grouping of the ID of a PDU and the Reference to a PDU.
        integer CanTpTxNPduId: 0.., origin=AUTOSAR_ECUC V1.1.0  # N-PDU identifier attached to the TxNdsu identified by CanTpTxNSduId. Each TxNsdu identifier is linked to one SF/FF/CF N-PDU identifier only. However, in the case of extended addressing format, the same N-PDU identifier can be used for several N-SDU identifiers. The distinction is made by means of the N_TA value (first data byte of SF or FF frames).
        reference def CanTpTxNPduRef: lower-multiplicity=1, upper-multiplicity=1, origin=AUTOSAR_ECUC V1.1.0, destination=Pdu  # Reference to a Pdu in the COM-Stack.
    container CommonPublishedInformation  # Common container, aggregated by all modules. It contains published information about vendor and versions.
      integer ArMajorVersion: implementation-config-class=PUBLISHED-INFORMATION, origin=AUTOSAR_ECUC V1.0.0  # Major version number of AUTOSAR specification on which the appropriate implementation is based on.
      integer ArMinorVersion: implementation-config-class=PUBLISHED-INFORMATION, origin=AUTOSAR_ECUC V1.0.0  # Minor version number of AUTOSAR specification on which the appropriate implementation is based on.
      integer ArPatchVersion: implementation-config-class=PUBLISHED-INFORMATION, origin=AUTOSAR_ECUC V1.0.0  # Patch level version number of AUTOSAR specification on which the appropriate implementation is based on.
      integer ModuleId: implementation-config-class=PUBLISHED-INFORMATION, origin=AUTOSAR_ECUC V1.0.0  # Module ID of this module from Module List
      integer SwMajorVersion: implementation-config-class=PUBLISHED-INFORMATION, origin=AUTOSAR_ECUC V1.0.0  # Major version number of the vendor specific implementation of the module. The numbering is vendor specific.
      integer SwMinorVersion: implementation-config-class=PUBLISHED-INFORMATION, origin=AUTOSAR_ECUC V1.0.0  # Minor version number of the vendor specific implementation of the module. The numbering is vendor specific.
      integer SwPatchVersion: implementation-config-class=PUBLISHED-INFORMATION, origin=AUTOSAR_ECUC V1.0.0  # Patch level version number of the vendor specific implementation of the module. The numbering is vendor specific.
      string VendorApiInfix [0..1]: implementation-config-class=PUBLISHED-INFORMATION, origin=AUTOSAR_ECUC V1.0.0  # In driver modules which can be instantiated several times on a single ECU, BSW00347 requires that the name of APIs is extended by the VendorId and a vendor specific name. This parameter is used to specify the vendor specific name. In total, the implementation specific name is generated as follows: <ModuleName>_>VendorId>_<VendorApiInfix><Api name from SWS>. E.g. assuming that the VendorId of the implementor is 123 and the implementer chose a VendorApiInfix of "v11r456" a api name Can_Write defined in the SWS will translate to Can_123_v11r456Write. This parameter is mandatory for all modules with upper multiplicity > 1. It shall not be used for modules with upper multiplicity =1.
      integer VendorId: implementation-config-class=PUBLISHED-INFORMATION, origin=AUTOSAR_ECUC V1.0.0  # Vendor ID of the dedicated implementation of this module according to the AUTOSAR vendor list
  module definition CanTrcv [0..*]  # Configuration of the CanTrcv (CAN Transceiver driver) module.
    container CanTrcvChannel [1..*]  # Container gives CAN transceiver driver information about a single CAN transceiver channel. Any CAN transceiver driver has such CAN transceiver channels.
      boolean CanTrcvChannelUsed: origin=AUTOSAR_ECUC V1.1.0, default-value=true  # Shall the related CAN transceiver channel be used?
      boolean CanTrcvControlsPowerSupply: origin=AUTOSAR_ECUC V1.1.0, default-value=false  # Is ECU power supply controlled by this transceiver? TRUE = Controlled by transceiver. FALSE = Not controlled by transceiver.
      enumeration CanTrcvInitState: {CanTrcvOpModeNormal, CanTrcvOpModeSleep, CanTrcvOpModeStandby}, origin=AUTOSAR_ECUC V1.1.0, default-value=CanTrcvOpModeNormal  # State of CAN transceiver after call to CanTrcv_Init.
      integer CanTrcvMaxBaudrate: 0..1000, origin=AUTOSAR_ECUC V1.1.0  # Max baudrate for transceiver hardware type. Only used for validation purposes. Value shall be configured by configuration tool based on transceiver hardware type.
      boolean CanTrcvWakeupByBusUsed: origin=AUTOSAR_ECUC V1.1.0, default-value=false  # Is wake up by bus supported? If CAN transceiver hardware does not support wake up by bus value is always FALSE. If CAN transceiver hardware supports wake up by bus value is TRUE or FALSE depending whether it is used or not. TRUE = Is used. FALSE = Is not used.
      symbolic name reference CanTrcvCanIfNetwork: origin=AUTOSAR_ECUC V1.1.0, destination=CanIfNetworkConfig  # Unique network number. It is used by ComM by Icu and internally. Reference to a CanIf configuration item CANIF_NETWORK.
      choice container CanTrcvAccess [1..*]
        container CanTrcvDioAccess [0..1]  # Container gives CAN transceiver driver information about accessing ports and port pins. In addition relation between CAN transceiver hardware pin names and Dio port access information is given. If a CAN transceiver hardware has no Dio interface, there is no instance of this container.
          string CanTrcvHardwareInterfaceName: origin=AUTOSAR_ECUC V1.0.0  # CAN transceiver hardware interface name. It is typically the name of a pin. From a Dio point of view it is either a port, a single channel or a channel group. Depending on this fact either CANTRCV_DIO_PORT_SYMBOLIC_NAME or CANTRCV_DIO_CHANNEL_SYMBOLIC_NAME or CANTRCV_DIO_CHANNEL_GROUP_SYMBOLIC_NAME shall reference a Dio configuration. The CAN transceiver driver implementation description shall list up this name for the appropriate CAN transceiver hardware.
          choice reference CanTrcvDioSymNameRef: origin=AUTOSAR_ECUC V1.1.0, destination=[DioChannel, DioPort, DioChannelGroup]  # Choice Reference to a DIO Port, DIO Channel or DIO Channel Group. This reference replaces the CANTRCV_DIO_PORT_SYM_NAME, CANTRCV_DIO_CHANNEL_SYM_NAME and CANTRCV_DIO_GROUP_SYM_NAME references in the Can Trcv SWS.
        container CanTrcvSpiSequence [0..1]  # Container gives CAN transceiver driver information about one SPI sequence. One SPI sequence used by CAN transceiver driver is in exclusive use for it. No other driver is allowed to access this sequence. CAN transceiver driver may use one sequence to access n CAN transceiver hardwares chips of the same type or n sequences are used to access one single CAN transceiver hardware chip. If a CAN transceiver hardware has no SPI interface, there is no instance of this container.
          symbolic name reference CanTrcvSpiSequenceName: origin=AUTOSAR_ECUC V1.0.0, destination=SpiSequence  # Reference to a Spi sequence configuration container.
    container CanTrcvGeneral  # Container gives CAN transceiver driver basic information.
      boolean CanTrcvDevErrorDetect: origin=AUTOSAR_ECUC V1.0.0  # Switches development error detection and notification on and off. If switched on, #define CANTRCV_DEV _ERROR_DETECT ON shall be generated. If switched off, #define CANTRCV_DEV_ERROR _DETECT OFF shall be generated. Define shall be part of file CanTrcv_Cfg.h.
      boolean CanTrcvGetVersionInfo: origin=AUTOSAR_ECUC V1.1.0, default-value=false  # Switches version information API on and off. If switched off, function need not be present in compiled code.
      enumeration CanTrcvWakeUpSupport: {CanTrcvWakeUpByIsr, CanTrcvWakeUpByPolling, CanTrcvWakeUpNotSupported}, origin=AUTOSAR_ECUC V1.1.0  # Informs whether wake up is supported by ISR, by polling or whether it is not supported. In case no wake up is supported by CAN transceiver hardware setting has to be always NO. Only in case wake up is supported by polling main function CanTrcv_main has to be present in source code and called by CanIf. Only in case wake up is supported by ISR callback function CanTrcv_CB_WakeupByBus has to be present in source code. In case of support for wake up either by ISR or by polling wake up ability may be switched on or off for each channel of one CAN transceiver channel independently by CanTrcvWakeupByBusUsed.
    container CommonPublishedInformation  # Common container, aggregated by all modules. It contains published information about vendor and versions.
      integer ArMajorVersion: implementation-config-class=PUBLISHED-INFORMATION, origin=AUTOSAR_ECUC V1.0.0  # Major version number of AUTOSAR specification on which the appropriate implementation is based on.
      integer ArMinorVersion: implementation-config-class=PUBLISHED-INFORMATION, origin=AUTOSAR_ECUC V1.0.0  # Minor version number of AUTOSAR specification on which the appropriate implementation is based on.
      integer ArPatchVersion: implementation-config-class=PUBLISHED-INFORMATION, origin=AUTOSAR_ECUC V1.0.0  # Patch level version number of AUTOSAR specification on which the appropriate implementation is based on.
      integer ModuleId: implementation-config-class=PUBLISHED-INFORMATION, origin=AUTOSAR_ECUC V1.0.0  # Module ID of this module from Module List
      integer SwMajorVersion: implementation-config-class=PUBLISHED-INFORMATION, origin=AUTOSAR_ECUC V1.0.0  # Major version number of the vendor specific implementation of the module. The numbering is vendor specific.
      integer SwMinorVersion: implementation-config-class=PUBLISHED-INFORMATION, origin=AUTOSAR_ECUC V1.0.0  # Minor version number of the vendor specific implementation of the module. The numbering is vendor specific.
      integer SwPatchVersion: implementation-config-class=PUBLISHED-INFORMATION, origin=AUTOSAR_ECUC V1.0.0  # Patch level version number of the vendor specific implementation of the module. The numbering is vendor specific.
      string VendorApiInfix [0..1]: implementation-config-class=PUBLISHED-INFORMATION, origin=AUTOSAR_ECUC V1.0.0  # In driver modules which can be instantiated several times on a single ECU, BSW00347 requires that the name of APIs is extended by the VendorId and a vendor specific name. This parameter is used to specify the vendor specific name. In total, the implementation specific name is generated as follows: <ModuleName>_>VendorId>_<VendorApiInfix><Api name from SWS>. E.g. assuming that the VendorId of the implementor is 123 and the implementer chose a VendorApiInfix of "v11r456" a api name Can_Write defined in the SWS will translate to Can_123_v11r456Write. This parameter is mandatory for all modules with upper multiplicity > 1. It shall not be used for modules with upper multiplicity =1.
      integer VendorId: implementation-config-class=PUBLISHED-INFORMATION, origin=AUTOSAR_ECUC V1.0.0  # Vendor ID of the dedicated implementation of this module according to the AUTOSAR vendor list
  module definition Com [0..1]  # Configuration of the Com module.
    container ComGeneral  # Contains the general configuration parameters of the Com module.
      integer ComConfigurationId: origin=AUTOSAR_ECUC V1.0.0  # This ID is returned by a call to Com_GetConfigurationId().
      float ComConfigurationTimeBase: origin=AUTOSAR_ECUC V1.0.0  # The period between successive calls to the Main Functions (Rx, Tx, Routing) of AUTOSAR COM in seconds.
      boolean ComConfigurationUseDet: origin=AUTOSAR_ECUC V1.0.0  # The error hook shall contain code to call the Det. If this parameter is configured COM_DEV_ERROR_DETECT shall be set to ON as output of the configuration tool. (as input for the source code).
      boolean ComVersionInfoApi: origin=AUTOSAR_ECUC V1.0.0  # Activate/Deactivate the version information API (see Com specification chapter 8.3.1.9).
    container ComIPdu [0..*]  # Contains the configuration parameters of Com I-Pdus. The shortName is used as the symbolic name (COM_IPDU_NAME) of this I-Pdu when communicating with the PduR. Is optional because the Com module might be used for internal communication only. This parameter is only stored in the XML file, and must not be used within the implementation.
      function name ComIPduCallout [0..1]: origin=AUTOSAR_ECUC V1.0.0  # If there is a callout defined for this I-PDU this parameter contains the name of the callout function..
      enumeration ComIPduDirection: {Received, Sent}, origin=AUTOSAR_ECUC V1.0.0  # Indicates if this I-PDU is sent by AUTOSAR COM or received by AUTOSAR COM.
      integer ComIPduMinimumDelayFactor: origin=AUTOSAR_ECUC V1.0.0  # Minimum delay between successive transmissions of this I-PDU, independent of the TRANSMISSION MODE. Although this value is of size uint32 certain implementations may only use 16 bit counters and, therefore, some values may not always be possible. There is only one minimum delay time parameter for the I-PDU. This minimum delay time does not change with mode changes. Neither is the timer reset. This means that mode changes are not allowed to violate the minimum delay time. It is not possible to monitor the MINIMUMDELAYTIME for I-PDUs that are requested using the Com_TriggerTransmit() API.
      integer ComIPduSize: origin=AUTOSAR_ECUC V1.0.0  # The size of the I-PDU in bits. In AUTOSAR currently this is limited to 64 bits.
      integer ComIPduUnusedAreasDefault: origin=AUTOSAR_ECUC V1.0.0  # AUTOSAR COM fills not used areas of an I-PDU with this bit-pattern. This attribute is mandatory to avoid undefined behaviour.This byte-pattern will be repeated throughout the I-PDU.
      integer ComRxIPduHandleId [0..1]: origin=AUTOSAR_ECUC V1.0.0, symbolic-name-value=true  # The numerical value used as the ID of this I-PDU. The Com_IPduHandleId is required by the API calls to receive I-PDUs from the PduR. It is only present for I-PDU is received from the PduR, because Com is the starting module for Tx I-PDUs and there is no need to define IDs for Tx I-PDUs in the Com module.
      enumeration ComSignalProcessing [0..1]: {Deferred, Immediate}, origin=AUTOSAR_ECUC V1.0.0  # For the definition of the two modes Immidiate and deffered, see COM298.
      reference def ComIPduGroupRef: lower-multiplicity=0, upper-multiplicity=1, origin=AUTOSAR_ECUC V1.0.0, destination=ComIPduGroup  # If the I-PDU belongs to an I-PDU group, this is the reference to the IPDUGROUP. If the I-PDU does not belong to any I-PDU group, the reference does not exists.
      reference def PduIdRef: lower-multiplicity=1, upper-multiplicity=1, origin=AUTOSAR_ECUC V1.0.0, destination=Pdu  # Reference to the "global" Pdu structure to allow harmonization of handle IDs in the COM-Stack.
      container ComTransmissionModeFalse [0..1]  # This container contains the configuration parameters of COM Transmission Modes in the case the COM_FILTER evaluates to false.
        container ComTxMode  # This container contains the configuration parameters of COM Transmission Modes.
          enumeration ComTxModeMode: {Direct, Mixed, None, Periodic}, origin=AUTOSAR_ECUC V1.0.0  # The available TRANSMISSION MODEs described in [STD_OSEK_OIL] shall be extended by the additional mode "none". The TRANSMISSION MODE "none" shall not have any further sub-attributes in the TRANSMISSIONMODE object.
          integer ComTxModeNumberOfRepetitions [0..1]: origin=AUTOSAR_ECUC V1.0.0, default-value=1  # Defines the number of repetitions for the TRANSMISSION MODE "direct/n-times" and the event driven part of "mixed". Default for this parameter shall be 1.
          integer ComTxModeRepetitionPeriodFactor [0..1]: origin=AUTOSAR_ECUC V1.0.0  # Period of the repetition of the n transmission for the TRANSMISSION MODE "direct/n-times" and the event driven part of "mixed". Although this value is specified as a uint32 certain implementations may only use 16 bit counters. Therefore the range is ECU and implementation dependant.
          integer ComTxModeTimeOffsetFactor [0..1]: origin=AUTOSAR_ECUC V1.0.0  # Time until first transmission of this I-PDU. Although this value is specified as a uint32 certain implementations may only use 16 bit counters and, therefore, some values may not always be possible. When REPETITION is 0, TIMEOFFSET is the time between Com_IpduGroupStart() and the first transmission request for the IPDU. When REPETITION is >0 then TIMEOFFSET is ignored.
          integer ComTxModeTimePeriodFactor [0..1]: origin=AUTOSAR_ECUC V1.0.0  # Period of the repetition of cyclic transmissions. Although this value is specified as a uint32 certain implementations may only use 16 bit counters. Therefore the range is ECU and implementation dependant.
      container ComTransmissionModeTrue [0..1]  # This container contains the configuration parameters of COM Transmission Modes in the case the COM_FILTER evaluates to true.
        container ComTxMode  # This container contains the configuration parameters of COM Transmission Modes.
          enumeration ComTxModeMode: {Direct, Mixed, None, Periodic}, origin=AUTOSAR_ECUC V1.0.0  # The available TRANSMISSION MODEs described in [STD_OSEK_OIL] shall be extended by the additional mode "none". The TRANSMISSION MODE "none" shall not have any further sub-attributes in the TRANSMISSIONMODE object.
          integer ComTxModeNumberOfRepetitions [0..1]: origin=AUTOSAR_ECUC V1.0.0, default-value=1  # Defines the number of repetitions for the TRANSMISSION MODE "direct/n-times" and the event driven part of "mixed". Default for this parameter shall be 1.
          integer ComTxModeRepetitionPeriodFactor [0..1]: origin=AUTOSAR_ECUC V1.0.0  # Period of the repetition of the n transmission for the TRANSMISSION MODE "direct/n-times" and the event driven part of "mixed". Although this value is specified as a uint32 certain implementations may only use 16 bit counters. Therefore the range is ECU and implementation dependant.
          integer ComTxModeTimeOffsetFactor [0..1]: origin=AUTOSAR_ECUC V1.0.0  # Time until first transmission of this I-PDU. Although this value is specified as a uint32 certain implementations may only use 16 bit counters and, therefore, some values may not always be possible. When REPETITION is 0, TIMEOFFSET is the time between Com_IpduGroupStart() and the first transmission request for the IPDU. When REPETITION is >0 then TIMEOFFSET is ignored.
          integer ComTxModeTimePeriodFactor [0..1]: origin=AUTOSAR_ECUC V1.0.0  # Period of the repetition of cyclic transmissions. Although this value is specified as a uint32 certain implementations may only use 16 bit counters. Therefore the range is ECU and implementation dependant.
    container ComIPduGroup [0..*]  # Contains the configuration parameters of Com I-Pdu groups. The shortName is used as the symbolic name of the I-Pdu group (COM_IPDU_GROUP_NAME). This parameter is only stored in the XML file, and must not be used within the implementation. The minimum is 2 because we expect that the ComM addresses one RX-group and one TX-group to implement normal and listen only mode. Since a group can only have send or receive I-PDUs you could theoretically have just one group if you only send or receive I-PDUs. But we expected that this would cause problems with the ComM. Therefore the minimum was set to 2. (Bug#11347).
      integer ComIPduGroupHandleId: origin=AUTOSAR_ECUC V1.0.0, symbolic-name-value=true  # The numerical value used as the ID of this I-PDU Group . The ComIPduGroupHandleId is required by the API calls to start and stop I-PDU Groups.
      reference def ComIPduGroupGroupRef: lower-multiplicity=0, upper-multiplicity=*, origin=AUTOSAR_ECUC V1.0.0, destination=ComIPduGroup  # If the I-PDU Group belongs to an I-PDU group, this is the NAME of the IPDUGROUP it belongs to. If the I-PDU Group does not belong to another I-PDU group, the string is empty.
    container ComNetworkSignal [0..*]  # Contains the configuration parameters of Com network signals. The shortName of this container holds the "COM_NETWORK_SIGNAL_NAME" [COM156]. The symbolic name of the network signal. This parameter is only stored in the XML file, and must not be used within the implementation.
      integer ComNetworkSignalBitPosition: origin=AUTOSAR_ECUC V1.0.0  # Starting position in the I-PDU of the network signal. If the network signal refers to a signal inside a signal group, this parameter still refers to the position in the I-PDU and not in the shadow buffer.
      enumeration ComNetworkSignalDirection: {Received, Sent}, origin=AUTOSAR_ECUC V1.0.0  # Describes whether this is a received or a sent network signal.
      enumeration ComNetworkSignalEndianess: {BigEndian, LittleEndian, Opaque}, origin=AUTOSAR_ECUC V1.0.0  # Defines the endianness of the network signal.
      integer ComNetworkSignalFirstTimeoutFact: origin=AUTOSAR_ECUC V1.0.0  # Defines the first timeout period for the deadline monitoring. Details can be found in [STD_OSEK_COM]. Note:See also COM263 for the configuration of the remaining timeout periods. Although this value is of size uint32 certain implementations may only use 16 bit counters and, therefore, some values may not always be possible.
      integer ComNetworkSignalSize: origin=AUTOSAR_ECUC V1.0.0  # Size of the network signal in bits.
      integer ComNetworkSignalTimeoutFact: origin=AUTOSAR_ECUC V1.0.0  # Defines the timeout period for the deadline monitoring. Details can be found in [STD_OSEK_COM]. Note: The period for the first timeout could differ from the TIMEOUTAlthough this value is specified as a uint32 certain implementations may only use 16 bit counters and, therefore, some values may not always be possible. COM264: If deadline monitoring is used on a signal with an update bit this defines the timeout for deadline monitoring. COM333: If the timeout is configured to 0 than no timeout monitoring shall take place
      reference def ComNetworkSignalIPduRef: lower-multiplicity=1, upper-multiplicity=1, origin=AUTOSAR_ECUC V1.0.0, destination=ComIPdu  # Reference to the I-PDU that contains this signal or signal group.
      container ComUpdate [0..1]  # This container contains the configuration parameters of COM Update items.
        integer ComUpdateBitPosition: origin=AUTOSAR_ECUC V1.0.0  # Bit position of update bit inside I-PDU. COM258: If this signal is part of a signal group the signal must have no update bit. This setting must be consistently on sender and on receiver side. If this attribute is omitted then there is no update bit.
    container ComSignal [1..*]  # Contains the configuration parameters of Com signals. The shortName is used as the symbolic name of the signal (COM_SIGNAL_NAME). This name is also used as the handle name for the signal. This parameter is only stored in the XML file, and must not be used within the implementation.
      integer ComSignalHandleId: origin=AUTOSAR_ECUC V1.0.0, symbolic-name-value=true  # The numerical value used as the ID of this signal . The ComSignalHandleId is required by the API calls to send and receive signals.
      integer ComSignalInitValue [0..1]: origin=AUTOSAR_ECUC V1.0.0, default-value=0  # Initial value for this signal. Default value is 0.
      integer ComSignalLength: origin=AUTOSAR_ECUC V1.0.0  # The COM_SIGNAL_LENGTH specifies the length of the signal in Bytes. This is necessary specially for the type UINT8[n], where it specifies "n", but also for the other types it has to be filled in.
      enumeration ComSignalProperty: {ReceiveUnqueuedExternal, ReceiveUnqueuedInternal, SendStaticExternal, SendStaticInternal}, origin=AUTOSAR_ECUC V1.0.0  # Signal property definition according to section MESSAGEPROPERTY name 3.2.10.1 in the [STD_OSEK_OIL] specification.
      enumeration ComSignalTransferProperty [0..1]: {Pending, Triggered}, origin=AUTOSAR_ECUC V1.0.0  # Derived from [STD_OSEK_OIL].
      enumeration ComSignalType: {Boolean, SInt16, SInt32, SInt8, UInt16, UInt32, UInt8, UInt8_n}, origin=AUTOSAR_ECUC V1.0.0  # The AUTOSAR type of the signal. Whether or not the signal is signed or unsigned can be found by examining the value of this attribute. This type could also be used to reserved appropriate storage in AUTOSAR COM.
      reference def ComSignalGroupRef: lower-multiplicity=0, upper-multiplicity=1, origin=AUTOSAR_ECUC V1.0.0, destination=ComSignalGroup  # If the signal belongs to a signal group, this is the reference to the containing signal group. If the signal does not belong to any signal group, the parameter shall not appear.
      reference def ComSignalNetworkSignalRef: lower-multiplicity=0, upper-multiplicity=1, origin=AUTOSAR_ECUC V1.0.0, destination=ComNetworkSignal  # If this signal is sent over a network this attribute is the reference to the matching network signal.
      container ComFilter  # This container contains the configuration parameters of COM Filters.
        enumeration ComFilterAlgorithm: {Always, MaskedNewDiffersMaskedOld, MaskedNewDiffersX, MaskedNewEqualsMaskedOld, MaskedNewEqualsX, Never, NewIsDifferent, NewIsEqual, NewIsGreater, NewIsGreaterOrEqual, NewIsLess, NewIsLessOrEqual, NewIsOutside, NewIsWithin, OneEveryN}, origin=AUTOSAR_ECUC V1.0.0  # The range of values is specified in the [STD_OSEK_COM] specification, chapter 2.2.2, Reception Filtering.
        integer ComFilterMask [0..1]: origin=AUTOSAR_ECUC V1.0.0  # The name of this attribute corresponds to the parameter name in the [STD_OSEK_COM] specification of Reception Filtering. Only the least significant 32 bits are significant.
        integer ComFilterMax [0..1]: origin=AUTOSAR_ECUC V1.0.0  # The name of this attribute corresponds to the parameter name in the [STD_OSEK_COM] specification of Reception Filtering. Only the least significant 32 bits are significant.
        integer ComFilterMin [0..1]: origin=AUTOSAR_ECUC V1.0.0  # The name of this attribute corresponds to the parameter name in the [STD_OSEK_COM] specification of Reception Filtering. Only the least significant 32 bits are significant.
        integer ComFilterOffset [0..1]: origin=AUTOSAR_ECUC V1.0.0  # The name of this attribute corresponds to the parameter name in the [STD_OSEK_COM] specification of Reception Filtering. Only the least significant 32 bits are significant.
        integer ComFilterPeriodFactor [0..1]: origin=AUTOSAR_ECUC V1.0.0  # The name of this attribute corresponds to the parameter name in the [STD_OSEK_COM] specification of Reception Filtering. Only the least significant 32 are significant.
        integer ComFilterX [0..1]: origin=AUTOSAR_ECUC V1.0.0  # The name of this attribute corresponds to the parameter name in the [STD_OSEK_COM] specification of Reception Filtering. Only the least significant 32 bits are significant.
      container ComNotificationError [0..1]  # Contains the configuration parameters of Com notifications in the case a notification for an error has to be done.
        container ComNotification  # Contains the configuration parameters of Com notifications.
          function name ComNotificationName [0..1]: origin=AUTOSAR_ECUC V1.0.0  # If ComNotificationType is ComCallback then this is the name of a callback function.
          enumeration ComNotificationType: {ComCallback, None}, origin=AUTOSAR_ECUC V1.0.0  # Type of notification provided to RTE. Note that FLAG, ACTIVATETASK and SETEVENT, although present in OIL, have been omitted as they are not used in AUTOSAR RTE.
      container ComNotificationSignal [0..1]  # Contains the configuration parameters of Com notifications in the case a notification for a signal has to be done.
        container ComNotification  # Contains the configuration parameters of Com notifications.
          function name ComNotificationName [0..1]: origin=AUTOSAR_ECUC V1.0.0  # If ComNotificationType is ComCallback then this is the name of a callback function.
          enumeration ComNotificationType: {ComCallback, None}, origin=AUTOSAR_ECUC V1.0.0  # Type of notification provided to RTE. Note that FLAG, ACTIVATETASK and SETEVENT, although present in OIL, have been omitted as they are not used in AUTOSAR RTE.
      container ComRxDataInvalid [0..1]  # Contains the configuration parameters of Com data invalid items. This container is used for reception of signals.
        enumeration ComRxDataInvalidAction [0..1]: {Notify, Replace}, origin=AUTOSAR_ECUC V1.0.0  # This parameter defines the action performed upon reception of an invalid signal. If Replace is used the initValue will be used for the replacement.
        function name ComRxDataInvalidIndicationFunc [0..1]: origin=AUTOSAR_ECUC V1.0.0  # Name of the function which notifies the RTE about the reception of an invalidated signal. Only applicable if COM_DATA_INVALID_ACTION = Notify
        integer ComRxDataInvalidValue [0..1]: origin=AUTOSAR_ECUC V1.0.0  # When this value is received it is recognized as the invalid value and the appropriate invalid action (as specified by COM_DATA_INVALID_ACTION) is performed.
      container ComRxDataTimeoutSub [0..1]  # Contains the configuration parameters of Com data substitution items if an Rx timeout violation occurs. This container is used only for reception of signals.
        enumeration ComRxDataTimeoutSubAction: {None, Replace}, origin=AUTOSAR_ECUC V1.0.0  # This parameter defines the action performed upon a reception timeout violation.
        integer ComRxDataTimeoutSubValue: origin=AUTOSAR_ECUC V1.0.0  # When the reception deadline monitoring timeout is violated the value of the related signal is according to the ComRxDataTimeoutSubstitutionAction substituted by this value.
      container ComSignalInternalDest [0..1]  # Reference to a signal/signal group as internal destination.
        choice reference ComSignalInternalDestRef: origin=AUTOSAR_ECUC V1.0.0, destination=[ComSignalGroup, ComSignal]  # Name of a signal or signal group, which is internal destination of the signal or signal group.
      container ComSignalRouteDest [0..*]  # Reference to a signal as destination of a signal gateway relation.
        choice reference ComSignalRouteDestRef: origin=AUTOSAR_ECUC V1.0.0, destination=[ComSignal, ComSignalGroup]  # Name of a signal or signal group, which is destination of signal gateway relation.
      container ComTxDataInvalid [0..1]  # Contains the configuration parameters of Com data invalid items. This container is used for transmission of signals.
        integer ComTxDataInvalidValue: origin=AUTOSAR_ECUC V1.0.0  # The value will be set on sender side by a Com_InvalidateSignal() and Com_InvalidateShadowSignal() call.
    container ComSignalGroup [0..*]  # Contains the configuration parameters of Com signal groups. The shortName is used as the symbolic name of the signal group (COM_SIGNAL_GROUP_NAME). This name is also used as the handle name for the signal group. This parameter is only stored in the XML file, and must not be used within the implementation.
      integer ComSignalGroupHandleId: origin=AUTOSAR_ECUC V1.0.0, symbolic-name-value=true  # The numerical value used as the ID of this signal group. The Com_SignalGroupHandleId is required by the Com_SendSignalGroup() and Com_ReceiveSignalGroup() calls.
      enumeration ComSignalGroupProperty: {ReceiveUnqueuedExternal, ReceiveUnqueuedInternal, SendStaticExternal, SendStaticInternal}, origin=AUTOSAR_ECUC V1.0.0  # Signal property definition according to section MESSAGEPROPERTY name 3.2.10.1 in the [STD_OSEK_OIL] specification.
      enumeration ComSignalGroupTransferProperty [0..1]: {Pending, Triggered}, origin=AUTOSAR_ECUC V1.0.0  # Derived from [STD_OSEK_OIL].
      reference def ComSignalGroupNetworkSignalRef: lower-multiplicity=0, upper-multiplicity=1, origin=AUTOSAR_ECUC V1.0.0, destination=ComNetworkSignal  # Network signal that contains this signal group.
      container ComNotificationError [0..1]  # Contains the configuration parameters of Com notifications in the case a notification for an error has to be done.
        container ComNotification  # Contains the configuration parameters of Com notifications.
          function name ComNotificationName [0..1]: origin=AUTOSAR_ECUC V1.0.0  # If ComNotificationType is ComCallback then this is the name of a callback function.
          enumeration ComNotificationType: {ComCallback, None}, origin=AUTOSAR_ECUC V1.0.0  # Type of notification provided to RTE. Note that FLAG, ACTIVATETASK and SETEVENT, although present in OIL, have been omitted as they are not used in AUTOSAR RTE.
      container ComNotificationSignal [0..1]  # Contains the configuration parameters of Com notifications in the case a notification for a signal has to be done.
        container ComNotification  # Contains the configuration parameters of Com notifications.
          function name ComNotificationName [0..1]: origin=AUTOSAR_ECUC V1.0.0  # If ComNotificationType is ComCallback then this is the name of a callback function.
          enumeration ComNotificationType: {ComCallback, None}, origin=AUTOSAR_ECUC V1.0.0  # Type of notification provided to RTE. Note that FLAG, ACTIVATETASK and SETEVENT, although present in OIL, have been omitted as they are not used in AUTOSAR RTE.
      container ComRxDataInvalid [0..1]  # Contains the configuration parameters of Com data invalid items. This container is used for reception of signals.
        enumeration ComRxDataInvalidAction [0..1]: {Notify, Replace}, origin=AUTOSAR_ECUC V1.0.0  # This parameter defines the action performed upon reception of an invalid signal. If Replace is used the initValue will be used for the replacement.
        function name ComRxDataInvalidIndicationFunc [0..1]: origin=AUTOSAR_ECUC V1.0.0  # Name of the function which notifies the RTE about the reception of an invalidated signal. Only applicable if COM_DATA_INVALID_ACTION = Notify
        integer ComRxDataInvalidValue [0..1]: origin=AUTOSAR_ECUC V1.0.0  # When this value is received it is recognized as the invalid value and the appropriate invalid action (as specified by COM_DATA_INVALID_ACTION) is performed.
      container ComRxDataTimeoutSub [0..1]  # Contains the configuration parameters of Com data substitution items if an Rx timeout violation occurs. This container is used only for reception of signals.
        enumeration ComRxDataTimeoutSubAction: {None, Replace}, origin=AUTOSAR_ECUC V1.0.0  # This parameter defines the action performed upon a reception timeout violation.
        integer ComRxDataTimeoutSubValue: origin=AUTOSAR_ECUC V1.0.0  # When the reception deadline monitoring timeout is violated the value of the related signal is according to the ComRxDataTimeoutSubstitutionAction substituted by this value.
      container ComSignalInternalDest [0..1]  # Reference to a signal/signal group as internal destination.
        choice reference ComSignalInternalDestRef: origin=AUTOSAR_ECUC V1.0.0, destination=[ComSignalGroup, ComSignal]  # Name of a signal or signal group, which is internal destination of the signal or signal group.
      container ComSignalRouteDest [0..*]  # Reference to a signal as destination of a signal gateway relation.
        choice reference ComSignalRouteDestRef: origin=AUTOSAR_ECUC V1.0.0, destination=[ComSignal, ComSignalGroup]  # Name of a signal or signal group, which is destination of signal gateway relation.
    container CommonPublishedInformation  # Common container, aggregated by all modules. It contains published information about vendor and versions.
      integer ArMajorVersion: implementation-config-class=PUBLISHED-INFORMATION, origin=AUTOSAR_ECUC V1.0.0  # Major version number of AUTOSAR specification on which the appropriate implementation is based on.
      integer ArMinorVersion: implementation-config-class=PUBLISHED-INFORMATION, origin=AUTOSAR_ECUC V1.0.0  # Minor version number of AUTOSAR specification on which the appropriate implementation is based on.
      integer ArPatchVersion: implementation-config-class=PUBLISHED-INFORMATION, origin=AUTOSAR_ECUC V1.0.0  # Patch level version number of AUTOSAR specification on which the appropriate implementation is based on.
      integer ModuleId: implementation-config-class=PUBLISHED-INFORMATION, origin=AUTOSAR_ECUC V1.0.0  # Module ID of this module from Module List
      integer SwMajorVersion: implementation-config-class=PUBLISHED-INFORMATION, origin=AUTOSAR_ECUC V1.0.0  # Major version number of the vendor specific implementation of the module. The numbering is vendor specific.
      integer SwMinorVersion: implementation-config-class=PUBLISHED-INFORMATION, origin=AUTOSAR_ECUC V1.0.0  # Minor version number of the vendor specific implementation of the module. The numbering is vendor specific.
      integer SwPatchVersion: implementation-config-class=PUBLISHED-INFORMATION, origin=AUTOSAR_ECUC V1.0.0  # Patch level version number of the vendor specific implementation of the module. The numbering is vendor specific.
      string VendorApiInfix [0..1]: implementation-config-class=PUBLISHED-INFORMATION, origin=AUTOSAR_ECUC V1.0.0  # In driver modules which can be instantiated several times on a single ECU, BSW00347 requires that the name of APIs is extended by the VendorId and a vendor specific name. This parameter is used to specify the vendor specific name. In total, the implementation specific name is generated as follows: <ModuleName>_>VendorId>_<VendorApiInfix><Api name from SWS>. E.g. assuming that the VendorId of the implementor is 123 and the implementer chose a VendorApiInfix of "v11r456" a api name Can_Write defined in the SWS will translate to Can_123_v11r456Write. This parameter is mandatory for all modules with upper multiplicity > 1. It shall not be used for modules with upper multiplicity =1.
      integer VendorId: implementation-config-class=PUBLISHED-INFORMATION, origin=AUTOSAR_ECUC V1.0.0  # Vendor ID of the dedicated implementation of this module according to the AUTOSAR vendor list
  module definition ComM [0..1]  # Configuration of the ComM (Communications Manager) module.
    container ComMChannel [1..*]  # This container contains the configuration (parameters) of the bus channel(s). The channel parameters shall be harmonized within the whole communication stack.
      enumeration ComMBusType: {ComMBusTypeCan, ComMBusTypeFr, ComMBusTypeInternal, ComMBusTypeLin}, origin=AUTOSAR_ECUC V1.1.0
      float ComMBusoffLatencyL1: 0.001..65, origin=AUTOSAR_ECUC V1.0.0, default-value=1  # Time in seconds between a bus off indication and a reconnect attempt or two reconnect attempts during level 1.
      float ComMBusoffLatencyL2: 0.001..65, origin=AUTOSAR_ECUC V1.0.0, default-value=3  # Time in seconds between two reconnect attempts during level 2.
      integer ComMChannelId: 0..255, origin=AUTOSAR_ECUC V1.0.0, symbolic-name-value=true  # Channel identification number of the corresponding channel. Shall be harmonized with channel IDs of networkmanagement and the bus interfaces.
      float ComMMainFunctionPeriod: 0.004..0.1, origin=AUTOSAR_ECUC V1.0.0, default-value=0.020  # Specifies the period the MainFunction has to be triggered in seconds. Comment: ComM scheduling shall be at lest as fast as the communication stack and a schedule longer then 100ms makes no sense for communication.
      boolean ComMNoCom: origin=AUTOSAR_ECUC V1.0.0, default-value=false  # Defines if a ECU is not allowed to change state of the channel to "Silent Communication" or "Full Communication". TRUE - Enabled (not allowed to switch to "Silent Communication mode" or "Full Communication mode") Range FALSE - disabled (default)
      boolean ComMNoFullCom: origin=AUTOSAR_ECUC V1.0.0, default-value=false  # Defines if a ECU is not allowed to change state of the channel to "Full Communication". TRUE - Enabled (not allowed to switch to "Full Communication mode") Range FALSE - disabled (default)
      boolean ComMNoWakeup: origin=AUTOSAR_ECUC V1.0.0, default-value=false  # Defines if a ECU is not allowed to wake-up the channel. TRUE - Enabled (not allowed to wake-up)) FALSE - disabled (default)
      integer ComMRestartTrialsL1: 1..255, origin=AUTOSAR_ECUC V1.0.0, default-value=5  # Amount of restarts during level1 until switching to level 2.
      float ComMStartTxTimeout: 0.001..65, origin=AUTOSAR_ECUC V1.0.0, default-value=0.050  # Maximum time in seconds between start transmission request and the confirmation.
      float ComMStopTxTimeout: 0.001..65, origin=AUTOSAR_ECUC V1.0.0, default-value=0.050  # Maximum time in seconds between stop transmission request and the confirmation.
      choice reference ComMBusReference: origin=AUTOSAR_ECUC V1.1.0, destination=[FrIfCluster, LinIfChannel, CanIfNetworkConfig]  # Subcontainer for reference to one channel.
      symbolic name reference ComMNvmBlockDescriptor: origin=AUTOSAR_ECUC V1.1.0, destination=NvmBlockDescriptor  # Reference to NVRAM block containing the none volatile data
      symbolic name reference ComMRxIPduGroup: origin=AUTOSAR_ECUC V1.0.0, destination=ComIPduGroup  # ComIPduGroupHandleId of COM IPDU group containing all received IPDUs of the corresponding channel. In milliseconds.
      symbolic name reference ComMTxIPduGroup: origin=AUTOSAR_ECUC V1.0.0, destination=ComIPduGroup  # ComIPduGroupHandleId of COM IPDU group containing all transmitted IPDUs of the corresponding channel. In milliseconds.
      container ComMNetworkManagement  # This container contains the configuration parameters of the networkmanagement.
        float ComMNmLightTimeout [0..1]: 1..255, origin=AUTOSAR_ECUC V1.0.0, default-value=10  # Defines the timeout (in seconds) after state "ready sleep" is left.
        enumeration ComMNmVariant: {ComMFull, ComMLight, ComMNone, ComMPassive}, origin=AUTOSAR_ECUC V1.1.0, default-value=full  # Defines the functionality of the networkmanagement.
      container ComMUserPerChannel [1..*]  # This container contains a list of identifiers that are needed to refer to a user in the system which is linked to a channel.
        integer ComMUserId: 0.., implementation-config-class=PUBLISHED-INFORMATION, origin=AUTOSAR_ECUC V1.1.0  # A list of identifiers to identify which user is linked to which channel.
        symbolic name reference ComMUserChannel: origin=AUTOSAR_ECUC V1.1.0, destination=ComMUser  # Reference to the ComM User that corresponds to this channel user.
    container ComMGeneral  # Container for Communication Manager Configuration
      boolean ComMDevErrorDetect: origin=AUTOSAR_ECUC V1.0.0, default-value=false  # Switches the Development Error Detection and Notification ON or OFF.
      integer ComMEcuGroupClassification: origin=AUTOSAR_ECUC V1.0.0, default-value=7  # Defines whether a mode inhibition affects the ECU or not. Bit 1 Wake Up inhibition (default = 1) Bit 2 Forcing into "Silent Communication" mode (default = 1) Bit 3 Forcing into "No Communication" mode (default = 1) Examples: 000: No mode inhibition can be activated 001: Wake up inhibition can be enabled
      integer ComMEcuMUser: origin=AUTOSAR_ECUC V1.0.0  # User handle of ComM for requesting EcuM modes.
      boolean ComMIpdumEnabled: origin=AUTOSAR_ECUC V1.0.0, default-value=false  # Switches the IPDUM functionality ON or OFF.
      boolean ComMModeLimitationEnabled: origin=AUTOSAR_ECUC V1.0.0, default-value=false  # TRUE if mode limitation functionality shall be enabled.
      boolean ComMNoCom: origin=AUTOSAR_ECUC V1.0.0, default-value=false  # TRUE if ECU is not allowed to change state of the ECU to "Silent Communication" or "Full communication". TRUE - Enabled (not allowed to switch to "Silent Communication mode" or "Full Communication mode") FALSE - Disabled (default)
      boolean ComMResetAfterForcingNoComm: origin=AUTOSAR_ECUC V1.0.0, default-value=false  # ComM shall perform a reset after entering "No Communication" mode because of an active mode limitation to "No Communication" mode.
      float ComMTMinFullComModeDuration: 0.001..65, origin=AUTOSAR_ECUC V1.0.0, default-value=5  # Minimum time duration in seconds, spent in the Full Communication mode.
      boolean ComMVersionInfoApi: origin=AUTOSAR_ECUC V1.0.0, default-value=true  # Switches the possibility to read the published information with the service ComM_GetPublishedInformation().
      boolean ComMWakeupInhibitionEnabled: origin=AUTOSAR_ECUC V1.0.0, default-value=false  # TRUE if wake up inhibition functionality enabled.
    container ComMUser [1..*]  # This container contains a list of identifiers that are needed to refer to a user in the system which is designated to request Communication modes.
      integer ComMUserIdentifier: 0.., origin=AUTOSAR_ECUC V1.1.0, symbolic-name-value=true  # A identifier that is needed to refer to a user in the system which is designated to request Communication modes.
    container CommonPublishedInformation  # Common container, aggregated by all modules. It contains published information about vendor and versions.
      integer ArMajorVersion: implementation-config-class=PUBLISHED-INFORMATION, origin=AUTOSAR_ECUC V1.0.0  # Major version number of AUTOSAR specification on which the appropriate implementation is based on.
      integer ArMinorVersion: implementation-config-class=PUBLISHED-INFORMATION, origin=AUTOSAR_ECUC V1.0.0  # Minor version number of AUTOSAR specification on which the appropriate implementation is based on.
      integer ArPatchVersion: implementation-config-class=PUBLISHED-INFORMATION, origin=AUTOSAR_ECUC V1.0.0  # Patch level version number of AUTOSAR specification on which the appropriate implementation is based on.
      integer ModuleId: implementation-config-class=PUBLISHED-INFORMATION, origin=AUTOSAR_ECUC V1.0.0  # Module ID of this module from Module List
      integer SwMajorVersion: implementation-config-class=PUBLISHED-INFORMATION, origin=AUTOSAR_ECUC V1.0.0  # Major version number of the vendor specific implementation of the module. The numbering is vendor specific.
      integer SwMinorVersion: implementation-config-class=PUBLISHED-INFORMATION, origin=AUTOSAR_ECUC V1.0.0  # Minor version number of the vendor specific implementation of the module. The numbering is vendor specific.
      integer SwPatchVersion: implementation-config-class=PUBLISHED-INFORMATION, origin=AUTOSAR_ECUC V1.0.0  # Patch level version number of the vendor specific implementation of the module. The numbering is vendor specific.
      string VendorApiInfix [0..1]: implementation-config-class=PUBLISHED-INFORMATION, origin=AUTOSAR_ECUC V1.0.0  # In driver modules which can be instantiated several times on a single ECU, BSW00347 requires that the name of APIs is extended by the VendorId and a vendor specific name. This parameter is used to specify the vendor specific name. In total, the implementation specific name is generated as follows: <ModuleName>_>VendorId>_<VendorApiInfix><Api name from SWS>. E.g. assuming that the VendorId of the implementor is 123 and the implementer chose a VendorApiInfix of "v11r456" a api name Can_Write defined in the SWS will translate to Can_123_v11r456Write. This parameter is mandatory for all modules with upper multiplicity > 1. It shall not be used for modules with upper multiplicity =1.
      integer VendorId: implementation-config-class=PUBLISHED-INFORMATION, origin=AUTOSAR_ECUC V1.0.0  # Vendor ID of the dedicated implementation of this module according to the AUTOSAR vendor list
  module definition Crc [0..1]  # Configuration of the Crc (Crc routines) module.
    container CommonPublishedInformation  # Common container, aggregated by all modules. It contains published information about vendor and versions.
      integer ArMajorVersion: implementation-config-class=PUBLISHED-INFORMATION, origin=AUTOSAR_ECUC V1.0.0  # Major version number of AUTOSAR specification on which the appropriate implementation is based on.
      integer ArMinorVersion: implementation-config-class=PUBLISHED-INFORMATION, origin=AUTOSAR_ECUC V1.0.0  # Minor version number of AUTOSAR specification on which the appropriate implementation is based on.
      integer ArPatchVersion: implementation-config-class=PUBLISHED-INFORMATION, origin=AUTOSAR_ECUC V1.0.0  # Patch level version number of AUTOSAR specification on which the appropriate implementation is based on.
      integer ModuleId: implementation-config-class=PUBLISHED-INFORMATION, origin=AUTOSAR_ECUC V1.0.0  # Module ID of this module from Module List
      integer SwMajorVersion: implementation-config-class=PUBLISHED-INFORMATION, origin=AUTOSAR_ECUC V1.0.0  # Major version number of the vendor specific implementation of the module. The numbering is vendor specific.
      integer SwMinorVersion: implementation-config-class=PUBLISHED-INFORMATION, origin=AUTOSAR_ECUC V1.0.0  # Minor version number of the vendor specific implementation of the module. The numbering is vendor specific.
      integer SwPatchVersion: implementation-config-class=PUBLISHED-INFORMATION, origin=AUTOSAR_ECUC V1.0.0  # Patch level version number of the vendor specific implementation of the module. The numbering is vendor specific.
      string VendorApiInfix [0..1]: implementation-config-class=PUBLISHED-INFORMATION, origin=AUTOSAR_ECUC V1.0.0  # In driver modules which can be instantiated several times on a single ECU, BSW00347 requires that the name of APIs is extended by the VendorId and a vendor specific name. This parameter is used to specify the vendor specific name. In total, the implementation specific name is generated as follows: <ModuleName>_>VendorId>_<VendorApiInfix><Api name from SWS>. E.g. assuming that the VendorId of the implementor is 123 and the implementer chose a VendorApiInfix of "v11r456" a api name Can_Write defined in the SWS will translate to Can_123_v11r456Write. This parameter is mandatory for all modules with upper multiplicity > 1. It shall not be used for modules with upper multiplicity =1.
      integer VendorId: implementation-config-class=PUBLISHED-INFORMATION, origin=AUTOSAR_ECUC V1.0.0  # Vendor ID of the dedicated implementation of this module according to the AUTOSAR vendor list
    container CrcGeneral  # General configuration of CRC module
      enumeration Crc16Mode: {Crc16Hardware, Crc16Runtime, Crc16Table}, origin=AUTOSAR_ECUC V1.0.0  # Switch to select one of the available CRC16 calculation methods.
      enumeration Crc32Mode: {Crc32Hardware, Crc32Runtime, Crc32Table}, origin=AUTOSAR_ECUC V1.0.0  # Switch to select one of the available CRC32 calculation methods.
      boolean CrcVersionInfoApi: origin=AUTOSAR_ECUC V1.0.0  # Pre-processor switch to enable / disable the API to read out the modules version information. ON Version info API enabled. OFF Version info API disabled,
    container CrcPublishedInformation  # Additional published parameters not covered by CommonPublishedInformation container. Note that these parameters do not have any configuration class setting, since they are published information.
      integer CrcInitialValue16: origin=AUTOSAR_ECUC V1.0.0  # Initial value for the 16-bit CRC calculation.
      integer CrcInitialValue32: origin=AUTOSAR_ECUC V1.0.0  # Initial value for the 32-bit CRC calculation.
  module definition Dcm [0..1]  # Configuration of the Dcm (Diagnostic Communications Manager) module.
    container CommonPublishedInformation  # Common container, aggregated by all modules. It contains published information about vendor and versions.
      integer ArMajorVersion: implementation-config-class=PUBLISHED-INFORMATION, origin=AUTOSAR_ECUC V1.0.0  # Major version number of AUTOSAR specification on which the appropriate implementation is based on.
      integer ArMinorVersion: implementation-config-class=PUBLISHED-INFORMATION, origin=AUTOSAR_ECUC V1.0.0  # Minor version number of AUTOSAR specification on which the appropriate implementation is based on.
      integer ArPatchVersion: implementation-config-class=PUBLISHED-INFORMATION, origin=AUTOSAR_ECUC V1.0.0  # Patch level version number of AUTOSAR specification on which the appropriate implementation is based on.
      integer ModuleId: implementation-config-class=PUBLISHED-INFORMATION, origin=AUTOSAR_ECUC V1.0.0  # Module ID of this module from Module List
      integer SwMajorVersion: implementation-config-class=PUBLISHED-INFORMATION, origin=AUTOSAR_ECUC V1.0.0  # Major version number of the vendor specific implementation of the module. The numbering is vendor specific.
      integer SwMinorVersion: implementation-config-class=PUBLISHED-INFORMATION, origin=AUTOSAR_ECUC V1.0.0  # Minor version number of the vendor specific implementation of the module. The numbering is vendor specific.
      integer SwPatchVersion: implementation-config-class=PUBLISHED-INFORMATION, origin=AUTOSAR_ECUC V1.0.0  # Patch level version number of the vendor specific implementation of the module. The numbering is vendor specific.
      string VendorApiInfix [0..1]: implementation-config-class=PUBLISHED-INFORMATION, origin=AUTOSAR_ECUC V1.0.0  # In driver modules which can be instantiated several times on a single ECU, BSW00347 requires that the name of APIs is extended by the VendorId and a vendor specific name. This parameter is used to specify the vendor specific name. In total, the implementation specific name is generated as follows: <ModuleName>_>VendorId>_<VendorApiInfix><Api name from SWS>. E.g. assuming that the VendorId of the implementor is 123 and the implementer chose a VendorApiInfix of "v11r456" a api name Can_Write defined in the SWS will translate to Can_123_v11r456Write. This parameter is mandatory for all modules with upper multiplicity > 1. It shall not be used for modules with upper multiplicity =1.
      integer VendorId: implementation-config-class=PUBLISHED-INFORMATION, origin=AUTOSAR_ECUC V1.0.0  # Vendor ID of the dedicated implementation of this module according to the AUTOSAR vendor list
    container DcmDsd  # These parameters apply to Diagnostic Service Dispatcher. All parameters for all service dispatchers are included in this one configuration container. upperMultiplicity: Multiple service dispatchers are allowed in this one configuration container. lowerMultiplicity: There must always be one service dispatcher in a DCM.
      container DcmDsdServiceIdTable [1..256]  # This container contains the configuration (DSD parameters) for Service Identifier Table.
        function name DcmDsdSidFunction: origin=AUTOSAR_ECUC V1.0.0  # Function Pointer for the callback function of the DSP or/and the Autosar SW component for the particular DCM_SIDTAB_SERVICEID. Please refer to the ISO 14229-1, ISO 15031-5 and "Distribution of Diagnostic Message to data processor" (chapter 7.2.2.4). Type: void XXX_Dcm<DiagnosticService>(Dcm_MsgContextType*)
        integer DcmDsdSidTabId: 0..255, origin=AUTOSAR_ECUC V1.0.0  # Due the fact of using one or more service tables the member of the Service Identifier Table includes a unique id for the Service Identifier Table.
        integer DcmDsdSidTabServiceId: 0..255, origin=AUTOSAR_ECUC V1.0.0  # Id of the Service identifier in hex. The possible Service identifier are predefined in the ISO 14229-1 and ISO 15031-5 and in Table 5 and Table 6.
        boolean DcmDsdSidTabSubfuncAvial: origin=AUTOSAR_ECUC V1.0.0  # Information whether the DCM_SIDTAB_SERVICEID includes Sub functions or not. Used for the Handling of "suppressPosRspMsgIndicationBit" (chapter 7.2.2.4) ISO14229-1 can be referenced here, as this specification gives fix definition, if an SID includes Subfunction or not.
        container DcmDsdSidTabSecLevelRow [1..*]  # Within each Service Table there may be one or more services, each with a configuration record.
          integer DcmDsdSidTabSecLevel: 0..255, origin=AUTOSAR_ECUC V1.0.0  # Information about the Security Access Levels needed for execution of the DCM_SIDTAB_SERVICEID. Please refer to the ISO 14229-1, ISO 15031-5 and "Verification of the Security Access levels" (chapter 7.2.2.4). For DCM_SEC_LEVEL please refer to chapter 10.5 DSP (Diagnostic Service Processing)Please note, that it shall be provided to configure several DCM_SIDTAB_SEC_LEVEL per DCM_SIDTAB_SERVICEID. 0x00, 0x01,0x03...0x7F: <configuration dependent - only odd values (and 0) are allowed (according to "securityAccessType" parameter of SecurityAccess request (see [6]))> 0xFF: all Sec. Access Levels
        container DcmDsdSidTabSessionLevelRow [1..*]  # Within each Service Table there may be one or more services, each with a configuration record.
          integer DcmDsdSidTabSessionLevel: 0..255, origin=AUTOSAR_ECUC V1.0.0  # Information about the Session Control needed for execution of the DCM_SIDTAB_SERVICEID. Please refer to the ISO 14229-1, ISO 15031-5 and "Verification of the Diagnostic Session" (chapter 7.2.2.4). For DCM_SESSION_LEVEL please refer to chapter 10.5 DSP (Diagnostic Service Processing)Please note, that it shall be provided to configure several DCM_SIDTAB_SESSION_LEVEL per DCM_SIDTAB_SERVICEID.
    container DcmDsl  # These parameters apply to a Diagnostic Session Layer. There may be a parameter set (DSL Configuration) per protocol. upperMultiplicity: Each DCM configuration must have exactly one DSL configuration. lowerMultiplicity: Each DCM configuration must have exactly one DSL configuration.
      container DcmDslBuffer [1..256]  # This container contains the configuration (parameters) for the diagnostic buffer.
        integer DcmDslBufferID: 0..255, origin=AUTOSAR_ECUC V1.0.0  # Identifier of Buffer.
        integer DcmDslBufferSize: 8..4096, origin=AUTOSAR_ECUC V1.0.0  # Size of Diagnostic Buffer (in Bytes) For a linear buffer: size of the buffer shall be as large as the longest message (request or response) For a paged buffer: size has impacts on the application performance Please note: max. range is the valid range for a CAN network. We assume a FlexRay (or other networks) implementation will work with this range (and the page buffer mechanism) without any problems.
      container DcmDslPeriodicTransmission  # The parameters within this container are required per protocol (DSL Configuration).
        boolean DcmDslPeriodicTransEnabled: origin=AUTOSAR_ECUC V1.0.0  # Allow to enable or disable a periodic transmission (CFG_ON, CFG_OFF).
        enumeration DcmDslPeriodicTransType: {PeriodicType1, PeriodicType2}, origin=AUTOSAR_ECUC V1.0.0  # Defines the transmission type for Periodic Transmissions. The SWS for DCM defines it as enumerated with two values: TYPE1 = normal diagnostic responses are transmitted on the DSL Tx PDU ID for this protocol (DCM_PROTOCOL_DCMTXPDUID). TYPE2 = normal diagnostic responses are transmitted on a separate DSL Tx PDU ID, the value of which is held in this configuration. upperMultiplicity: Exactly one value of PeriodicTransmission Type must be defined if Periodic Transmission is enabled. lowerMultiplicity: PeriodicTransmission Type does not need to be defined if Periodic Transmission is not enabled. origin: Standard AUTOSAR configuration parameter.
        reference def DcmDslPeriodicTxBufferID: lower-multiplicity=0, upper-multiplicity=1, origin=AUTOSAR_ECUC V1.0.0, destination=DcmDslBuffer  # This identifies the buffer configuration to be used for the Periodic Tx PDU ID for this DSL. upperMultiplicity: One buffer ID required if Periodic Transmission Type is TYPE2. lowerMultiplicity: No buffer is required if Periodic Transmission Type is TYPE1.
        container DcmDslPeriodicDcmTxPDUID  # This is the transmission PDU ID to be used by this DCM when sending Periodic Transmissions. It is only needed for Type2 Periodic Transmissions configurations.
          reference def DcmDslPeriodicTxPduRef: lower-multiplicity=1, upper-multiplicity=1, origin=AUTOSAR_ECUC V1.0.0, destination=Pdu
      container DcmDslProtocol  # This container contains the configuration (parameters) for the protocol configuration (for each protocol) The following parameters needs to be configured per protocol.
        container DcmDslProtocolRow [1..256]  # This container contains the configuration (parameters) for the protocol configuration (for each protocol) The following parameters needs to be configured per protocol.
          integer DcmDslProtocolID: 0..2, origin=AUTOSAR_ECUC V1.0.0  # The SWS for DCM defines this as enum type of maxsize uint8 with values {OBD, UDS, ...}. It is effectively the name of the diagnostic protocol type for the DCM DSL protocol that is being configured. 0x00 : DCM_OBD_ON_CAN OBD on CAN (ISO15765-4; ISO15031-5) 0x01 : DCM_UDS_ON_CAN UDS on CAN (ISO15765-3; ISO14229-1) 0x02 : DCM_UDS_ON_FLEXRAY UDS on FlexRay (Manufacturer specific; ISO14229-1) 0x03..0xEF : Reserved for further AUTOSAR implementation 0xF0..0xFF : Reserved for SW supplier specific
          float DcmDslProtocolPreemptTimeout: 0.., origin=AUTOSAR_ECUC V1.0.0  # This is the value for the timeout (in milliseconds) of preempting protocol until protocol needs to be started. This is defined in the AUTOSAR SWS for DCM as a uint16. The AUTOSAR configuration standard is to use SI units, so this parameter is defined as a float value in seconds. DCM configuration tools must convert this float value to the appropriate value format for the use in the software implementation of DCM. min: A negative value is not allowed. upperMultiplicity: Exactly one P2ServerMin value per DSL protocol timing structure. lowerMultiplicity: Exactly one P2ServerMin value per DSL timing structure. origin: Standard AUTOSAR configuration parameter.
          integer DcmDslProtocolPriority: 0..255, origin=AUTOSAR_ECUC V1.0.0  # The SWS for DCM defines this item as uint8. This is the protocol priority that is used during protocol preemption handling. 0 = Highest priority (protocol may not be preempted by other protocols) 1, 2, 3... = Reducing priority. Protocol may be preempted by other protocols with lower priority value. upperMultiplicity: Exactly one priority must be provided per Tx Protocol. lowerMultiplicity: Exactly one priority must be provided per Tx Protocol. origin: Standard AUTOSAR configuration parameter.
          reference def DcmDslProtocolSIDTable: lower-multiplicity=1, upper-multiplicity=1, origin=AUTOSAR_ECUC V1.0.0, destination=DcmDsdServiceIdTable  # Link to the diagnostic service table for this protocol. upperMultiplicity: Must have exactly one service table for the protocol. lowerMultiplicity: Must have exactly one service table for the protocol.
          reference def DcmDslProtocolTimeDefault: lower-multiplicity=1, upper-multiplicity=1, origin=AUTOSAR_ECUC V1.0.0, destination=DcmDslProtocolTimingRow  # Link to the default timing structure (valid for a default session) upperMultiplicity: Exactly one default timing structure must be provided. lowerMultiplicity: Exactly one default timing structure must be provided.
          reference def DcmDslProtocolTimeLimit: lower-multiplicity=1, upper-multiplicity=1, origin=AUTOSAR_ECUC V1.0.0, destination=DcmDslProtocolTimingRow  # Link to the extended / limit timing structure. Note: limits are checked when using AccessTimingParameter service. upperMultiplicity: Exactly one extended timing structure must be provided. lowerMultiplicity: Exactly one extended timing structure must be provided.
          reference def DcmDslProtocolTxBufferID: lower-multiplicity=1, upper-multiplicity=1, origin=AUTOSAR_ECUC V1.0.0, destination=DcmDslBuffer  # Link to the buffer configuration for transmissions for this protocol. upperMultiplicity: Exactly one transmit buffer required for a DSL protocol. lowerMultiplicity: Exactly one transmit buffer required for a DSL protocol.
          container DcmDslConnectionTable  # This container contains links between DIAGNOSTIC_PROTOCOL_TABLE and the included containers.
            container DcmDslProtocolRx [1..*]  # This holds the PDU IDs at which this protocol will receive requests to be used by this DCM. Multiple receive PDU IDs are allowed (e.g. one to receive func requests, one to receive phys requests). Each ID has an associate buffer and address type. upperMultiplicity: More than one receive PDU ID may be configured for reception (e.g. one for func requests, one for phys requests). lowerMultiplicity: At least one receive PDU ID configuration must be provided per protocol.
              enumeration DcmDslProtocolRxAddrType: {FUNCTIONALType, PHYSICALType}, origin=AUTOSAR_ECUC V1.0.0  # The SWS for DCM defines this as a two value enumeration: PHYSICAL = 1 to 1 communications using physical addressing FUNCTIONAL = 1 to n communication
              reference def DcmDslProtocolRxBufferID: lower-multiplicity=1, upper-multiplicity=1, origin=AUTOSAR_ECUC V1.0.0, destination=DcmDslBuffer  # Link to the buffer to be used by this protocol for receiving . upperMultiplicity: Exactly one receive buffer is required for protocol reception. lowerMultiplicity: Exactly one receive buffer is required for protocol reception.
              container DcmDslProtocolRxPduId  # DcmTxPduId value for transmission of responses.
                integer DcmDslProtocolRxPduId: origin=AUTOSAR_ECUC V1.0.0, symbolic-name-value=true  # DcmTxPduId value for transmission of responses.
                reference def DcmDslProtocolRxPduRef: lower-multiplicity=1, upper-multiplicity=1, origin=AUTOSAR_ECUC V1.0.0, destination=Pdu
            container DcmDslProtocolTx [1..*]  # This holds the PDU IDs at which this protocol will receive requests to be used by this DCM. Multiple receive PDU IDs are allowed (e.g. one to receive func requests, one to receive phys requests). Each ID has an associate buffer and address type. upperMultiplicity: More than one receive PDU ID may be configured for reception (e.g. one for func requests, one for phys requests). lowerMultiplicity: At least one receive PDU ID configuration must be provided per protocol.
              reference def DcmDslProtocolTxPduRef: lower-multiplicity=1, upper-multiplicity=1, origin=AUTOSAR_ECUC V1.0.0, destination=Pdu
      container DcmDslProtocolTiming [1..*]  # This container contains the configuration (parameters) for Protocol timing. Please notice that per protocol 2 Time tables shall be configured (DCM_DEFAULT and DCM_LIMITS) . This container contains rows of PROTOCOL_TIMING_STRUCTURE_ROW.
        container DcmDslProtocolTimingRow [2..2]  # Definition of a single row of configuration for protocol timing
          float DcmTimStrP2ServerMax: 0.., origin=AUTOSAR_ECUC V1.0.0  # This is the value for P2ServerMin in milliseconds. This is defined in the AUTOSAR SWS for DCM as a uint16. The AUTOSAR configuration standard is to use SI units, so this parameter is defined as a float value in seconds. DCM configuration tools must convert this float value to the appropriate value format for the use in the software implementation of DCM.
          float DcmTimStrP2ServerMin: 0.., origin=AUTOSAR_ECUC V1.0.0  # This is the value for P2ServerMin in milliseconds. This is defined in the AUTOSAR SWS for DCM as a uint16. The AUTOSAR configuration standard is to use SI units, so this parameter is defined as a float value in seconds. DCM configuration tools must convert this float value to the appropriate value format for the use in the software implementation of DCM.
          float DcmTimStrP2StarServerMax: 0.., origin=AUTOSAR_ECUC V1.0.0  # This is the value for P2ServerMin in milliseconds. This is defined in the AUTOSAR SWS for DCM as a uint16. The AUTOSAR configuration standard is to use SI units, so this parameter is defined as a float value in seconds. DCM configuration tools must convert this float value to the appropriate value format for the use in the software implementation of DCM.
          float DcmTimStrP2StarServerMin: 0.., origin=AUTOSAR_ECUC V1.0.0  # This is the value for P2ServerMin in milliseconds. This is defined in the AUTOSAR SWS for DCM as a uint16. The AUTOSAR configuration standard is to use SI units, so this parameter is defined as a float value in seconds. DCM configuration tools must convert this float value to the appropriate value format for the use in the software implementation of DCM.
          float DcmTimStrS3Server: 0.., origin=AUTOSAR_ECUC V1.0.0  # This is the value for P2ServerMin in milliseconds. This is defined in the AUTOSAR SWS for DCM as a uint16. The AUTOSAR configuration standard is to use SI units, so this parameter is defined as a float value in seconds. DCM configuration tools must convert this float value to the appropriate value format for the use in the software implementation of DCM.
          integer DcmTimeStrType: 0..2, origin=AUTOSAR_ECUC V1.0.0  # Type of the timing structure Note: The Dcm_TimerModeType DCM_CURRENT is not configurable
      container DcmDslResponseOnEvent  # This container contains the configuration (parameters) for ResponseOnEvent service
        boolean DcmDslROEEnabled: origin=AUTOSAR_ECUC V1.0.0  # Allow to enable or disable a ROE transmission
        enumeration DcmDslROETransType: {ROEType1, ROEType2}, origin=AUTOSAR_ECUC V1.0.0  # Defines the transmission type for ResponseOnEvent. The SWS for DCM defines it as enumerated with two values: TYPE1 = normal diagnostic responses are transmitted on the DSL Tx PDU ID for this protocol (DCM_PROTOCOL_DCMTXPDUID). TYPE2 = normal diagnostic responses are transmitted on a separate DSL Tx PDU ID, the value of which is held in this configuration.
        reference def DcmDslROETxBufferID: lower-multiplicity=1, upper-multiplicity=1, origin=AUTOSAR_ECUC V1.0.0, destination=DcmDslBuffer  # This identifies the buffer configuration to be used for the ROE Tx PDU ID for this DSL. upperMultiplicity: One buffer ID required if ROE Transmission Type is TYPE2. lowerMultiplicity: No bufer required if ROE Transmission Type is TYPE1.
        container DcmDslRoeTx  # These parameters apply to a Diagnostic Session Layer. There may be a parameter set (DSL Configuration) per protocol. upperMultiplicity: Each DCM configuration must have exactly one DSL configuration. lowerMultiplicity: Each DCM configuration must have exactly one DSL configuration.
          reference def DcmDslRoeTxPduRef: lower-multiplicity=1, upper-multiplicity=1, origin=AUTOSAR_ECUC V1.0.0, destination=Pdu  # Reference to the PDU that is transmitted in this frame.
    container DcmDsp  # These parameters apply to Diagnostic Service Processing. There will always be one set of these parameters per DCM.
      container DcmDspReadDTC [0..1]  # This container contains the configuration (parameters) of the service Read DTC Information - 0x19 (per sub-function type)
        container DcmDspReadDTCRow [0..*]  # This container contains the configuration (parameters) of the service Read DTC Information - 0x19 (per sub-function type)
          integer DcmDspDTCInfoSubFuncLevel: 0..255, origin=AUTOSAR_ECUC V1.0.0  # hex value of the sub-function.
          boolean DcmDspInfoSubFuncSupp: origin=AUTOSAR_ECUC V1.0.0  # This parameter is defined in the DCM SWS as a Boolean that indicates whether the respective sub-function is supported. TRUE = sub-function supported. FALSE = sub-function not supported.
          integer DcmDspReadDTCSecLevel: 0..255, origin=AUTOSAR_ECUC V1.0.0  # Security level value, indicates which security level is necessary to execute a specific sub-function 0x00, 0x01,0x03...0x7F: configuration dependent - only odd values (and 0) are allowed (according to "securityAccessType" parameter of SecurityAccess request
      container DcmDspSecurity  # These parameters apply to Diagnostic Service Processing. There will always be one set of these parameters per DCM.
        container DcmDspSecurityRow [1..256]  # This container contains the configuration ( DSP parameter) for security level configuration (per security level)
          float DcmDspSecurityDelayTime: 0.., origin=AUTOSAR_ECUC V1.0.0  # Defined in the DCM SWS as uint16, this parameter contains a value in milliseconds for the delay time introduced after a failed security access once DcmDspSecurityNumAttDelay failed attempts have been made. The AUTOSAR configuration standard is to use SI units, so this parameter is defined as float value in seconds. DCM configuration tools must convert this float value to the appropriate value format for the use in the software implementation of DCM. min: A negative value is not allowed. upperMultiplicity: Exactly one delay tie must be specified per security levbel configuration. lowerMultiplicity: Exactly one delay tie must be specified per security levbel configuration. origin: Standard AUTOSAR configuration parameter.
          integer DcmDspSecurityKeySize: 1..255, origin=AUTOSAR_ECUC V1.0.0  # This parameter is defined in the DCM SWS as uint8. It holds a value indicating the size of the security key (in Bytes).
          integer DcmDspSecurityLevel: 0..255, origin=AUTOSAR_ECUC V1.0.0  # Defined in the DCM SWS as a uint8 containing the security level value. 0 is the highest security level. 0x00, 0x01,0x03...0x7F: configuration dependent - only odd values (and 0) are allowed (according to "securityAccessType" parameter of SecurityAccess request
          string DcmDspSecurityName: origin=AUTOSAR_ECUC V1.0.0  # Defined in the DCM SWS as a string containing the name of the security level.
          integer DcmDspSecurityNumAttDelay: 0..255, origin=AUTOSAR_ECUC V1.0.0  # Defined in the DCM SWS as uint8, this parameter contains the number of failed security accesses after which the delay time is activated.
          integer DcmDspSecurityNumAttLock: 1..255, origin=AUTOSAR_ECUC V1.0.0  # Defined in the DCM SWS as uint8, this parameter contains the number of failed security accesses after which security access is locked.
          integer DcmDspSecuritySeedSize: 1..255, origin=AUTOSAR_ECUC V1.0.0  # This parameter is defined in the DCM SWS as uint8. It holds a value indicating the size of the security seed (in Bytes).
      container DcmDspSession  # These parameters apply to Diagnostic Service Processing. There will always be one set of these parameters per DCM.
        container DcmDspSessionRow [1..8]  # This container contains the configuration ( DSP parameter) session control configuration (per session control)
          integer DcmDspSessionLevel: 0..255, origin=AUTOSAR_ECUC V1.0.0  # This is defined as uint8 in the SWS for DCM. This is the session control value. .
          string DcmDspSessionName: origin=AUTOSAR_ECUC V1.0.0  # Name of the Session control.
          float DcmDspSessionP2ServerMax: 0.., origin=AUTOSAR_ECUC V1.0.0  # This is the session value for P2ServerMax in milliseconds. This is defined in the AUTOSAR SWS for DCM as a uint16. The AUTOSAR configuration standard is to use SI units, so this parameter is defined as a float value in seconds. DCM configuration tools must convert this float value to the appropriate value format for the use in the software implementation of DCM.
          float DcmDspSessionP2StarServerMax: 0.., origin=AUTOSAR_ECUC V1.0.0  # This is the session value for P2ServerMax in milliseconds. This is defined in the AUTOSAR SWS for DCM as a uint16. The AUTOSAR configuration standard is to use SI units, so this parameter is defined as a float value in seconds. DCM configuration tools must convert this float value to the appropriate value format for the use in the software implementation of DCM.
    container DcmGeneral  # This container contains the configuration (parameters) for Component wide parameters
      boolean DcmDevErrorDetect: origin=AUTOSAR_ECUC V1.0.0  # Preprocessor switch to enable or disable the Development Error Detection (DET) mechanism.
      boolean DcmRequestIndicationEnabled: origin=AUTOSAR_ECUC V1.0.0  # Allows to enable or disable the requested indication mechanism.
      integer DcmTaskTime: 0..255, origin=AUTOSAR_ECUC V1.0.0  # Allow to configure the time for the periodic cyclic task (in ms). Please note: This configuration value shall be equal to the value in the ScheduleManager module.
      boolean DcmVersionInfoApi: origin=AUTOSAR_ECUC V1.0.0  # Preprocessor switch to enable or disable the output Version info of the functionality.
    container DcmPageBufferCfg  # This container contains the configuration (parameters) for Page Buffer handling
      boolean DcmPagedBufferEnabled: origin=AUTOSAR_ECUC V1.0.0  # Allow to enable or disable the Page buffer mechanism.
      integer DcmPagedBufferTimeout: 0..65535, origin=AUTOSAR_ECUC V1.0.0  # Allow to configure the Timeout (in ms) towards the application for filling the next page.
  module definition Dem [0..1]  # Configuration of the Dem (Diagnostic Event Manager) module.
    container CommonPublishedInformation  # Common container, aggregated by all modules. It contains published information about vendor and versions.
      integer ArMajorVersion: implementation-config-class=PUBLISHED-INFORMATION, origin=AUTOSAR_ECUC V1.0.0  # Major version number of AUTOSAR specification on which the appropriate implementation is based on.
      integer ArMinorVersion: implementation-config-class=PUBLISHED-INFORMATION, origin=AUTOSAR_ECUC V1.0.0  # Minor version number of AUTOSAR specification on which the appropriate implementation is based on.
      integer ArPatchVersion: implementation-config-class=PUBLISHED-INFORMATION, origin=AUTOSAR_ECUC V1.0.0  # Patch level version number of AUTOSAR specification on which the appropriate implementation is based on.
      integer ModuleId: implementation-config-class=PUBLISHED-INFORMATION, origin=AUTOSAR_ECUC V1.0.0  # Module ID of this module from Module List
      integer SwMajorVersion: implementation-config-class=PUBLISHED-INFORMATION, origin=AUTOSAR_ECUC V1.0.0  # Major version number of the vendor specific implementation of the module. The numbering is vendor specific.
      integer SwMinorVersion: implementation-config-class=PUBLISHED-INFORMATION, origin=AUTOSAR_ECUC V1.0.0  # Minor version number of the vendor specific implementation of the module. The numbering is vendor specific.
      integer SwPatchVersion: implementation-config-class=PUBLISHED-INFORMATION, origin=AUTOSAR_ECUC V1.0.0  # Patch level version number of the vendor specific implementation of the module. The numbering is vendor specific.
      string VendorApiInfix [0..1]: implementation-config-class=PUBLISHED-INFORMATION, origin=AUTOSAR_ECUC V1.0.0  # In driver modules which can be instantiated several times on a single ECU, BSW00347 requires that the name of APIs is extended by the VendorId and a vendor specific name. This parameter is used to specify the vendor specific name. In total, the implementation specific name is generated as follows: <ModuleName>_>VendorId>_<VendorApiInfix><Api name from SWS>. E.g. assuming that the VendorId of the implementor is 123 and the implementer chose a VendorApiInfix of "v11r456" a api name Can_Write defined in the SWS will translate to Can_123_v11r456Write. This parameter is mandatory for all modules with upper multiplicity > 1. It shall not be used for modules with upper multiplicity =1.
      integer VendorId: implementation-config-class=PUBLISHED-INFORMATION, origin=AUTOSAR_ECUC V1.0.0  # Vendor ID of the dedicated implementation of this module according to the AUTOSAR vendor list
    container DemGeneral
      integer DemBswErrorBufferSize: 0..255, origin=AUTOSAR_ECUC V1.0.0  # Maximum number of elements in buffer for handling of BSW errors (ref. to Dem107).
      boolean DemDevErrorDetect: origin=AUTOSAR_ECUC V1.0.0  # Activate/Deactivate the Development Error Detection and Notification.
      integer DemMaxNumberEventEntryMir: 0..255, origin=AUTOSAR_ECUC V1.0.0, default-value=0  # Maximum number of events which can be stored in the mirror memory (typically up to 30) (ref. to example ch. 7)
      integer DemMaxNumberEventEntryPrm: 0..65535, origin=AUTOSAR_ECUC V1.0.0, default-value=30  # Maximum number of events which can be stored in the primary memory (typically up to 20) (ref. to example ch. 7)
      integer DemMaxNumberEventEntrySec: 0..255, origin=AUTOSAR_ECUC V1.0.0, default-value=0  # Maximum number of events which can be stored in the secondary memory (typically up to 30) (ref. to example ch. 7)
      integer DemNumberOfEvents: 0..65535, origin=AUTOSAR_ECUC V1.0.0, default-value=500  # Maximum of defined events which are present in the system (typically 500).
      integer DemNvmAccessRetry: 0..255, origin=AUTOSAR_ECUC V1.0.0  # Maximum number of retries to access NVRAM Manager.
      float DemNvmAccessRetryTimeDelay: 0..65.535, origin=AUTOSAR_ECUC V1.0.0  # Time between to retries to NVRAM Manager in case of access failure.
      integer DemTypeOfDTCSupported: 0..31, origin=AUTOSAR_ECUC V1.0.0  # DEM_TYPE_OF_DTC_SUPPORTED is defined in the DEM SWS as uint8. However, it is used in a way similar to an enum. Bit 0: 2 byte ISO15031-6 DTC Bit 1: 3 byte ISO14229-1 DTC Bit 2: Customer specific DTC Bit 3: SAEJ1939 Bit 4: WWH-OBD-format Set the according Bit to '1' means DTC format is supported. Combination of different DTC formats is possible (e.g. ISO 15031-6 and ISO14229-1 is coded by 0x0011b).
      integer DemTypeOfOriginSupported [0..1]: 0..7, origin=AUTOSAR_ECUC V1.0.0  # Definition of origins available in ECU. Bit 0: DEM_DTC_ORIGIN_PRIMARY_MEMORY Bit 1: DEM_DTC_ORIGIN_SECONDARY_MEMORY Bit 2: DEM_DTC_ORIGIN_MIRROR_MEMORY Set the according Bit to '1' means origin is available. Comination of different origins is possible (e.g. DEM_DTC_ORIGIN_MIRROR_MEMORY and DEM_DTC_ORIGIN_PRIMARY_MEMORY supported is coded by 0x0101b) This parameter is optional, because multiple origins are not supported by all automotive manufacturer.
      boolean DemVersionInfoApi: origin=AUTOSAR_ECUC V1.0.0  # Activate/Deactivate the version information API.
      container DemEventParameter [0..65535]  # This container contains the configuaration (parameters) for events. Note that this container definition does not explicitly define a symbolic name parameter. Instead, the short name of the container will be used in the Ecu Configuration Description to specify the symbolic name of the DEM_EVENT_NAME.
        integer DemEventID: 1..65535, origin=AUTOSAR_ECUC V1.0.0, symbolic-name-value=true  # Unique identifier of an event 1..255 for small PDUs with <255 different events and a limited RAM 1..65535 for other PDUs The events should be sequential ordered beginning with 1 and no gaps in between.
        string DemInitMonitorName: origin=AUTOSAR_ECUC V1.0.0  # Monitor function which has to be initialized for the event (ref. to Xxx_DemInitMonitor(EventId)
        container DemDTCClass [1..2]  # This container contains the configuration for DTCClass.
          integer DemDTC: 0..4194304, origin=AUTOSAR_ECUC V1.0.0  # Diagnostic Trouble Code
          enumeration DemDTCKind: {DEM_DTC_KIND_ALL_DTCS, DEM_DTC_KIND_EMISSION_REL_DTCS}, origin=AUTOSAR_ECUC V1.0.0  # Kind of DTC (OBD relevant or not)
          enumeration DemDTCSeverity [0..1]: {DEM_DTC_SEV_CHECK_AT_NEXT_HALT, DEM_DTC_SEV_IMMEDIATELY, DEM_DTC_SEV_MAINTENANCE_ONLY, DEM_DTC_SEV_NO_SEVERITY}, origin=AUTOSAR_ECUC V1.0.0  # This parameter depends on automotive manufacturer and is optional.
        container DemEventClass  # This container contains the configuaration (parameters) for EventClass
          integer DemEnableConditionID [0..1]: 0..65535, origin=AUTOSAR_ECUC V1.1.0  # Defines a condition ID.
          integer DemEnableConditionStatus [0..1]: 0..255, origin=AUTOSAR_ECUC V1.0.0  # Defines a status for enable or disable of storage of a event.
          integer DemEventDestination: 0..7, origin=AUTOSAR_ECUC V1.0.0  # Dem104 identification of the destination of an event/Dem_DTCOriginType.
          integer DemEventPriority: 0..255, origin=AUTOSAR_ECUC V1.0.0  # Priority of an event, in view of full event buffer (ref. to Dem104).
          boolean DemFFPrestorageSupported: origin=AUTOSAR_ECUC V1.1.0  # If this parameter is set to true, then the Prestorage of freeze frames is supported by the assigned event. This parameter is useful to calculate the buffer size.
          boolean DemHealingAllowed: origin=AUTOSAR_ECUC V1.0.0  # (Dem104) general switch to allow healing/unlearning or not.
          integer DemHealingCycle: 0..255, origin=AUTOSAR_ECUC V1.0.0  # cycles needed to heal/erase event (ref. Dem104). This parameter is optional (depends on OEM).
          integer DemHealingCycleCounter [0..1]: 1..256, origin=AUTOSAR_ECUC V1.1.0  # cycles needed to heal/erase event (ref. Dem104). This parameter is optional (depends on OEM).
          integer DemOperationCycle: 0..255, origin=AUTOSAR_ECUC V1.0.0  # Kind of operation cycle for the event (e.g. power cycle, driving cycle, ...)
          integer DemPredebounceAlgorithm: 0..3, origin=AUTOSAR_ECUC V1.1.0  # Selects a Predebounce Algorithm
          reference def DemSupportedViewName: lower-multiplicity=1, upper-multiplicity=1, origin=AUTOSAR_ECUC V1.0.0, destination=DemViewList  # view name of supported view A view describes a functional group like a wiper system or a window lifter for the access of corresponding DTCs and related data. SUPPORTED_VIEW_NAME selects a view in which the event is visible. Example: WIPERSYSTEM refers to functionality wiper system, WINDOWLIFTER refers to functionality window lifter, ... This parameter is optional.
          container DemIndicatorAttributeList [0..255]  # This container contains the event specific configuration of Indicators.
            integer DemIndicatorBehaviour: 0..7, origin=AUTOSAR_ECUC V1.0.0  # Behaviour of the linked indicator Bit 0: Indicator is active if event in status FAILED Bit 1: Indicator is passive if event in status FAILED Bit 2: Indicator is blinking if event in status FAILED
            reference def DemLinkedIndicator: lower-multiplicity=1, upper-multiplicity=1, origin=AUTOSAR_ECUC V1.0.0, destination=DemIndicator  # indicator name of the used indicator
          container DemOEMSpecific [0..1]  # This container contains the configuaration for OEM specific additional parameter.
        container DemExtendedDataClass [0..*]  # This container contains the configuration for ExtendedClass.
          integer DemDataSize: 0..255, origin=AUTOSAR_ECUC V1.0.0  # Defines the size of the extended Data Record in Bytes.
          integer DemExtendedClassID: 0..65535, origin=AUTOSAR_ECUC V1.0.0  # Unique identifier of an extended data class.
          integer DemExtendedDataRecordNumber: 0..255, origin=AUTOSAR_ECUC V1.0.0  # Unique identifier of an extended data class.
        container DemFreezeFrameClass [0..*]  # This container contains the configuration for FreezeFrameClass.
          integer DemDataID: 0..65535, origin=AUTOSAR_ECUC V1.0.0  # For enhanced diagnostics Multiple DataIDs can be relevant per FreezeFrame. This parameter is optional!
          integer DemGlobalParameter: 0..65535, origin=AUTOSAR_ECUC V1.0.0  # Mandatory parameters for OBD and common parameter for all events
          integer DemPID: 0..65535, origin=AUTOSAR_ECUC V1.0.0  # For OBD relevant data Multiple PIDs can be relevant per Freezeframe. This parameter is optional!
          container DemGetDataValByDataIdList  # This container contains the configuration for GetDataValueByDataIdentifierList.
            string DemGetDataValByDataIdListTarget: origin=AUTOSAR_ECUC V1.1.0  # Real name of Xxx_GetDataValueByDataIdentifier function.
        container DemGetExtendedDataList  # This container contains the configuaration for GetExtendedData functions
          string DemGetExtendedDataTarget: origin=AUTOSAR_ECUC V1.0.0  # Real name of the Xxx_GetExtendedData function.
        container DemTriggerOnEventStatusList [0..*]  # This container contains the configuration for TriggerOnEvent functions.
          string DemTriggerOnEventStatusTarget: origin=AUTOSAR_ECUC V1.0.0  # Real name of Xxx_DemTriggerOnEventStatus function. The possible selection depends on Xxx_DemTriggerOnEventStatusList.
      container DemGroupOfDTCList [6..6]  # This container contains the configuaration (parameters) for DTC Groups.
        integer DemGroupDTCs: 0..4194304, origin=AUTOSAR_ECUC V1.0.0  # Range of DTC numbers of the selected group of DTC (according to ISO14229-1[10] Annex D1)
      container DemIndicator [0..255]  # This container contains the configuaration (parameters) for Indicators. Note hat this container definition does not explicitly define a symbolic name parameter. Instead, the short name of the container will be used in the Ecu Configuration Description to specify the symbolic name of the INDICATOR_NAME.
        integer IndicatorID: 0..255, origin=AUTOSAR_ECUC V1.0.0, symbolic-name-value=true  # Unique Identifier of a Indicator
      container DemNvramBlockIdList [0..*]  # This container contains the configuaration (parameters) for Dem_OperationCycleList. Note hat this container definition does not explicitly define a symbolic name parameter. Instead, the short name of the container will be used in the Ecu Configuration Description to specify the symbolic name of the VALUE_NAME.
        integer DemNvramBlockId: origin=AUTOSAR_ECUC V1.0.0, symbolic-name-value=true  # Defines a unique ID of a data value.
      container DemOemIdClass [0..*]  # This container contains the configuaration (parameters) for OEMIdClass. Note hat this container definition does not explicitly define a symbolic name parameter. Instead, the short name of the container will be used in the Ecu Configuration Description to specify the symbolic name of the VALUE_NAME.
        integer DemOemID: origin=AUTOSAR_ECUC V1.0.0, symbolic-name-value=true  # Defines a unique ID of a data value.
      container DemOperationCycleList [0..*]  # Note hat this container definition does not explicitly define a symbolic name parameter. Instead, the short name of the container will be used in the Ecu Configuration Description to specify the symbolic name of the OperationCycleName.
      container DemViewList [0..255]  # This container contains the configuaration (parameters) for Views. Note hat this container definition does not explicitly define a symbolic name parameter. Instead, the short name of the container will be used in the Ecu Configuration Description to specify the symbolic name of the VIEW_NAME.
        integer ViewID: origin=AUTOSAR_ECUC V1.0.0, symbolic-name-value=true  # Unique Identifier of a View
      container XxxDemGetDataValByDataIdList [0..*]  # This container contains the configuaration (parameters) for GetDataValueByDataIdentifier functions.
        string PrefixGetDataValByDataIdList: origin=AUTOSAR_ECUC V1.1.0  # Unique prefix of a Xxx_DemTriggerOnEventStatus function. The prefix shall be replace the Xxx in function name. The prefixes shall be matching to available SC_C and BSW.
      container XxxDemGetExtDataRecordList [0..*]  # This container contains the configuaration (parameters) for GetDataValueByDataIdentifier functions.
        string PrefixGetExtDataRecord: origin=AUTOSAR_ECUC V1.1.0  # Unique prefix of a Xxx_DemTriggerOnEventStatus function. The prefix shall be replace the Xxx in function name. The prefixes shall be matching to available SC_C and BSW.
      container XxxDemTriggerOnEventStatusList [0..*]  # This container contains the configuaration (parameters) for DemTriggerOnEventStatus functions.
        string PrefixDemTrigOnEventStatusList: origin=AUTOSAR_ECUC V1.0.0  # Unique prefix of a Xxx_DemTriggerOnEventStatus function. The prefix shall be replace the Xxx in function name. The prefixes shall be matching to available SC_C and BSW.
