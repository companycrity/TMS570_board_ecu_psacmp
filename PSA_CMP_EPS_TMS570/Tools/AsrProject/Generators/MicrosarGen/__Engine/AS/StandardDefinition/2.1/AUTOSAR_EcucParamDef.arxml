[part 2 of 3: package /AUTOSAR]
AUTOSAR XML (schema 2.1.5)
package /AUTOSAR  (continued)
  module definition Det [0..1]  # Configuration of the Det (Development Error Tracer) module. There are NO standardized configuration parameters defined. All the configuration of the Det is done via vendor-specific configuration parameters which need to be defined inside this ModuleDef.
    container CommonPublishedInformation  # Common container, aggregated by all modules. It contains published information about vendor and versions.
      integer ArMajorVersion: implementation-config-class=PUBLISHED-INFORMATION, origin=AUTOSAR_ECUC V1.0.0  # Major version number of AUTOSAR specification on which the appropriate implementation is based on.
      integer ArMinorVersion: implementation-config-class=PUBLISHED-INFORMATION, origin=AUTOSAR_ECUC V1.0.0  # Minor version number of AUTOSAR specification on which the appropriate implementation is based on.
      integer ArPatchVersion: implementation-config-class=PUBLISHED-INFORMATION, origin=AUTOSAR_ECUC V1.0.0  # Patch level version number of AUTOSAR specification on which the appropriate implementation is based on.
      integer ModuleId: implementation-config-class=PUBLISHED-INFORMATION, origin=AUTOSAR_ECUC V1.0.0  # Module ID of this module from Module List
      integer SwMajorVersion: implementation-config-class=PUBLISHED-INFORMATION, origin=AUTOSAR_ECUC V1.0.0  # Major version number of the vendor specific implementation of the module. The numbering is vendor specific.
      integer SwMinorVersion: implementation-config-class=PUBLISHED-INFORMATION, origin=AUTOSAR_ECUC V1.0.0  # Minor version number of the vendor specific implementation of the module. The numbering is vendor specific.
      integer SwPatchVersion: implementation-config-class=PUBLISHED-INFORMATION, origin=AUTOSAR_ECUC V1.0.0  # Patch level version number of the vendor specific implementation of the module. The numbering is vendor specific.
      string VendorApiInfix [0..1]: implementation-config-class=PUBLISHED-INFORMATION, origin=AUTOSAR_ECUC V1.0.0  # In driver modules which can be instantiated several times on a single ECU, BSW00347 requires that the name of APIs is extended by the VendorId and a vendor specific name. This parameter is used to specify the vendor specific name. In total, the implementation specific name is generated as follows: <ModuleName>_>VendorId>_<VendorApiInfix><Api name from SWS>. E.g. assuming that the VendorId of the implementor is 123 and the implementer chose a VendorApiInfix of "v11r456" a api name Can_Write defined in the SWS will translate to Can_123_v11r456Write. This parameter is mandatory for all modules with upper multiplicity > 1. It shall not be used for modules with upper multiplicity =1.
      integer VendorId: implementation-config-class=PUBLISHED-INFORMATION, origin=AUTOSAR_ECUC V1.0.0  # Vendor ID of the dedicated implementation of this module according to the AUTOSAR vendor list
  module definition Dio [0..1]  # Configuration of the Dio (Digital IO) module.
    container CommonPublishedInformation  # Common container, aggregated by all modules. It contains published information about vendor and versions.
      integer ArMajorVersion: implementation-config-class=PUBLISHED-INFORMATION, origin=AUTOSAR_ECUC V1.0.0  # Major version number of AUTOSAR specification on which the appropriate implementation is based on.
      integer ArMinorVersion: implementation-config-class=PUBLISHED-INFORMATION, origin=AUTOSAR_ECUC V1.0.0  # Minor version number of AUTOSAR specification on which the appropriate implementation is based on.
      integer ArPatchVersion: implementation-config-class=PUBLISHED-INFORMATION, origin=AUTOSAR_ECUC V1.0.0  # Patch level version number of AUTOSAR specification on which the appropriate implementation is based on.
      integer ModuleId: implementation-config-class=PUBLISHED-INFORMATION, origin=AUTOSAR_ECUC V1.0.0  # Module ID of this module from Module List
      integer SwMajorVersion: implementation-config-class=PUBLISHED-INFORMATION, origin=AUTOSAR_ECUC V1.0.0  # Major version number of the vendor specific implementation of the module. The numbering is vendor specific.
      integer SwMinorVersion: implementation-config-class=PUBLISHED-INFORMATION, origin=AUTOSAR_ECUC V1.0.0  # Minor version number of the vendor specific implementation of the module. The numbering is vendor specific.
      integer SwPatchVersion: implementation-config-class=PUBLISHED-INFORMATION, origin=AUTOSAR_ECUC V1.0.0  # Patch level version number of the vendor specific implementation of the module. The numbering is vendor specific.
      string VendorApiInfix [0..1]: implementation-config-class=PUBLISHED-INFORMATION, origin=AUTOSAR_ECUC V1.0.0  # In driver modules which can be instantiated several times on a single ECU, BSW00347 requires that the name of APIs is extended by the VendorId and a vendor specific name. This parameter is used to specify the vendor specific name. In total, the implementation specific name is generated as follows: <ModuleName>_>VendorId>_<VendorApiInfix><Api name from SWS>. E.g. assuming that the VendorId of the implementor is 123 and the implementer chose a VendorApiInfix of "v11r456" a api name Can_Write defined in the SWS will translate to Can_123_v11r456Write. This parameter is mandatory for all modules with upper multiplicity > 1. It shall not be used for modules with upper multiplicity =1.
      integer VendorId: implementation-config-class=PUBLISHED-INFORMATION, origin=AUTOSAR_ECUC V1.0.0  # Vendor ID of the dedicated implementation of this module according to the AUTOSAR vendor list
    container DioGeneral  # General DIO module configuration parameters.
      boolean DioDevErrorDetect: origin=AUTOSAR_ECUC V1.0.0  # Switches the Development Error Detection and Notification ON or OFF
      boolean DioVersionInfoApi: origin=AUTOSAR_ECUC V1.0.0  # Adds / removes the service Dio_ GetVersionInfo() from the code.
    container DioPort [1..*]  # Configuration of individual DIO ports, consisting of channels and possible channel groups. Nothe that this container definition does not explicitly define a symbolic name parameter. Instead, the container's short name will be used in the Ecu Configuration Description to specify the symbolic name of the port.
      integer DioPortId: 0.., origin=AUTOSAR_ECUC V1.0.0, symbolic-name-value=true  # Numeric identifier of the DIO port. Not all MCU ports may be used for DIO, thus there may be "gaps" in the list of all IDs. This value will be assigned to the DIO port symbolic name (i.e. the SHORT-NAME of the DioPort container).
      container DioChannel [0..*]  # Configuration of an individual DIO channel. Besides a HW specific channel name which is typically fixed for a specific micro controller, additional symbolic names can be defined per channel. Note hat this container definition does not explicitly define a symbolic name parameter. Instead, the container's short name will be used in the Ecu Configuration Description to specify the symbolic name of the channel.
        integer DioChannelId: 0.., origin=AUTOSAR_ECUC V1.0.0, symbolic-name-value=true  # Channel Id of the DIO channel. This value will be assigned to the symbolic names.
      container DioChannelGroup [0..*]  # Definition and configuration of DIO channel groups. A channel group represents several adjoining DIO channels represented by a logical group. Note hat this container definition does not explicitly define a symbolic name parameter. Instead, the container's short name will be used in the Ecu Configuration Description to specify the symbolic name of the channel group.
        string DioChannelGroupIdentification: origin=AUTOSAR_ECUC V1.0.0, symbolic-name-value=true  # The DIO channel group is identified in DIO API by a pointer to a data structure (of type Dio_ChannelGroupType). That data structure contains the channel group information. This parameter contains the code fragment that has to be inserted in the API call of the calling module to get the address of the variable in memory which holds the channel group information. Example values are "&MyDioGroup1" or "&MyDioGroupArray[0]"
        integer DioPortMask: origin=AUTOSAR_ECUC V1.1.0  # This shall be the mask which defines the positions of the channel group. The data type depends on the port width
        derived integer DioPortOffset: origin=AUTOSAR_ECUC V1.1.0  # The position of the Channel Group on the port, counted from the LSB. This value can be derived from DioPortMask. calculationFormula = Position of the first bit of DioPortMask which is set to '1' counted from LSB
  module definition Ea [0..1]  # Configuration of the Ea (EEPROM Abstraction) module. The module shall abstract from the device specific addressing scheme and segmentation and provide the upper layers with a virtual addressing scheme and segmentation as well as a "virtually" unlimited number of erase cycles.
    container CommonPublishedInformation  # Common container, aggregated by all modules. It contains published information about vendor and versions.
      integer ArMajorVersion: implementation-config-class=PUBLISHED-INFORMATION, origin=AUTOSAR_ECUC V1.0.0  # Major version number of AUTOSAR specification on which the appropriate implementation is based on.
      integer ArMinorVersion: implementation-config-class=PUBLISHED-INFORMATION, origin=AUTOSAR_ECUC V1.0.0  # Minor version number of AUTOSAR specification on which the appropriate implementation is based on.
      integer ArPatchVersion: implementation-config-class=PUBLISHED-INFORMATION, origin=AUTOSAR_ECUC V1.0.0  # Patch level version number of AUTOSAR specification on which the appropriate implementation is based on.
      integer ModuleId: implementation-config-class=PUBLISHED-INFORMATION, origin=AUTOSAR_ECUC V1.0.0  # Module ID of this module from Module List
      integer SwMajorVersion: implementation-config-class=PUBLISHED-INFORMATION, origin=AUTOSAR_ECUC V1.0.0  # Major version number of the vendor specific implementation of the module. The numbering is vendor specific.
      integer SwMinorVersion: implementation-config-class=PUBLISHED-INFORMATION, origin=AUTOSAR_ECUC V1.0.0  # Minor version number of the vendor specific implementation of the module. The numbering is vendor specific.
      integer SwPatchVersion: implementation-config-class=PUBLISHED-INFORMATION, origin=AUTOSAR_ECUC V1.0.0  # Patch level version number of the vendor specific implementation of the module. The numbering is vendor specific.
      string VendorApiInfix [0..1]: implementation-config-class=PUBLISHED-INFORMATION, origin=AUTOSAR_ECUC V1.0.0  # In driver modules which can be instantiated several times on a single ECU, BSW00347 requires that the name of APIs is extended by the VendorId and a vendor specific name. This parameter is used to specify the vendor specific name. In total, the implementation specific name is generated as follows: <ModuleName>_>VendorId>_<VendorApiInfix><Api name from SWS>. E.g. assuming that the VendorId of the implementor is 123 and the implementer chose a VendorApiInfix of "v11r456" a api name Can_Write defined in the SWS will translate to Can_123_v11r456Write. This parameter is mandatory for all modules with upper multiplicity > 1. It shall not be used for modules with upper multiplicity =1.
      integer VendorId: implementation-config-class=PUBLISHED-INFORMATION, origin=AUTOSAR_ECUC V1.0.0  # Vendor ID of the dedicated implementation of this module according to the AUTOSAR vendor list
    container EaBlockConfiguration [1..*]  # Configuration of block specific parameters for the EEPROM abstraction module.
      integer EaBlockNumber: origin=AUTOSAR_ECUC V1.0.0, symbolic-name-value=true  # Number of logical block.
      integer EaBlockSize: 0..65535, origin=AUTOSAR_ECUC V1.0.0  # Size of a logical block in bytes.
      boolean EaImmediateData: origin=AUTOSAR_ECUC V1.0.0  # Marker for high priority data.
      integer EaNumberOfWriteCycles: origin=AUTOSAR_ECUC V1.0.0  # Number of write cycles required for this block.
      symbolic name reference EaDeviceIndex: origin=AUTOSAR_ECUC V1.0.0, destination=EepGeneral
    container EaGeneral  # General configuration of the EEPROM abstraction module. This container lists block independent configuration parameters.
      boolean EaDevErrorDetect: origin=AUTOSAR_ECUC V1.0.0  # Pre-processor switch to enable and disable development error detection.
      function name EaJobEndNotification: origin=AUTOSAR_ECUC V1.0.0  # Mapped to the job end notification routine provided by the upper layer module (NvM_JobEndNotification).
      function name EaJobErrorNotification: origin=AUTOSAR_ECUC V1.0.0  # Mapped to the job error notification routine provided by the upper layer module (NvM_JobErrorNotification).
      float EaMaximumBlockingTime: 0.., origin=AUTOSAR_ECUC V1.0.0  # The maximum time the EA module's API routines shall be blocked (delayed) by internal operations. (EA070) unit: [s] Note: Configuration generators need to convert this value into a hardware specific representation (ticks) when generating the modules configuration header file.
      boolean EaPollingMode: origin=AUTOSAR_ECUC V1.0.0  # Pre-processor switch to enable and disable the polling mode for this module.
      boolean EaVersionInfoApi: origin=AUTOSAR_ECUC V1.0.0  # Pre-processor switch to enable and disable the API to read out the modules version information.
      integer EaVirtualPageSize: 0..65535, origin=AUTOSAR_ECUC V1.0.0  # The size in bytes to which logical blocks shall be aligned.
    container EaPublishedInformation  # Additional published parameters not covered by CommonPublishedInformation container. Note that these parameters do not have any configuration class setting, since they are published information.
      integer EaBlockOverhead: origin=AUTOSAR_ECUC V1.0.0  # Management overhead per logical block in bytes. Note: If the management overhead depends on the block size or block location a formula has to be provided that allows the configurator to calculate the management overhead correctly.
      integer EaPageOverhead: origin=AUTOSAR_ECUC V1.0.0  # Management overhead per page in bytes. Note: If the management overhead depends on the block size or block location a formula has to be provided that allows the configurator to calculate the management overhead correctly.
  module definition EcuC [0..1]  # Virtual module to collect ECU Configuration specific / global configuration information.
    container PduCollection [0..1]  # Collection of all Pdu objects flowing through the Com-Stack.
      container Pdu [0..*]  # One Pdu flowing through the COM-Stack. This Pdu is used by all Com-Stack modules to aggree on referencing the same Pdu.
        container SystemTemplateRelation [0..1]  # Container to hold the relationship information between the Pdu and the FrameInstance in the System Template. If this container is not present the Pdu is only "local" to the ECU (e.g. to define the communication between the TPs, the PduR and Dcm).
          integer FrameOffset [0..1]: origin=AUTOSAR_ECUC V1.0.0  # If the Pdu is only a part of a bigger Frame on the bus (e.g. FlexRay), this parameter holds the offset where this Pdu starts within the Frame. In bits.
          instance reference FrameInstanceRef: origin=AUTOSAR_ECUC V1.0.0, destination-context=CommunicationMatrixInstance, destination-type=FrameInstance  # Reference to the System Template's FrameInstance this Pdu is contained in.
  module definition EcuM [0..1]  # Configuration of the EcuM (ECU State Manager) module.
    container CommonPublishedInformation  # Common container, aggregated by all modules. It contains published information about vendor and versions.
      integer ArMajorVersion: implementation-config-class=PUBLISHED-INFORMATION, origin=AUTOSAR_ECUC V1.0.0  # Major version number of AUTOSAR specification on which the appropriate implementation is based on.
      integer ArMinorVersion: implementation-config-class=PUBLISHED-INFORMATION, origin=AUTOSAR_ECUC V1.0.0  # Minor version number of AUTOSAR specification on which the appropriate implementation is based on.
      integer ArPatchVersion: implementation-config-class=PUBLISHED-INFORMATION, origin=AUTOSAR_ECUC V1.0.0  # Patch level version number of AUTOSAR specification on which the appropriate implementation is based on.
      integer ModuleId: implementation-config-class=PUBLISHED-INFORMATION, origin=AUTOSAR_ECUC V1.0.0  # Module ID of this module from Module List
      integer SwMajorVersion: implementation-config-class=PUBLISHED-INFORMATION, origin=AUTOSAR_ECUC V1.0.0  # Major version number of the vendor specific implementation of the module. The numbering is vendor specific.
      integer SwMinorVersion: implementation-config-class=PUBLISHED-INFORMATION, origin=AUTOSAR_ECUC V1.0.0  # Minor version number of the vendor specific implementation of the module. The numbering is vendor specific.
      integer SwPatchVersion: implementation-config-class=PUBLISHED-INFORMATION, origin=AUTOSAR_ECUC V1.0.0  # Patch level version number of the vendor specific implementation of the module. The numbering is vendor specific.
      string VendorApiInfix [0..1]: implementation-config-class=PUBLISHED-INFORMATION, origin=AUTOSAR_ECUC V1.0.0  # In driver modules which can be instantiated several times on a single ECU, BSW00347 requires that the name of APIs is extended by the VendorId and a vendor specific name. This parameter is used to specify the vendor specific name. In total, the implementation specific name is generated as follows: <ModuleName>_>VendorId>_<VendorApiInfix><Api name from SWS>. E.g. assuming that the VendorId of the implementor is 123 and the implementer chose a VendorApiInfix of "v11r456" a api name Can_Write defined in the SWS will translate to Can_123_v11r456Write. This parameter is mandatory for all modules with upper multiplicity > 1. It shall not be used for modules with upper multiplicity =1.
      integer VendorId: implementation-config-class=PUBLISHED-INFORMATION, origin=AUTOSAR_ECUC V1.0.0  # Vendor ID of the dedicated implementation of this module according to the AUTOSAR vendor list
    container EcuMConfiguration  # This container contains the configuration (parameters) of the ECU State Manager
      integer EcuMConfigConsistencyHash: origin=AUTOSAR_ECUC V1.1.0  # A hash value generated across all pre-compile and link-time parameters of all BSW modules. This hash value is compared against a field in the EcuM_ConfigType and hence allows checking the consistency of the entire configuration.
      integer EcuMDefaultShutdownTarget: origin=AUTOSAR_ECUC V1.0.0  # Structure of - EcuM_StateType - uint8 The integer number is the mode qualifier for the default target. It is an index into the ECUM_SLEEP_MODES list. See also parameters of the EcuM_SelectShutdownTarget service.
      integer EcuMNvramWriteallTimeout: origin=AUTOSAR_ECUC V1.1.0  # Period given in milliseconds for which the ECU State Manager will wait until it considers a write all job of the NVRAM Manager as failed
      integer EcuMRunSelfRequestPeriod: origin=AUTOSAR_ECUC V1.0.0  # Period given in milliseconds for which the ECU State Manager will request itself to stay in RUN state when RUN state just has been entered.
      integer EcuMSleepActivityPeriod: origin=AUTOSAR_ECUC V1.1.0  # Period of the EcuM_SleepActivity callout. The period is given in milliseconds
      reference def EcuMGptInitConfig: lower-multiplicity=1, upper-multiplicity=1, origin=AUTOSAR_ECUC V1.1.0, destination=GptChannelConfigSet  # Init configuration for the General Purpose Timer
      reference def EcuMMcuInitConfig: lower-multiplicity=1, upper-multiplicity=1, origin=AUTOSAR_ECUC V1.1.0, destination=McuModuleConfiguration  # Init configuration for the MCU Driver
      reference def EcuMWdgMInitConfig: lower-multiplicity=1, upper-multiplicity=1, origin=AUTOSAR_ECUC V1.0.0, destination=WdgMConfigEntities  # EcuM2722: Init configuration for the Watchdog Manager EcuM2681: The configuration shall reference the startup mode of the Watchdog Manager
      symbolic name reference EcuMDefaultAppMode: origin=AUTOSAR_ECUC V1.0.0, destination=OsAppMode  # The default application mode loaded when the ECU comes out of reset.
      container EcuMDriverInitListOne [0..1]  # Container of module Initialisation List One. This container holds a list of module IDs that will be initialised under a predefined set of circumstances. When the predefined conditions are met, each module in the list will be called for initialisation in the list order. All modules in this list are initilialised before the OS is started and so these modules require no OS support.
        container EcuMDriverInitItem [1..*]  # This container describes a structure with the following items as its elements. EcuM_DriverInitItems are concatenated to build up a list.
          string EcuMInitConfiguration: origin=AUTOSAR_ECUC V1.0.0  # This paramter contains pointer to the init structure of the corresponding BSW module
          string EcuMModuleID: origin=AUTOSAR_ECUC V1.0.0  # An item in an init list is referenced by its module ID.
      container EcuMDriverInitListTwo [0..1]  # Container of module Initialisation List One. This container holds a list of module IDs that will be initialised under a predefined set of circumstances. When the predefined conditions are met, each module in the list will be called for initialisation in the list order. All modules in this list are initilialised after the OS is started and so these modules may use OS support.
        container EcuMDriverInitItem [1..*]  # This container describes a structure with the following items as its elements. EcuM_DriverInitItems are concatenated to build up a list.
          string EcuMInitConfiguration: origin=AUTOSAR_ECUC V1.0.0  # This paramter contains pointer to the init structure of the corresponding BSW module
          string EcuMModuleID: origin=AUTOSAR_ECUC V1.0.0  # An item in an init list is referenced by its module ID.
      container EcuMDriverRestartList [0..1]  # List of module IDs. EcuM2719: A configuration tool shall fill the callout EcuM_AL_DriverRestart with initialization calls to the listed drivers in the order in which they occur in the list. EcuM2720: Entries in this list must appear in the same order as in the combined list of EcuM_DriverInitListOne and EcuM_DriverInitListTwo. This list may be a real subset though. In all other cases, the generation tool shall report an error. The included container has the same structure as EcuM_DriverInitItem
        container EcuMDriverInitItem [1..*]  # This container describes a structure with the following items as its elements. EcuM_DriverInitItems are concatenated to build up a list.
          string EcuMInitConfiguration: origin=AUTOSAR_ECUC V1.0.0  # This paramter contains pointer to the init structure of the corresponding BSW module
          string EcuMModuleID: origin=AUTOSAR_ECUC V1.0.0  # An item in an init list is referenced by its module ID.
      container EcuMSleepMode [1..*]  # List of the configured sleep modes
        integer EcuMSleepModeId: origin=AUTOSAR_ECUC V1.1.0  # This parameter is part of the SleepModeConfiguration as defined in the SWS. It represents the index to configuration tables of MCU driver of the EcuM_SleepModeConfigType.
        string EcuMSleepModeName: origin=AUTOSAR_ECUC V1.0.0, symbolic-name-value=true  # This item allows to give symbolic names to the different sleep modes. Multiple names can be given to one sleep mode. This definition is application dependent. In combination with the hardware specific EcuM_SleepMode, this allows to port SW-Cs across different ECUs.
        integer EcuMWakupSourceMask: origin=AUTOSAR_ECUC V1.1.0  # This parameter is part of the SleepModeConfiguration as defined in the SWS. This mask defines the wakeup sources to be enabled for the following sleep period.
      container EcuMTTII [0..*]  # This container describes a structure and the following configuration items describe its elements. This structures are concatenated to build a list as indicated by Figure 27 - Configuration Container Diagram. The list must contain at least on element when ECUM_TTII_ENABLED is set to true.
        integer EcuMDivisor: origin=AUTOSAR_ECUC V1.0.0  # A lookup table to find the divisor preload value. The key is the associated sleep mode.
        string EcuMSleepModeName: origin=AUTOSAR_ECUC V1.0.0  # This configuration parameter is a human readable name for a sleep mode which may only be used by the configuration tool. For imlementation on the ECU, this parameter may be dropped and replaced by a generated list index of EcuM_SleepMode. The SleepModeName (or the index, if more suitable for an ECU implementation) is used to reference the EcuM_SleepMode.
        string EcuMSuccessor: origin=AUTOSAR_ECUC V1.1.0  # This item is a reference to the next sleep mode in the TTII protocol. The representation here is human readable but may be replaced by an index for efficient implementation on an ECU
      container EcuMUserConfig [1..*]  # A list of identifiers that are needed to refer to a software component or another appropriate entity in the system which is designated to request the RUN state. Application requestors refer to entities above RTE, system requestors to entities below RTE (e.g. Communication Manager).
        integer EcuMUser: origin=AUTOSAR_ECUC V1.0.0
      container EcuMWakeupSourceConfig [1..*]  # List of configuration items for the wakeup sources
        integer EcuMResetReason: origin=AUTOSAR_ECUC V1.0.0  # This parameter describes the mapping of reset reasons detected by the MCU driver into ECU State Manager types
        integer EcuMValidationTimeout: origin=AUTOSAR_ECUC V1.0.0  # The validation timeout (period for which the ECU State Manager will wait for the validation of a wakeup event) can be defined for each wakeup source independently. The timeout is specified in milliseconds.
        integer EcuMWakeupSource: origin=AUTOSAR_ECUC V1.0.0  # The key entry
        string EcuMWakeupSourceName: origin=AUTOSAR_ECUC V1.0.0  # A name to identify this source
        string EcuWakeupSourceName: origin=AUTOSAR_ECUC V1.0.0, symbolic-name-value=true
        symbolic name reference EcuMComChannel: origin=AUTOSAR_ECUC V1.0.0, destination=ComMChannel  # Reference to EcuMComChannel where ComMChannelId is used as symbolic Name value in the Range 0 - 254. 255 (default) means wakeup source is not a ComChannel.
    container EcuMGeneral  # This container holds the general, pre-compile configuration parameters
      boolean EcuMDevErrorDetect: origin=AUTOSAR_ECUC V1.0.0  # If false, no debug artifacts (e.g. calls to DET) shall remain in the executable object. Initialization of DET, however is controlled by configuration of optional BSW modules.
      boolean EcuMIncludeDem: origin=AUTOSAR_ECUC V1.0.0  # If enabled and NVRAM manager is disabled, then an error shall be flagged by the configuration tool
      boolean EcuMIncludeDet: origin=AUTOSAR_ECUC V1.0.0  # If defined, the according BSW module will be initialized by the ECU State Manager
      boolean EcuMIncludeNvramMgr: origin=AUTOSAR_ECUC V1.0.0  # If NVRAM manager is enabled but both flash and EEPROM driver are missing, then an error shall be flagged by the configuration tool
      boolean EcuMIncludeWdgM: origin=AUTOSAR_ECUC V1.0.0  # This configuration parameter defines whether the watchdog manager is supported by EcuM. This feature is presented for development purpose to compile out the watchdog manager in the early debugging phase
      boolean EcuMTTIIEnabled: origin=AUTOSAR_ECUC V1.0.0  # Boolean switch to enable / disable TTII
      string EcuMTTIIWakupSource: origin=AUTOSAR_ECUC V1.1.0  # This configuration parameter references the first sleep mode to be used by TTII when TTII is activated after a RUN mode. EcuM2785: Whenever RUN mode is reached, the TTII protocol shall be reset to use the wakeup source referenced by this parameter. This configuration parameter is a human readable name for a TTII wakeup source which is only needed by the configuration tool. For imlementation on the ECU, this parameter may be dropped and replaced by a generated list index of EcuM_TTII.
      boolean EcuMVersionInfoApi: origin=AUTOSAR_ECUC V1.0.0  # Switches the version info API on or off
  module definition Eep [0..*]  # Configuration of the Eep (internal or external EEPROM driver) module. Its multiplicity describes the number of EEPROM drivers present, so there will be one container for each EEPROM driver in the ECUC template. When no EEPROM driver is present then the multiplicity is 0.
    container CommonPublishedInformation  # Common container, aggregated by all modules. It contains published information about vendor and versions.
      integer ArMajorVersion: implementation-config-class=PUBLISHED-INFORMATION, origin=AUTOSAR_ECUC V1.0.0  # Major version number of AUTOSAR specification on which the appropriate implementation is based on.
      integer ArMinorVersion: implementation-config-class=PUBLISHED-INFORMATION, origin=AUTOSAR_ECUC V1.0.0  # Minor version number of AUTOSAR specification on which the appropriate implementation is based on.
      integer ArPatchVersion: implementation-config-class=PUBLISHED-INFORMATION, origin=AUTOSAR_ECUC V1.0.0  # Patch level version number of AUTOSAR specification on which the appropriate implementation is based on.
      integer ModuleId: implementation-config-class=PUBLISHED-INFORMATION, origin=AUTOSAR_ECUC V1.0.0  # Module ID of this module from Module List
      integer SwMajorVersion: implementation-config-class=PUBLISHED-INFORMATION, origin=AUTOSAR_ECUC V1.0.0  # Major version number of the vendor specific implementation of the module. The numbering is vendor specific.
      integer SwMinorVersion: implementation-config-class=PUBLISHED-INFORMATION, origin=AUTOSAR_ECUC V1.0.0  # Minor version number of the vendor specific implementation of the module. The numbering is vendor specific.
      integer SwPatchVersion: implementation-config-class=PUBLISHED-INFORMATION, origin=AUTOSAR_ECUC V1.0.0  # Patch level version number of the vendor specific implementation of the module. The numbering is vendor specific.
      string VendorApiInfix [0..1]: implementation-config-class=PUBLISHED-INFORMATION, origin=AUTOSAR_ECUC V1.0.0  # In driver modules which can be instantiated several times on a single ECU, BSW00347 requires that the name of APIs is extended by the VendorId and a vendor specific name. This parameter is used to specify the vendor specific name. In total, the implementation specific name is generated as follows: <ModuleName>_>VendorId>_<VendorApiInfix><Api name from SWS>. E.g. assuming that the VendorId of the implementor is 123 and the implementer chose a VendorApiInfix of "v11r456" a api name Can_Write defined in the SWS will translate to Can_123_v11r456Write. This parameter is mandatory for all modules with upper multiplicity > 1. It shall not be used for modules with upper multiplicity =1.
      integer VendorId: implementation-config-class=PUBLISHED-INFORMATION, origin=AUTOSAR_ECUC V1.0.0  # Vendor ID of the dedicated implementation of this module according to the AUTOSAR vendor list
    container EepGeneral  # Container for general configuration parameters of the EEPROM driver. These parameters are always pre-compile.
      boolean EepDevErrorDetect: origin=AUTOSAR_ECUC V1.0.0, default-value=true  # Switches the Development Error Detection and Notification ON or OFF.
      integer EepDriverIndex: 0..254, origin=AUTOSAR_ECUC V1.0.0, symbolic-name-value=true  # Index of the driver, used by EA.
      boolean EepUseInterrupts: origin=AUTOSAR_ECUC V1.0.0, default-value=false  # Switches to activate or deactivate interrupt controlled job processing.
      boolean EepVersionInfoApi: origin=AUTOSAR_ECUC V1.0.0, default-value=false  # Switches the Eep_GetVersionInfo function ON or OFF.
      boolean EepWriteCycleReduction: origin=AUTOSAR_ECUC V1.0.0, default-value=false  # Switches to activate or deactivate write cycle reduction (EEPROM value is read and compared before being overwritten).
    container EepInitConfiguration  # Container for runtime configuration parameters of the EEPROM driver.
      integer EepBaseAddress: 0..4294967295, origin=AUTOSAR_ECUC V1.0.0  # This parameter is the EEPROM device base address.
      enumeration EepDefaultMode: {EepModeFast, EepModeSlow}, origin=AUTOSAR_ECUC V1.0.0, default-value="EepModeSlow"  # This parameter is the default EEPROM device mode after initialization.
      integer EepFastReadBlockSize: 0..4294967295, origin=AUTOSAR_ECUC V1.0.0  # This parameter is the number of bytes read within one job processing cycle in fast mode.
      integer EepFastWriteBlockSize [0..1]: 0..4294967295, origin=AUTOSAR_ECUC V1.0.0  # This parameter is the number of bytes written within one job processing cycle in fast mode.
      float EepJobCallCycle: origin=AUTOSAR_ECUC V1.0.0  # This parameter is the call cycle of the job processing function during write/erase operations. Unit: [s]
      function name EepJobEndNotification: origin=AUTOSAR_ECUC V1.0.0  # This parameter is a reference to a callback function for positive job result (see EEP045).
      function name EepJobErrorNotification: origin=AUTOSAR_ECUC V1.0.0  # This parameter is a reference to a callback function for negative job result (see EEP046).
      integer EepNormalReadBlockSize: 0..4294967295, origin=AUTOSAR_ECUC V1.0.0  # This parameter is the number of bytes read within one job processing cycle in normal mode.
      integer EepNormalWriteBlockSize [0..1]: 0..4294967295, origin=AUTOSAR_ECUC V1.0.0  # Number of bytes written within one job processing cycle in normal mode. This parameter is optional and only available if the hardware allows configuration. Whether this feature is supported by the EEP driver can be determined through published information in the BSW Module Description Template. The multiplicity of this parameter is 0 if this option is not supported by the driver.
      integer EepSize: 0..4294967295, origin=AUTOSAR_ECUC V1.0.0  # This parameter is the used size of EEPROM device in bytes.
      container EepExternalDriver [0..1]  # This container is present for external EEPROM drivers only. Internal EEPROM drivers do not use the parameter listed in this container, hence its multiplicity is 0 for internal drivers.
        symbolic name reference Spi_Reference: origin=AUTOSAR_ECUC V1.0.0, destination=SpiSequence  # Reference to SPI sequence (required for external EEPROM drivers).
    container EepPublishedInformation  # Additional published parameters not covered by CommonPublishedInformation container. Note that these parameters do not have any configuration class setting, since they are published information.
      integer EepAllowedWriteCycles: implementation-config-class=PUBLISHED-INFORMATION, origin=AUTOSAR_ECUC V1.0.0  # Specified maximum number of write cycles under worst case conditions of specific EEPROM hardware (e.g. +90°C)
      float EepEraseTime: implementation-config-class=PUBLISHED-INFORMATION, origin=AUTOSAR_ECUC V1.0.0  # Time for erasing one EEPROM data unit.
      integer EepEraseUnitSize: implementation-config-class=PUBLISHED-INFORMATION, origin=AUTOSAR_ECUC V1.0.0  # Size of smallest erasable EEPROM data unit in bytes.
      integer EepEraseValue: implementation-config-class=PUBLISHED-INFORMATION, origin=AUTOSAR_ECUC V1.0.0  # Value of an erased EEPROM cell.
      integer EepMinimumAddressType: implementation-config-class=PUBLISHED-INFORMATION, origin=AUTOSAR_ECUC V1.0.0  # Minimum expected size of Eep_AddressType.
      integer EepMinimumLengthType: implementation-config-class=PUBLISHED-INFORMATION, origin=AUTOSAR_ECUC V1.0.0  # Minimum expected size of Eep_LengthType.
      integer EepReadUnitSize: implementation-config-class=PUBLISHED-INFORMATION, origin=AUTOSAR_ECUC V1.0.0  # Size of smallest readable EEPROM data unit in bytes.
      integer EepTotalSize: implementation-config-class=PUBLISHED-INFORMATION, origin=AUTOSAR_ECUC V1.0.0  # Total size of EEPROM in bytes.
      float EepWriteTime: implementation-config-class=PUBLISHED-INFORMATION, origin=AUTOSAR_ECUC V1.0.0  # Time for writing one EEPROM data unit.
      integer EepWriteUnitSize: implementation-config-class=PUBLISHED-INFORMATION, origin=AUTOSAR_ECUC V1.0.0  # Size of smallest writeable EEPROM data unit in bytes.
  module definition Fee [0..1]  # Configuration of the Fee (Flash EEPROM Emulation) module.
    container CommonPublishedInformation  # Common container, aggregated by all modules. It contains published information about vendor and versions.
      integer ArMajorVersion: implementation-config-class=PUBLISHED-INFORMATION, origin=AUTOSAR_ECUC V1.0.0  # Major version number of AUTOSAR specification on which the appropriate implementation is based on.
      integer ArMinorVersion: implementation-config-class=PUBLISHED-INFORMATION, origin=AUTOSAR_ECUC V1.0.0  # Minor version number of AUTOSAR specification on which the appropriate implementation is based on.
      integer ArPatchVersion: implementation-config-class=PUBLISHED-INFORMATION, origin=AUTOSAR_ECUC V1.0.0  # Patch level version number of AUTOSAR specification on which the appropriate implementation is based on.
      integer ModuleId: implementation-config-class=PUBLISHED-INFORMATION, origin=AUTOSAR_ECUC V1.0.0  # Module ID of this module from Module List
      integer SwMajorVersion: implementation-config-class=PUBLISHED-INFORMATION, origin=AUTOSAR_ECUC V1.0.0  # Major version number of the vendor specific implementation of the module. The numbering is vendor specific.
      integer SwMinorVersion: implementation-config-class=PUBLISHED-INFORMATION, origin=AUTOSAR_ECUC V1.0.0  # Minor version number of the vendor specific implementation of the module. The numbering is vendor specific.
      integer SwPatchVersion: implementation-config-class=PUBLISHED-INFORMATION, origin=AUTOSAR_ECUC V1.0.0  # Patch level version number of the vendor specific implementation of the module. The numbering is vendor specific.
      string VendorApiInfix [0..1]: implementation-config-class=PUBLISHED-INFORMATION, origin=AUTOSAR_ECUC V1.0.0  # In driver modules which can be instantiated several times on a single ECU, BSW00347 requires that the name of APIs is extended by the VendorId and a vendor specific name. This parameter is used to specify the vendor specific name. In total, the implementation specific name is generated as follows: <ModuleName>_>VendorId>_<VendorApiInfix><Api name from SWS>. E.g. assuming that the VendorId of the implementor is 123 and the implementer chose a VendorApiInfix of "v11r456" a api name Can_Write defined in the SWS will translate to Can_123_v11r456Write. This parameter is mandatory for all modules with upper multiplicity > 1. It shall not be used for modules with upper multiplicity =1.
      integer VendorId: implementation-config-class=PUBLISHED-INFORMATION, origin=AUTOSAR_ECUC V1.0.0  # Vendor ID of the dedicated implementation of this module according to the AUTOSAR vendor list
    container FeeBlockConfiguration [1..*]  # Configuration of block specific parameters for the Flash EEPROM Emulation module.
      integer FeeBlockNumber: origin=AUTOSAR_ECUC V1.0.0, symbolic-name-value=true  # Number of logical block.
      integer FeeBlockSize: 0..65535, origin=AUTOSAR_ECUC V1.0.0  # Size of a logical block in bytes.
      boolean FeeImmediateData: origin=AUTOSAR_ECUC V1.0.0  # Marker for high priority data.
      integer FeeNumberOfWriteCycles: origin=AUTOSAR_ECUC V1.0.0  # Number of write cycles required for this block.
      symbolic name reference FeeDeviceIndex: origin=AUTOSAR_ECUC V1.0.0, destination=FlsGeneral
    container FeeGeneral  # Container for general parameters. These parameters are not specific to a block.
      boolean FeeDevErrorDetect: origin=AUTOSAR_ECUC V1.0.0  # Pre-processor switch to enable and disable development error detection
      function name FeeJobEndNotification: origin=AUTOSAR_ECUC V1.0.0  # Mapped to the job end notification routine provided by the upper layer module (NvM_JobEndNotification).
      function name FeeJobErrorNotification: origin=AUTOSAR_ECUC V1.0.0  # Mapped to the job error notification routine provided by the upper layer module (NvM_JobErrorNotification).
      boolean FeePollingMode: origin=AUTOSAR_ECUC V1.0.0  # Pre-processor switch to enable and disable the polling mode for this module.
      boolean FeeVersionInfoApi: origin=AUTOSAR_ECUC V1.0.0  # Pre-processor switch to enable and disable the API to read out the modules version information.
      integer FeeVirtualPageSize: 0..65535, origin=AUTOSAR_ECUC V1.0.0  # The size in bytes to which logical blocks shall be aligned.
    container FeePublishedInformation  # Additional published parameters not covered by CommonPublishedInformation container. Note that these parameters do not have any configuration class setting, since they are published information.
      integer FeeBlockOverhead: origin=AUTOSAR_ECUC V1.0.0  # Management overhead per logical block in bytes. Note: If the management overhead depends on the block size or block location a formula has to be provided that allows the configurator to calculate the management overhead correctly.
      float FeeMaximumBlockingTime: 0.., origin=AUTOSAR_ECUC V1.0.0  # The maximum time the FEE module's API routines shall be blocked (delayed) by internal operations. Note: Internal operations in that case means operations that are not explicitly invoked from the upper layer module but need to be handled for proper operation of this module or the underlying memory driver. unit: [s] Configuration generators may need to convert this value into a hardware specific representation (e.g. timer ticks).
      integer FeePageOverhead: origin=AUTOSAR_ECUC V1.0.0  # Management overhead per page in bytes. Note: If the management overhead depends on the block size or block location a formula has to be provided that allows the configurator to calculate the management overhead correctly.
  module definition Fim [0..1]  # Configuration of the Fim (Function Inhibition Manager) module.
    container CommonPublishedInformation  # Common container, aggregated by all modules. It contains published information about vendor and versions.
      integer ArMajorVersion: implementation-config-class=PUBLISHED-INFORMATION, origin=AUTOSAR_ECUC V1.0.0  # Major version number of AUTOSAR specification on which the appropriate implementation is based on.
      integer ArMinorVersion: implementation-config-class=PUBLISHED-INFORMATION, origin=AUTOSAR_ECUC V1.0.0  # Minor version number of AUTOSAR specification on which the appropriate implementation is based on.
      integer ArPatchVersion: implementation-config-class=PUBLISHED-INFORMATION, origin=AUTOSAR_ECUC V1.0.0  # Patch level version number of AUTOSAR specification on which the appropriate implementation is based on.
      integer ModuleId: implementation-config-class=PUBLISHED-INFORMATION, origin=AUTOSAR_ECUC V1.0.0  # Module ID of this module from Module List
      integer SwMajorVersion: implementation-config-class=PUBLISHED-INFORMATION, origin=AUTOSAR_ECUC V1.0.0  # Major version number of the vendor specific implementation of the module. The numbering is vendor specific.
      integer SwMinorVersion: implementation-config-class=PUBLISHED-INFORMATION, origin=AUTOSAR_ECUC V1.0.0  # Minor version number of the vendor specific implementation of the module. The numbering is vendor specific.
      integer SwPatchVersion: implementation-config-class=PUBLISHED-INFORMATION, origin=AUTOSAR_ECUC V1.0.0  # Patch level version number of the vendor specific implementation of the module. The numbering is vendor specific.
      string VendorApiInfix [0..1]: implementation-config-class=PUBLISHED-INFORMATION, origin=AUTOSAR_ECUC V1.0.0  # In driver modules which can be instantiated several times on a single ECU, BSW00347 requires that the name of APIs is extended by the VendorId and a vendor specific name. This parameter is used to specify the vendor specific name. In total, the implementation specific name is generated as follows: <ModuleName>_>VendorId>_<VendorApiInfix><Api name from SWS>. E.g. assuming that the VendorId of the implementor is 123 and the implementer chose a VendorApiInfix of "v11r456" a api name Can_Write defined in the SWS will translate to Can_123_v11r456Write. This parameter is mandatory for all modules with upper multiplicity > 1. It shall not be used for modules with upper multiplicity =1.
      integer VendorId: implementation-config-class=PUBLISHED-INFORMATION, origin=AUTOSAR_ECUC V1.0.0  # Vendor ID of the dedicated implementation of this module according to the AUTOSAR vendor list
    container FimEventSummary [0..*]  # The summarized EventId definition record consists of a summarized event ID and a specific EventId. This record means that a particular FID that has to be disabled in case of summarized event (defined above) is to be disabled in any of the specific events. A possible solution could be assigning events as summarized events along with a list of specific events. During the configuration process the summarized event substitutes the referenced single events. However, it is not outlined how this requirement is solved - whether by configuration process or by implementation within the FIM. The FIM configuration tool could also build up a suitable data structure for summarized events and deal with it in the FIM implementation.
      container FimInputSummarizedEventId  # The configuration parameter is used as an input for a summarized event.
        symbolic name reference FimInputSumEventRef: origin=AUTOSAR_ECUC V1.0.0, destination=DemEventParameter
      container FimOutputSummarizedEventId  # The configuration parameter is used as an output for a summarized event.
        symbolic name reference FimOutputSumEventRef: origin=AUTOSAR_ECUC V1.0.0, destination=FimSummaryEventId
    container FimFid [0..*]  # This container includes symbolic names of all FIDs.
      integer FimFuntionId: 0..65535, origin=AUTOSAR_ECUC V1.0.0, symbolic-name-value=true  # The configuration parameter is used as an ID which represents a functionality. FIM_FUNCTION_ID is the unique identifier assigned during FIM configuration.
    container FimGeneral
      boolean FimCyclicEventEvaluation: origin=AUTOSAR_ECUC V1.0.0  # This configuration parameter specifies whether the evaluation of DEM events is performed by the FIM cyclically or the DEM informs FIM about changes of event states. ON: FIM cyclically evaluates event states in the DEM. OFF: DEM informs FIM about changes of event states.
      boolean FimDataFixed: origin=AUTOSAR_ECUC V1.0.0  # Enable or disable calibration of inhibit relations The scope of the parameter is to meet the requirement (FIM008) to have the option to calibrate inhibit data on the one hand side and also to provide the option to protect inhibit data for consistency reasons.
      boolean FimDevErrorDetect: origin=AUTOSAR_ECUC V1.0.0  # This configuration parameter is used to switch on or to switch off the detection of development errors during development.
      integer FimMaxEventFidLinks: 1..65535, origin=AUTOSAR_ECUC V1.0.0  # This configuration parameter specifies the total maximum number of links between EventIds and FIDs.
      integer FimMaxEventsPerFid: 1..65535, origin=AUTOSAR_ECUC V1.0.0  # This configuration parameter specifies the maximum number of EventIds that can be linked to a single FID.
      integer FimMaxFidsPerEvent: 1..65535, origin=AUTOSAR_ECUC V1.0.0  # This configuration parameter specifies the maximum number of FIDs that can be linked to a single event.
      integer FimMaxSummaryEvents: 0..65535, origin=AUTOSAR_ECUC V1.0.0  # This configuration parameter specifies the maximum number of summarized events that can be configured.
      integer FimMaxSummaryLinks: 1..65535, origin=AUTOSAR_ECUC V1.0.0  # This configuration parameter specifies the total maximum number of links between EventIds and FIDs plus the number of links between EventIds and summarized events.
      integer FimMaxTotalLinks: 1..65535, origin=AUTOSAR_ECUC V1.0.0  # This configuration parameter specifies the total maximum number of links between EventIds and FIDs plus the number of links between EventIds and summarized events.
      boolean FimVersionInfoApi: origin=AUTOSAR_ECUC V1.0.0  # This configuration parameter is used to switch on or to switch off the API to get the version information.
    container FimInhibitionConfiguration [0..*]  # This container includes all configuration parameters concerning the relationship between event and FID.
      enumeration FimInhInhibitionMask: {FIM_LAST_FAILED, FIM_NOT_TESTED, FIM_TESTED, FIM_TESTED_AND_FAILED}, origin=AUTOSAR_ECUC V1.0.0  # The configuration parameter is used to specify the inhibition mask for an event - FID relation.
      container FimInhEventId  # The configuration parameter is used for an existing DEM event and summarized events as well.
        choice container FimInhRefChoice
          container FimInhChoiceDemRef
            symbolic name reference FimInhEventRef: origin=AUTOSAR_ECUC V1.0.0, destination=DemEventParameter
          container FimInhChoiceSumRef
            symbolic name reference FimInhSumRef: origin=AUTOSAR_ECUC V1.0.0, destination=FimSummaryEventId
      container FimInhFunctionId  # The configuration parameter is used as an ID which represents a functionality. FIM_INH_FUNCTION_ID is the FID to be considered in a particular inhibit relation EventId-FID-Mask.
        reference def FimInhFunctionRef: lower-multiplicity=1, upper-multiplicity=1, origin=AUTOSAR_ECUC V1.0.0, destination=FimFid
    container FimSummaryEventId [0..*]  # The summarized EventId definition record defines the existence of a summarized event with a specific name. This summarized event can be referenced in the EventSummary (as FIM_OUTPUT_SUMMARIZED_EVENT) and Inhibition configuration (as FIM_INH_EVENT_ID).
      integer FimEventSumId: 0..65535, origin=AUTOSAR_ECUC V1.1.0, symbolic-name-value=true  # The summarized EventId definition record defines the existence of a summarized event with a specific name. This summarized event can be referenced in the EventSummary (as FIM_OUTPUT_SUMMARIZED_EVENT) and Inhibition configuration (as FIM_INH_EVENT_ID).
  module definition Fls [0..*]  # Configuration of the Fls (internal or external flash driver) module. Its multiplicity describes the number of flash drivers present, so there will be one container for each flash driver in the ECUC template. When no flash driver is present then the multiplicity is 0.
    container CommonPublishedInformation  # Common container, aggregated by all modules. It contains published information about vendor and versions.
      integer ArMajorVersion: implementation-config-class=PUBLISHED-INFORMATION, origin=AUTOSAR_ECUC V1.0.0  # Major version number of AUTOSAR specification on which the appropriate implementation is based on.
      integer ArMinorVersion: implementation-config-class=PUBLISHED-INFORMATION, origin=AUTOSAR_ECUC V1.0.0  # Minor version number of AUTOSAR specification on which the appropriate implementation is based on.
      integer ArPatchVersion: implementation-config-class=PUBLISHED-INFORMATION, origin=AUTOSAR_ECUC V1.0.0  # Patch level version number of AUTOSAR specification on which the appropriate implementation is based on.
      integer ModuleId: implementation-config-class=PUBLISHED-INFORMATION, origin=AUTOSAR_ECUC V1.0.0  # Module ID of this module from Module List
      integer SwMajorVersion: implementation-config-class=PUBLISHED-INFORMATION, origin=AUTOSAR_ECUC V1.0.0  # Major version number of the vendor specific implementation of the module. The numbering is vendor specific.
      integer SwMinorVersion: implementation-config-class=PUBLISHED-INFORMATION, origin=AUTOSAR_ECUC V1.0.0  # Minor version number of the vendor specific implementation of the module. The numbering is vendor specific.
      integer SwPatchVersion: implementation-config-class=PUBLISHED-INFORMATION, origin=AUTOSAR_ECUC V1.0.0  # Patch level version number of the vendor specific implementation of the module. The numbering is vendor specific.
      string VendorApiInfix [0..1]: implementation-config-class=PUBLISHED-INFORMATION, origin=AUTOSAR_ECUC V1.0.0  # In driver modules which can be instantiated several times on a single ECU, BSW00347 requires that the name of APIs is extended by the VendorId and a vendor specific name. This parameter is used to specify the vendor specific name. In total, the implementation specific name is generated as follows: <ModuleName>_>VendorId>_<VendorApiInfix><Api name from SWS>. E.g. assuming that the VendorId of the implementor is 123 and the implementer chose a VendorApiInfix of "v11r456" a api name Can_Write defined in the SWS will translate to Can_123_v11r456Write. This parameter is mandatory for all modules with upper multiplicity > 1. It shall not be used for modules with upper multiplicity =1.
      integer VendorId: implementation-config-class=PUBLISHED-INFORMATION, origin=AUTOSAR_ECUC V1.0.0  # Vendor ID of the dedicated implementation of this module according to the AUTOSAR vendor list
    container FlsConfigSet  # Container for runtime configuration parameters of the flash driver.
      function name FlsAcErase: origin=AUTOSAR_ECUC V1.0.0  # Function pointer to erase flash access code. Address offset in RAM to which the erase flash access code shall be loaded.
      function name FlsAcWrite: origin=AUTOSAR_ECUC V1.0.0  # Function pointer to write flash access code. Address offset in RAM to which the write flash access code shall be loaded.
      float FlsCallCycle: 0.., origin=AUTOSAR_ECUC V1.0.0  # Cycle time of calls of the flash driver's main function. This value is given in seconds. A tool generating the flash driver's configuration header file converts this value to a HW specific representation (e.g. timer ticks).
      function name FlsJobEndNotification: origin=AUTOSAR_ECUC V1.0.0  # Mapped to the job end notification routine provided by some upper layer module, typically the Fee module.
      function name FlsJobErrorNotification: origin=AUTOSAR_ECUC V1.0.0  # Mapped to the job error notification routine provided by some upper layer module, typically the Fee module.
      integer FlsMaxReadFastMode: 1..4294967295, origin=AUTOSAR_ECUC V1.0.0  # The maximum number of bytes to read or compare in one cycle of the flash driver's job processing function in fast mode.
      integer FlsMaxReadNormalMode: 1..4294967295, origin=AUTOSAR_ECUC V1.0.0  # The maximum number of bytes to read or compare in one cycle of the flash driver's job processing function in normal mode.
      integer FlsMaxWriteFastMode: 1..4294967295, origin=AUTOSAR_ECUC V1.0.0  # The maximum number of bytes to write in one cycle of the flash driver's job processing function in fast mode.
      integer FlsMaxWriteNormalMode: 1..4294967295, origin=AUTOSAR_ECUC V1.0.0  # The maximum number of bytes to write in one cycle of the flash driver's job processing function in normal mode.
      integer FlsProtection: 0..4294967295, origin=AUTOSAR_ECUC V1.0.0  # Erase/write protection settings. Only relevant if supported by hardware.
      container FlsExternalDriver [0..1]  # This container is present for external flash drivers only. Internal flash drivers do not use the parameter listed in this container, hence its multiplicity is 0 for internal drivers.
        integer FlsMaxSuspendTime: origin=AUTOSAR_ECUC V1.0.0  # The maximum read access blocking time (suspend time) in milliseconds. A tool generating the flash driver configuration header file may need to convert the value of this parameter to a HW specific representation. Parameter is present for external drivers only.
        symbolic name reference SpiReference: origin=AUTOSAR_ECUC V1.0.0, destination=SpiSequence  # Reference to SPI sequence (required for external flash drivers).
    container FlsGeneral  # Container for general parameters of the flash driver. These parameters are always pre-compile.
      boolean FlsAcLoadOnJobStart: origin=AUTOSAR_ECUC V1.0.0, default-value=false  # The flash driver shall load the flash access code to RAM whenever an erase or write job is started and unload (overwrite) it after that job has been finished or canceled.
      integer FlsBaseAddress: 0..4294967295, origin=AUTOSAR_ECUC V1.0.0  # The flash memory start address (see also FLS118). FLS169: This parameter defines the lower boundary for read / write / erase and compare jobs.
      boolean FlsCancelApi: origin=AUTOSAR_ECUC V1.0.0  # Compile switch to enable and disable the Fls_Cancel function.
      boolean FlsCompareApi: origin=AUTOSAR_ECUC V1.0.0  # Compile switch to enable and disable the Fls_Compare function.
      boolean FlsDevErrorDetect: origin=AUTOSAR_ECUC V1.0.0, default-value=true  # Pre-processor switch for enabling the development error detection and reporting (see FLS077).
      integer FlsDriverIndex: 0..254, origin=AUTOSAR_ECUC V1.0.0, symbolic-name-value=true  # Index of the driver, used by FEE.
      boolean FlsGetJobResultApi: origin=AUTOSAR_ECUC V1.0.0  # Compile switch to enable and disable the Fls_GetJobResult function.
      boolean FlsGetStatusApi: origin=AUTOSAR_ECUC V1.0.0  # Compile switch to enable and disable the Fls_GetStatus function.
      boolean FlsSetModeApi: origin=AUTOSAR_ECUC V1.0.0  # Compile switch to enable and disable the Fls_SetMode function.
      integer FlsTotalSize: 0..4294967295, origin=AUTOSAR_ECUC V1.0.0  # The total amount of flash memory in bytes (see also FLS118). FLS170: This parameter in conjunction with FLS_BASE_ADDRESS defines the upper boundary for read / write / erase and compare jobs.
      boolean FlsUseInterrupts: origin=AUTOSAR_ECUC V1.0.0, default-value=false  # Job processing triggered by hardware interrupt (only available if supported by underlying flash hardware).
      boolean FlsVersionInfoApi: origin=AUTOSAR_ECUC V1.0.0  # Compile switch to enable and disable the version information function.
    container FlsPublishedInformation  # Additional published parameters not covered by CommonPublishedInformation container. Note that these parameters do not have any configuration class setting, since they are published information.
      integer FlsAcLocationErase: implementation-config-class=PUBLISHED-INFORMATION, origin=AUTOSAR_ECUC V1.0.0  # Position in RAM, to which the erase flash access code has to be loaded. Only relevant if the erase flash access code is not position independent. If this information is not provided it is assumed that the erase flash access code is position independent and that therefore the RAM position can be freely configured.
      integer FlsAcLocationWrite: implementation-config-class=PUBLISHED-INFORMATION, origin=AUTOSAR_ECUC V1.0.0  # Position in RAM, to which the write flash access code has to be loaded. Only relevant if the write flash access code is not position independent. If this information is not provided it is assumed that the write flash access code is position independent and that therefore the RAM position can be freely configured.
      integer FlsAcSizeErase: implementation-config-class=PUBLISHED-INFORMATION, origin=AUTOSAR_ECUC V1.0.0  # Number of bytes in RAM needed for the erase flash access code.
      integer FlsAcSizeWrite: implementation-config-class=PUBLISHED-INFORMATION, origin=AUTOSAR_ECUC V1.0.0  # Number of bytes in RAM needed for the write flash access code.
      float FlsEraseTime: implementation-config-class=PUBLISHED-INFORMATION, origin=AUTOSAR_ECUC V1.0.0  # Maximum time to erase one complete flash sector.
      integer FlsErasedValue: implementation-config-class=PUBLISHED-INFORMATION, origin=AUTOSAR_ECUC V1.0.0  # The contents of an erased flash memory cell.
      string FlsExpectedHwId: implementation-config-class=PUBLISHED-INFORMATION, origin=AUTOSAR_ECUC V1.0.0  # Unique identifier of the hardware device that is expected by this driver (the device for which this driver has been implemented). Only relevant for external flash drivers.
      string FlsPageList: implementation-config-class=PUBLISHED-INFORMATION, origin=AUTOSAR_ECUC V1.0.0  # List of flash pages (smallest writable flash memory units) specifying start address (for checking of address alignment) and size (for checking write job sizes) for all different flash page sizes.
      string FlsSectorList: implementation-config-class=PUBLISHED-INFORMATION, origin=AUTOSAR_ECUC V1.0.0  # List of flash sectors (smallest erasable flash memory units) specifying start address (for checking of address alignment) and size (for checking erase job sizes) for all different flash sector sizes.
      integer FlsSpecifiedEraseCycles: implementation-config-class=PUBLISHED-INFORMATION, origin=AUTOSAR_ECUC V1.0.0  # Number of erase cycles specified for the flash device (usually given in the device data sheet). FLS198: If the number of specified erase cycles depends on the operating environment (temperature, voltage, ...) during reprogramming of the flash device, the minimum number for which a data retention of at least 15 years over the temperature range from -40°C .. +125°C can be guaranteed shall be given. Note: If there are different numbers of specified erase cycles for different flash sectors of the device this parameter has to be extended to a parameter list (similar to the sector list above).
      float FlsWriteTime: implementation-config-class=PUBLISHED-INFORMATION, origin=AUTOSAR_ECUC V1.0.0  # Maximum time to program one complete flash page.
  module definition Fr [0..*]  # Configuration of the Fr (FlexRay driver) module.
    container CommonPublishedInformation  # Common container, aggregated by all modules. It contains published information about vendor and versions.
      integer ArMajorVersion: implementation-config-class=PUBLISHED-INFORMATION, origin=AUTOSAR_ECUC V1.0.0  # Major version number of AUTOSAR specification on which the appropriate implementation is based on.
      integer ArMinorVersion: implementation-config-class=PUBLISHED-INFORMATION, origin=AUTOSAR_ECUC V1.0.0  # Minor version number of AUTOSAR specification on which the appropriate implementation is based on.
      integer ArPatchVersion: implementation-config-class=PUBLISHED-INFORMATION, origin=AUTOSAR_ECUC V1.0.0  # Patch level version number of AUTOSAR specification on which the appropriate implementation is based on.
      integer ModuleId: implementation-config-class=PUBLISHED-INFORMATION, origin=AUTOSAR_ECUC V1.0.0  # Module ID of this module from Module List
      integer SwMajorVersion: implementation-config-class=PUBLISHED-INFORMATION, origin=AUTOSAR_ECUC V1.0.0  # Major version number of the vendor specific implementation of the module. The numbering is vendor specific.
      integer SwMinorVersion: implementation-config-class=PUBLISHED-INFORMATION, origin=AUTOSAR_ECUC V1.0.0  # Minor version number of the vendor specific implementation of the module. The numbering is vendor specific.
      integer SwPatchVersion: implementation-config-class=PUBLISHED-INFORMATION, origin=AUTOSAR_ECUC V1.0.0  # Patch level version number of the vendor specific implementation of the module. The numbering is vendor specific.
      string VendorApiInfix [0..1]: implementation-config-class=PUBLISHED-INFORMATION, origin=AUTOSAR_ECUC V1.0.0  # In driver modules which can be instantiated several times on a single ECU, BSW00347 requires that the name of APIs is extended by the VendorId and a vendor specific name. This parameter is used to specify the vendor specific name. In total, the implementation specific name is generated as follows: <ModuleName>_>VendorId>_<VendorApiInfix><Api name from SWS>. E.g. assuming that the VendorId of the implementor is 123 and the implementer chose a VendorApiInfix of "v11r456" a api name Can_Write defined in the SWS will translate to Can_123_v11r456Write. This parameter is mandatory for all modules with upper multiplicity > 1. It shall not be used for modules with upper multiplicity =1.
      integer VendorId: implementation-config-class=PUBLISHED-INFORMATION, origin=AUTOSAR_ECUC V1.0.0  # Vendor ID of the dedicated implementation of this module according to the AUTOSAR vendor list
    container FrController [1..*]  # Configuration of the individual controllers.
      integer FrCtrlClock: 0..80000000, origin=AUTOSAR_ECUC V1.0.0  # Determines clock connected to the CC [Hz].
      integer FrCtrlIdx: origin=AUTOSAR_ECUC V1.0.0, symbolic-name-value=true  # Determines index of CC within Fr.
      boolean FrIsLeadingColdStarter: origin=AUTOSAR_ECUC V1.0.0  # Enables/Disables the leading transmission of SUP frames.
      boolean PAllowHaltDueToClock: origin=AUTOSAR_ECUC V1.0.0  # Boolean flag that controls the transition to the POC:halt state due to a clock synchronization errors. If set to true, the CC is allowed to transition to POC:halt. If set to false, the CC will not transition to the POC:halt state but will enter or remain in the POC:normal passive state (self healing would still be possible)
      integer PAllowPassiveToActive: 0..31, origin=AUTOSAR_ECUC V1.0.0  # Number of consecutive even/odd cycle pairs that must have valid clock correction terms before the CC will be allowed to transition from the POC:normal passive state to POC:normal active state. If set to zero, the CC is not allowed to transition from POC:normal passive to POC:normal active
      enumeration PChannels: {FR_CHANNEL_A, FR_CHANNEL_AB, FR_CHANNEL_B}, origin=AUTOSAR_ECUC V1.0.0  # Channels to which the node is connected
      integer PClusterDriftDamping: 0..20, origin=AUTOSAR_ECUC V1.0.0  # Local cluster drift damping factor used for rate correction [Microticks]
      integer PDecodingCorrection: 14..143, origin=AUTOSAR_ECUC V1.0.0  # Value used by the receiver to calculate the difference between primary time reference point and secondary time reference point [Microticks]
      integer PDelayCompensationA: 0..200, origin=AUTOSAR_ECUC V1.0.0  # Value used to compensate for reception delays on the indicated channel. This covers assumed propagation delay up to cPropagationDelayMax for microticks in the range of 0.0125 µs to 0.05 µs. In practice, the minimum of the propagation delays of all sync nodes should be applied [Microticks].
      integer PDelayCompensationB: 0..200, origin=AUTOSAR_ECUC V1.0.0  # Value used to compensate for reception delays on the indicated channel. This covers assumed propagation delay up to cPropagationDelayMax for microticks in the range of 0.0125 µs to 0.05 µs. In practice, the minimum of the propagation delays of all sync nodes should be applied [Microticks].
      integer PExternOffsetCorrection: 0..7, origin=AUTOSAR_ECUC V1.0.0  # Number of microticks added or subtracted to the NIT to carry out a host-requested external offset correction [Microticks].
      integer PExternRateCorrection: 0..7, origin=AUTOSAR_ECUC V1.0.0  # Number of microticks added or subtracted to the cycle to carry out a host-requested external rate correction [Microticks].
      integer PKeySlotId [0..1]: 1..1023, origin=AUTOSAR_ECUC V1.0.0  # ID of the slot used to transmit the startup frame, sync frame, or designated single slot frame
      boolean PKeySlotUsedForStartup: origin=AUTOSAR_ECUC V1.0.0  # Flag indicating whether the Key Slot is used to transmit a startup frame
      boolean PKeySlotUsedForSync: origin=AUTOSAR_ECUC V1.0.0  # Flag indicating whether the Key Slot is used to transmit a sync frame
      integer PLatestTx: 0..7981, origin=AUTOSAR_ECUC V1.0.0  # Number of the last minislot in which a frame transmission can start in the dynamic segment [Minislots].
      integer PMacroInitialOffsetA: 2..72, origin=AUTOSAR_ECUC V1.0.0  # Integer number of macroticks between the static slot boundary and the following macrotick boundary of the secondary time reference point based on the nominal macrotick duration [Macroticks].
      integer PMacroInitialOffsetB: 2..72, origin=AUTOSAR_ECUC V1.0.0  # Integer number of macroticks between the static slot boundary and the following macrotick boundary of the secondary time reference point based on the nominal macrotick duration [Macroticks].
      integer PMicroInitialOffsetA: 0..240, origin=AUTOSAR_ECUC V1.0.0  # Number of microticks between the closest macrotick boundary described by pMacroInitialOffset[Ch] and the secondary time reference point. The parameter depends on pDelayCompensation[Ch] and therefore it has to be set independently for each channel [Microticks].
      integer PMicroInitialOffsetB: 0..240, origin=AUTOSAR_ECUC V1.0.0  # Number of microticks between the closest macrotick boundary described by pMacroInitialOffset[Ch] and the secondary time reference point. The parameter depends on pDelayCompensation[Ch] and therefore it has to be set independently for each channel [Microticks].
      integer PMicroPerCycle: 640..640000, origin=AUTOSAR_ECUC V1.0.0  # Nominal number of microticks in the communication cycle of the local node. If nodes have different microtick durations this number will differ from node to node [Microticks].
      integer PMicroPerMacroNom: 40..240, origin=AUTOSAR_ECUC V1.0.0  # Number of microticks per nominal macrotick that all implementations must support [Microticks].
      integer POffsetCorrectionOut: 5..15266, origin=AUTOSAR_ECUC V1.0.0  # Magnitude of the maximum permissible offset correction value [Microticks].
      integer PPayloadLengthDynMax: 0..127, origin=AUTOSAR_ECUC V1.0.0  # Maximum payload length for dynamic frames [16 bit words].
      integer PRateCorrectionOut: 2..1923, origin=AUTOSAR_ECUC V1.0.0  # Magnitude of the maximum permissible rate correction value [Microticks].
      enumeration PSamplesPerMicrotick: {n1samples, n2samples, n4samples}, origin=AUTOSAR_ECUC V1.0.0  # Number of samples per microtick
      boolean PSingleSlotEnabled: origin=AUTOSAR_ECUC V1.0.0  # Flag indicating whether or not the node shall enter single slot mode following startup
      enumeration PWakeupChannel: {FR_CHANNEL_A, FR_CHANNEL_B}, origin=AUTOSAR_ECUC V1.0.0  # Channel used by the node to send a wakeup pattern
      integer PWakeupPattern: 2..63, origin=AUTOSAR_ECUC V1.0.0  # Number of repetitions of the wakeup symbol that are combined to form a wakeup pattern when the node enters the POC:wakeup send state
      integer PdAcceptedStartupRange: 0..1875, origin=AUTOSAR_ECUC V1.0.0  # Expanded range of measured clock deviation allowed for startup frames during integration [Microticks].
      integer PdListenTimeout: 1284..1283846, origin=AUTOSAR_ECUC V1.0.0  # Upper limit for the start up listen timeout and wake up listen timeout [Microticks].
      integer PdMaxDrift: 2..1923, origin=AUTOSAR_ECUC V1.0.0  # Maximum drift offset between two nodes that operate with unsynchronized clocks over one communication cycle [Microticks].
      enumeration PdMicrotick: {t100ns, t12ns, t200ns, t25ns, t50ns}, origin=AUTOSAR_ECUC V1.0.0  # Duration of a microtick.
      container FrAbsoluteTimer [1..*]  # Specifies the absolute timer configuration parameters of the Fr.
        integer FrAbsTimerIdx: 0..254, origin=AUTOSAR_ECUC V1.0.0, symbolic-name-value=true  # Contains the index of an absolute timer contained in Fr on a certain FlexRay CC.
      container FrRelativeTimer [0..*]  # Specifies the relative timer configuration parameters of the Fr.
        integer FrRelTimerIdx: 0..254, origin=AUTOSAR_ECUC V1.0.0, symbolic-name-value=true  # Contains the index of a relative timer contained in Fr on a certain FlexRay CC.
    container FrGeneral  # General configuration (parameters) of the FlexRay Driver module.
      boolean FrDevErrorDetect: origin=AUTOSAR_ECUC V1.0.0  # Switches the Development Error Detection and Notification ON or OFF.
      integer FrNumCtrlSupported: 1..255, origin=AUTOSAR_ECUC V1.0.0  # Determines the maximum number of communication controllers that the driver supports.
      boolean FrRelativeTimerEnable: origin=AUTOSAR_ECUC V1.0.0  # Enables or disables the usage of relative timers
      boolean FrVersionInfoApi: origin=AUTOSAR_ECUC V1.0.0  # Enables/disables the existence of the Fr_GetVersionInfo API
  module definition FrIf [0..1]  # Configuration of the FrIf (FlexRay Interface) module.
    container CommonPublishedInformation  # Common container, aggregated by all modules. It contains published information about vendor and versions.
      integer ArMajorVersion: implementation-config-class=PUBLISHED-INFORMATION, origin=AUTOSAR_ECUC V1.0.0  # Major version number of AUTOSAR specification on which the appropriate implementation is based on.
      integer ArMinorVersion: implementation-config-class=PUBLISHED-INFORMATION, origin=AUTOSAR_ECUC V1.0.0  # Minor version number of AUTOSAR specification on which the appropriate implementation is based on.
      integer ArPatchVersion: implementation-config-class=PUBLISHED-INFORMATION, origin=AUTOSAR_ECUC V1.0.0  # Patch level version number of AUTOSAR specification on which the appropriate implementation is based on.
      integer ModuleId: implementation-config-class=PUBLISHED-INFORMATION, origin=AUTOSAR_ECUC V1.0.0  # Module ID of this module from Module List
      integer SwMajorVersion: implementation-config-class=PUBLISHED-INFORMATION, origin=AUTOSAR_ECUC V1.0.0  # Major version number of the vendor specific implementation of the module. The numbering is vendor specific.
      integer SwMinorVersion: implementation-config-class=PUBLISHED-INFORMATION, origin=AUTOSAR_ECUC V1.0.0  # Minor version number of the vendor specific implementation of the module. The numbering is vendor specific.
      integer SwPatchVersion: implementation-config-class=PUBLISHED-INFORMATION, origin=AUTOSAR_ECUC V1.0.0  # Patch level version number of the vendor specific implementation of the module. The numbering is vendor specific.
      string VendorApiInfix [0..1]: implementation-config-class=PUBLISHED-INFORMATION, origin=AUTOSAR_ECUC V1.0.0  # In driver modules which can be instantiated several times on a single ECU, BSW00347 requires that the name of APIs is extended by the VendorId and a vendor specific name. This parameter is used to specify the vendor specific name. In total, the implementation specific name is generated as follows: <ModuleName>_>VendorId>_<VendorApiInfix><Api name from SWS>. E.g. assuming that the VendorId of the implementor is 123 and the implementer chose a VendorApiInfix of "v11r456" a api name Can_Write defined in the SWS will translate to Can_123_v11r456Write. This parameter is mandatory for all modules with upper multiplicity > 1. It shall not be used for modules with upper multiplicity =1.
      integer VendorId: implementation-config-class=PUBLISHED-INFORMATION, origin=AUTOSAR_ECUC V1.0.0  # Vendor ID of the dedicated implementation of this module according to the AUTOSAR vendor list
    container FrIfCluster [1..*]  # This container specifies a FrIf Cluster and all related data which is required to enable communication of the Cluster. A Cluster may consist of more than one Controller.
      integer FrIfClstIdx: 0.., origin=AUTOSAR_ECUC V1.0.0, symbolic-name-value=true  # This parameter provides a zero-based consecutive index of the FlexRay Clusters. Upper layer BSW modules and the FrIf itself use this index to identify a FlexRay Cluster.
      float FrIfMainFunctionCycle: 0.0.., origin=AUTOSAR_ECUC V1.0.0  # The execution cycle of the FrIf_MainFunction_<cluster>() in seconds. The FrIf does not require this information but the BSW scheduler, which invokes the cluster main functions, needs it in order to plan its tasks.
      integer FrIfMaxIsrDelay: 0.., origin=AUTOSAR_ECUC V1.0.0  # The maximum delay in macroticks the FrIf_JoblistExec_<cluster>() function is processed after the absolute timer interrupt was triggered.
      enumeration GChannels: {FR_CHANNEL_A, FR_CHANNEL_AB, FR_CHANNEL_B}, origin=AUTOSAR_ECUC V1.0.0  # The channels that are used by the cluster
      integer GClusterDriftDamping: 0..5, origin=AUTOSAR_ECUC V1.0.0  # The cluster drift damping factor, based on the longest microtick gdMaxMicrotick used in the cluster. Used to compute the local cluster drift damping factor pClusterDriftDamping [Micrroticks].
      integer GColdStartAttempts: 2..31, origin=AUTOSAR_ECUC V1.0.0  # Maximum number of times a node in the cluster is permitted to attempt to start the cluster by initiating schedule synchronization
      integer GListenNoise: 2..16, origin=AUTOSAR_ECUC V1.0.0  # Upper limit for the start up listen timeout and wake up listen timeout in the presence of noise. It is used as a multiplier of the cluster parameter pdListenTimeout.
      integer GMacroPerCycle: 10..16000, origin=AUTOSAR_ECUC V1.0.0  # Number of macroticks in a communication cycle.
      integer GMaxWithoutClockCorrectFatal: 1..15, origin=AUTOSAR_ECUC V1.0.0  # Threshold used for testing the vClockCorrectionFailed counter. Defines the number of consecutive even/odd Cycle pairs with missing clock correction terms that will cause the protocol to transition from the POC:normal active or POC:normal passive state into the POC:halt state. [Even/odd cycle pairs].
      integer GMaxWithoutClockCorrectPassive: 1..15, origin=AUTOSAR_ECUC V1.0.0  # Threshold used for testing the vClockCorrectionFailed counter. Defines the number of consecutive even/odd Cycle pairs with missing clock correction terms that will cause the protocol to transition from the POC:normal active state to the POC:normal passive state. [Even/Odd cycle pairs]
      integer GNetworkManagementVectLength: 0..12, origin=AUTOSAR_ECUC V1.0.0  # Length of the Network Management vector in a cluster [bytes]
      integer GNumberOfMinislots: 0..7986, origin=AUTOSAR_ECUC V1.0.0  # Number of minislots in the dynamic segment
      integer GNumberOfStaticSlots: 2..1023, origin=AUTOSAR_ECUC V1.0.0  # Number of static slots in the static segment
      float GOffsetCorrectionMax: 0.5E-6..381.1E-6, origin=AUTOSAR_ECUC V1.0.0  # describes the maximum value which the offset correction should assume in seconds.
      integer GOffsetCorrectionStart: 9..15999, origin=AUTOSAR_ECUC V1.0.0  # Start of the offset correction phase within the NIT, expressed as the number of macroticks from the start of cycle.
      integer GPayloadLengthStatic: 0..127, origin=AUTOSAR_ECUC V1.0.0  # Payload length of a static frame [16 bit words]
      integer GSyncNodeMax: 2..15, origin=AUTOSAR_ECUC V1.0.0  # Maximum number of nodes that may send frames with the sync frame indicator bit set to one.
      integer GdActionPointOffset: 1..63, origin=AUTOSAR_ECUC V1.0.0  # Number of Macroticks the action point is offset from the beginning of a Static Slots or symbol window.
      enumeration GdBit: {t100ns, t200ns, t400ns}, origin=AUTOSAR_ECUC V1.0.0  # Nominal bit time
      integer GdCasRxLowMax: 67..99, origin=AUTOSAR_ECUC V1.0.0  # Upper limit of the CAS acceptance window [gdBit]
      float GdCycle: 10.0E-6..16.0E-3, origin=AUTOSAR_ECUC V1.0.0  # Length of the cycle, expressed in s
      integer GdDynamicSlotIdlePhase: 0..2, origin=AUTOSAR_ECUC V1.0.0  # Duration of the idle phase within a dynamic slot [Minislots].
      float GdMacrotick: 1.0E-6..6.0E-6, origin=AUTOSAR_ECUC V1.0.0  # Duration of the cluster wide nominal macrotick, expressed in s
      float GdMaxInitializationError: 0.0E-6..11.7E-6, origin=AUTOSAR_ECUC V1.0.0  # Maximum error that a node may have following integration in seconds.
      integer GdMiniSlotActionPointOffset: 1..31, origin=AUTOSAR_ECUC V1.0.0  # Number of Macroticks the Minislot action point is offset from the beginning of a Minislot [Macroticks].
      integer GdMinislot: 2..63, origin=AUTOSAR_ECUC V1.0.0  # Duration of a minislot [Macroticks]
      integer GdNit: 2..767, origin=AUTOSAR_ECUC V1.0.0  # Duration of the Network Idle Time [Macroticks]
      enumeration GdSampleClockPeriod: {t12_5ns, t25ns, t50ns}, origin=AUTOSAR_ECUC V1.0.0  # Sample clock period
      integer GdStaticSlot: 4..659, origin=AUTOSAR_ECUC V1.0.0  # Duration of a Static Slot [Macroticks].
      integer GdSymbolWindow: 0..139, origin=AUTOSAR_ECUC V1.0.0  # Duration of the symbol window [Macroticks].
      integer GdTssTransmitter: 3..15, origin=AUTOSAR_ECUC V1.0.0  # Number of bits in the Transmission Start Sequence [gdBits].
      integer GdWakeupSymbolRxIdle: 14..59, origin=AUTOSAR_ECUC V1.0.0  # Number of bits used by the node to test the duration of the 'idle' portion of a received wakeup symbol. Duration is equal to (gdWakeupSymbolTxIdle - gdWakeupSymbolTxLow)/2 minus a safe part. (Collisions, clock differences, and other effects can deform the Tx-wakeup pattern.) [gdBit].
      integer GdWakeupSymbolRxLow: 10..55, origin=AUTOSAR_ECUC V1.0.0  # Number of bits used by the node to test the LOW portion of a received wakeup symbol. This lower limit of zero bits has to be received to detect the LOW portion by the receiver. The duration is equal to gdWakeupSymbolTxLow minus a safe part. (Active stars, clock differences, and other effects can deform the Tx-wakeup pattern.) [gdBits].
      integer GdWakeupSymbolRxWindow: 76..301, origin=AUTOSAR_ECUC V1.0.0  # The size of the window used to detect wakeups. Detection of a wakeup requires a low and idle period (from one WUS) and a low period (from another WUS) to be detected entirely within a window of this size. The duration is equal to gdWakeupSymbolTxIdle + 2 * gdWakeupSymbolTxLow plus a safe part. (Clock differences and other effects can deform the Tx-wakeup pattern.) [gdBit].
      integer GdWakeupSymbolTxIdle: 45..180, origin=AUTOSAR_ECUC V1.0.0  # Number of bits used by the node to transmit the 'idle' part of a wakeup symbol. The duration is equal to cdWakeupSymbolTxIdle [gdBit].
      integer GdWakeupSymbolTxLow: 15..60, origin=AUTOSAR_ECUC V1.0.0  # Number of bits used by the node to transmit the LOW part of a wakeup symbol. The duration is equal to cdWakeupSymbolTxLow [gdBit].
      container FrIfController [1..*]  # Defines the communication controllers provided by FrIf.
        integer FrIfCtrlIdx: origin=AUTOSAR_ECUC V1.0.0, symbolic-name-value=true  # This parameter provides a zero-based consecutive index of the FlexRay Communication Controllers. Upper layer BSW modules and the FrIf itself use this index to identify a FlexRay CC.
        symbolic name reference FrIfFrCtrlRef: origin=AUTOSAR_ECUC V1.0.0, destination=FrController  # Reference to a Controller, which is handled by a specific Driver. This reference is unique for the ECU.
        container FrIfAbsTimer [1..*]  # This container contains the configuration of an absolute timer of a FlexRay CC.
          integer FrIfAbsTimerIdx: 0.., origin=AUTOSAR_ECUC V1.0.0, symbolic-name-value=true  # This parameter provides a zero-based consecutive index of the absolute timers. Upper layer BSW modules use this index to identify an absolute timer.
          symbolic name reference FrIfFrAbsTimerRef: origin=AUTOSAR_ECUC V1.0.0, destination=FrAbsoluteTimer  # Reference to an absolute timer, which is handled by a specific FlexRay Driver. This reference is unique for the ECU, therefore, an explicit reference to the FlexRay Driver is not necessary.
        container FrIfFrameTriggering [0..*]  # A frame triggering defies that a frame shall be sent in a certain (slot, base cycle, cycle repetition, channel) pattern.
          boolean FrIfAlwaysTransmit: origin=AUTOSAR_ECUC V1.0.0  # The FlexRay Driver API service Fr_TransmitTxLSdu() will be called for this FlexRay Frame even if FrIf_Transmit() has not been called for any of the PDUs in the Frame.
          integer FrIfBaseCycle: 0..63, origin=AUTOSAR_ECUC V1.0.0  # This parameter contains the FlexRay Base Cycle used to transmit this FlexRay Frame.
          enumeration FrIfChannel: {FRIF_CHANNEL_A, FRIF_CHANNEL_AB, FRIF_CHANNEL_B}, origin=AUTOSAR_ECUC V1.0.0  # This parameter contains the FlexRay Channel used to transmit this FlexRay Frame.
          integer FrIfCycleRepetition: 1..64, origin=AUTOSAR_ECUC V1.0.0  # This parameter contains the FlexRay Cycle Repetition used to transmit this FlexRay Frame..
          integer FrIfSlotId: 1..2047, origin=AUTOSAR_ECUC V1.0.0  # This parameter contains the FlexRay Slot ID used to transmit this FlexRay Frame.
          reference def FrIfFrameStructureRef: lower-multiplicity=1, upper-multiplicity=1, origin=AUTOSAR_ECUC V1.0.0, destination=FrIfFrameStructure  # Reference to the Construction Plan of the FlexRay Frame.
        container FrIfRelTimer [0..*]  # This container contains the configuration of a relative timer of a FlexRay CC.
          integer FrIfRelTimerIdx: 0.., origin=AUTOSAR_ECUC V1.0.0, symbolic-name-value=true  # This parameter provides a zero-based consecutive index of the relative timers. Upper layer BSW modules use this index to identify a relative timer.
          symbolic name reference FrIfFrRelTimerRef: origin=AUTOSAR_ECUC V1.0.0, destination=FrRelativeTimer  # Reference to a relative timer, which is handled by a specific FlexRay Driver. This reference is unique for the ECU, therefore, an explicit reference to the FlexRay Driver is not necessary.
        container FrIfTransceiver [0..2]  # Up to two FlexRay Transceivers may connect a Controller to a Cluster. This container realizes a Controller-Transceiver assignment.
          enumeration FrIfClusterChannel: {FRIF_CHANNEL_A, FRIF_CHANNEL_B}, origin=AUTOSAR_ECUC V1.0.0  # This parameter identifies to which one of the two Channels "A" or "B" of the Cluster the Transceiver is connected.
          symbolic name reference FrIfFrTrcvChannelRef: origin=AUTOSAR_ECUC V1.0.0, destination=FrTrcvNode  # Reference to a Transceiver Driver Channel. This reference is unique for the ECU.
        container FrIfVirtualBuffer [0..*]  # FlexRay interface and FlexRay driver(s) communicate with each other using "virtual buffer index" as a handle. Each (cycle, slot) pair that is used for transmission or reception on a cluster gets an own virtual buffer index assigned. That way, FlexRay Interface does not need to know about any hardware restrictions a certain controller might have. It is up to the FlexRay driver to map virtual buffers to real hardware buffers.
          integer FrIfVirtualBufferIdx: origin=AUTOSAR_ECUC V1.0.0, symbolic-name-value=true  # This parameter identifies the virtual buffer.
          reference def FrIfVBTriggeringRef: lower-multiplicity=1, upper-multiplicity=1, origin=AUTOSAR_ECUC V1.0.0, destination=FrIfFrameTriggering  # Reference to the assigned Frame triggering.
      container FrIfJobList [0..1]  # This container specifies a list of all FlexRay Jobs of the Cluster to be performed by FrIf_JobListExec_<ClstIdx>().
        symbolic name reference FrIfAbsTimerRef: origin=AUTOSAR_ECUC V1.0.0, destination=FrIfAbsTimer  # Reference to the absolute timer to be used to trigger the interrupt whose ISR contains the FrIf_JobListExec_<ClstIdx>() function.
        container FrIfJob [1..*]  # A job may contain more than one operation that are executed at a specific point in time.
          integer FrIfCycle: 0..63, origin=AUTOSAR_ECUC V1.0.0  # The FlexRay Cycle in which to execute this job
          integer FrIfMacrotick: 1..16000, origin=AUTOSAR_ECUC V1.0.0  # Macrotick offset in the Cycle [Macrotick]
          container FrIfCommunicationOperation [1..*]  # A job may contain several communication operations which are executed sequentially
            enumeration FrIfCommunicationAction: {DECOUPLED_TRANSMISSION, RECEIVE_AND_INDICATE, RECEIVE_AND_STORE, RX_INDICATION, TX_CONFIRMATION}, origin=AUTOSAR_ECUC V1.0.0  # The action to be performed in the FlexRay Operation
            integer FrIfCommunicationOperationIdx: 0.., origin=AUTOSAR_ECUC V1.0.0  # For each FlexRay Communication Job, this index spans a range of zero-based consecutive values and thus defines the order of the FlexRay Communication Operation in the respective FlexRay Communication Job.
            reference def FrIfVirtualBufferRef: lower-multiplicity=1, upper-multiplicity=1, origin=AUTOSAR_ECUC V1.0.0, destination=FrIfVirtualBuffer  # Reference to a virtual buffer.
    container FrIfFrameStructure [0..*]  # The Frame structure specifies a Construction Plan how a Frame is assembled with PDUs and their respective Update-Bits.
      integer FrIfLSduLength: 0..254, origin=AUTOSAR_ECUC V1.0.0  # The payload length of the Frame is given here. This parameter is required for validation if configured PDUs and update information fits into the Frame at configuration time [bytes].
      container FrIfPdusInFrame [1..*]  # This container holds all the information about a PDU in a FlexRay Frame.
        integer FrIfPduOffset: 0..253, origin=AUTOSAR_ECUC V1.0.0  # The value specifies the offset of the PDU within the Frame.
        integer FrIfPduUpdateBitOffset [0..1]: 0..2031, origin=AUTOSAR_ECUC V1.0.0  # This value specifies where the PDU's Update-Bit is stored in the Frame. If the value is marked as invalid, no Update-Bit is used for the PDU.
        reference def FrIfFrIfPduRef: lower-multiplicity=1, upper-multiplicity=1, origin=AUTOSAR_ECUC V1.0.0, destination=FrIfPdu  # This is the reference to the local definition of a PDU.
    container FrIfGeneral  # This container contains the general configuration of the FlexRay Interface.
      boolean FrIfAllowSwitchConfig: origin=AUTOSAR_ECUC V1.0.0  # Enables/disables the existence of the FrIf_SwitchConfig() API service. In AUTOSAR R2.0 this parameter has to be set to OFF.
      integer FrIfApplMemSizeMax: 0.., origin=AUTOSAR_ECUC V1.0.0  # The maximum RAM memory size to be used by the FrIf for variable data, i.e. storage of flags, states, and temporary data. If the FrIf is configured at post build time, it is not allowed to use more RAM memory than specified by this parameter.
      boolean FrIfDevErrorDetect: origin=AUTOSAR_ECUC V1.0.0  # Switches the Development Error Detection and Notification on or off
      integer FrIfNumClstSupported: 1.., origin=AUTOSAR_ECUC V1.0.0  # Maximum number of FlexRay Clusters that the FlexRay Interface supports.
      integer FrIfNumCtrlSupported: 1.., origin=AUTOSAR_ECUC V1.0.0  # Maximum number of FlexRay CCs that the FlexRay Interface supports
      boolean FrIfVersionInfoApi: origin=AUTOSAR_ECUC V1.0.0  # Enables/disables the existence of the FrIf_GetVersionInfo() API service
    container FrIfPdu [0..*]  # Contains PDU information. A PDU may be either a transmission PDU or a reception PDU. So, this container holds exactly one sub container.
      choice container FrIfPduDirection  # A PDU is either transmit or receive
        container FrIfRxPdu [0..1]  # Receive PDU
          reference def FrIfPduRef: lower-multiplicity=1, upper-multiplicity=1, origin=AUTOSAR_ECUC V1.0.0, destination=Pdu  # Reference to the external PDU definition.
        container FrIfTxPdu [0..1]  # This container specifies transmission PDUs.
          boolean FrIfConfirm: origin=AUTOSAR_ECUC V1.0.0  # Defines whether the transmission of a PDU should be checked and confirmed to the PDU owning BSW module.
          integer FrIfCounterLimit: 1.., origin=AUTOSAR_ECUC V1.0.0  # This value states the maximum number of indication of ready PDU data to the FrIf (i.e. maximum number of invocations of FrIf_Transmit) without an intermediate transmission of the PDU.
          boolean FrIfImmediate: origin=AUTOSAR_ECUC V1.0.0  # Defines whether the the PDU is transmitted immediate or decoupled..
          integer FrIfTxPduId: 0.., origin=AUTOSAR_ECUC V1.0.0, symbolic-name-value=true  # The global PDU identifier, which has to be used by the upper layer BSW module. The identifier has to be zero based and consecutive.
          reference def FrIfPduRef: lower-multiplicity=1, upper-multiplicity=1, origin=AUTOSAR_ECUC V1.0.0, destination=Pdu  # Reference to the external PDU definition.
  module definition FrNm [0..1]  # The Flexray Nm module
    container CommonPublishedInformation  # Common container, aggregated by all modules. It contains published information about vendor and versions.
      integer ArMajorVersion: implementation-config-class=PUBLISHED-INFORMATION, origin=AUTOSAR_ECUC V1.0.0  # Major version number of AUTOSAR specification on which the appropriate implementation is based on.
      integer ArMinorVersion: implementation-config-class=PUBLISHED-INFORMATION, origin=AUTOSAR_ECUC V1.0.0  # Minor version number of AUTOSAR specification on which the appropriate implementation is based on.
      integer ArPatchVersion: implementation-config-class=PUBLISHED-INFORMATION, origin=AUTOSAR_ECUC V1.0.0  # Patch level version number of AUTOSAR specification on which the appropriate implementation is based on.
      integer ModuleId: implementation-config-class=PUBLISHED-INFORMATION, origin=AUTOSAR_ECUC V1.0.0  # Module ID of this module from Module List
      integer SwMajorVersion: implementation-config-class=PUBLISHED-INFORMATION, origin=AUTOSAR_ECUC V1.0.0  # Major version number of the vendor specific implementation of the module. The numbering is vendor specific.
      integer SwMinorVersion: implementation-config-class=PUBLISHED-INFORMATION, origin=AUTOSAR_ECUC V1.0.0  # Minor version number of the vendor specific implementation of the module. The numbering is vendor specific.
      integer SwPatchVersion: implementation-config-class=PUBLISHED-INFORMATION, origin=AUTOSAR_ECUC V1.0.0  # Patch level version number of the vendor specific implementation of the module. The numbering is vendor specific.
      string VendorApiInfix [0..1]: implementation-config-class=PUBLISHED-INFORMATION, origin=AUTOSAR_ECUC V1.0.0  # In driver modules which can be instantiated several times on a single ECU, BSW00347 requires that the name of APIs is extended by the VendorId and a vendor specific name. This parameter is used to specify the vendor specific name. In total, the implementation specific name is generated as follows: <ModuleName>_>VendorId>_<VendorApiInfix><Api name from SWS>. E.g. assuming that the VendorId of the implementor is 123 and the implementer chose a VendorApiInfix of "v11r456" a api name Can_Write defined in the SWS will translate to Can_123_v11r456Write. This parameter is mandatory for all modules with upper multiplicity > 1. It shall not be used for modules with upper multiplicity =1.
      integer VendorId: implementation-config-class=PUBLISHED-INFORMATION, origin=AUTOSAR_ECUC V1.0.0  # Vendor ID of the dedicated implementation of this module according to the AUTOSAR vendor list
    container FrNmChannelConfig  # This container contains all configuration parameters of FlexRay NM configured from the channel perspective.
      container FrNmChannelIdentifiers  # This container contains instance specific identifiers related to the respective FlexRay Channel.
        integer FrNmChannelId: 0..255, origin=AUTOSAR_ECUC V1.1.0  # It is used for referring to the respective NM channel handle. It must be unique for each NM instance within one ECU.
        integer FrNmDataCycleOffset: 0..63, origin=AUTOSAR_ECUC V1.1.0  # Cycle offset within the NM Data Cycle to transmit the NM-Data PDU in the dynamic segment.
        integer FrNmDataSlot: 1..2047, origin=AUTOSAR_ECUC V1.1.0  # Slot of FlexRay Schedule in the dynamic segment used for transmission of the NM-Data.
        integer FrNmDataSlotNumber: 1..16, origin=AUTOSAR_ECUC V1.1.0  # Number of slots of FlexRay Schedule in the dynamic segment used for transmission of the NM-Data.
        integer FrNmInstanceId: 8192..8446, origin=AUTOSAR_ECUC V1.1.0  # FlexRay NM instance identifier configured for the respective FlexRay Channel. It is used for reporting of development errors to DET. It must be unique for each NM instance within one ECU.
        integer FrNmNodeId: 0..255, origin=AUTOSAR_ECUC V1.1.0  # NM node identifier configured for the respective FlexRay Channel. It is used for identifying the respective NM node in the NM-cluster. It must be unique for each NM node within one NM cluster.
        integer FrNmPduLength: 0..8, origin=AUTOSAR_ECUC V1.1.0  # Length of the NM-Data PDU.
        integer FrNmVoteSlot: 1..2047, origin=AUTOSAR_ECUC V1.1.0  # Slot of FlexRay Schedule in the dynamic segment used for transmission of the NM-Vote.
        integer FrNmVoteSlotNumber: 1..16, origin=AUTOSAR_ECUC V1.1.0  # Number of slots of FlexRay Schedule in the dynamic segment used for transmission of the NM-Vote.
        integer FrNmVotingCycleOffset: 0..63, origin=AUTOSAR_ECUC V1.1.0  # Cycle offset within the NM Voting Cycle to transmit the ECUs NM-Vote PDU in the dynamic segment.
        symbolic name reference FrNmChannelHandle: origin=AUTOSAR_ECUC V1.1.0, destination=FrIfCluster  # Channel identifier configured for the respective instance of the NM. The FrNmChannelHandle shall be encoded in the FrNmRxPduId parameter which is passed to FrNm_RxIndication() function called by the FrIf. The FrNmChannelHandle shall be encoded in the FrNmTxPduId which is passed to FrNm_TxConfirmation() function called by the FrIf.
        container FrNmTxDataPdu  # Contains the ID and the reference to the Data PDU.
          integer FrNmTxDataPduId: 0..65536, origin=AUTOSAR_ECUC V1.1.0  # L-PDU identifier configured for the respective FlexRay Channel. It is used if NM data is sent in a separate PDU, for referring to the FlexRay Interface transmit function for the trnasmission of NM data messages and must be consistent with the value configured in the FlexRay interface.
          reference def FrNmTxDataPduRef: lower-multiplicity=1, upper-multiplicity=1, origin=AUTOSAR_ECUC V1.1.0, destination=Pdu  # The reference to a PDU in the global PDU structure.
        container FrNmTxPdu  # Contains the ID and the reference to the TX PDU.
          integer FrNmTxPduId: 0..65536, origin=AUTOSAR_ECUC V1.1.0  # L-PDU identifier configured for the respective FlexRay Channel. It is used for referring to the FlexRay Interface transmit function. It must be consistent with the value configured in the FlexRay Interface. This ID is used for the combined transmission of NM Vote and NM Data or for the transmission of the NM Vote if NM Data is sent in a separate PDU:
          reference def FrNmTxPduRef: lower-multiplicity=1, upper-multiplicity=1, origin=AUTOSAR_ECUC V1.1.0, destination=Pdu  # The reference to a PDU in the global PDU structure.
        container FrNmTxPdu2  # Contains the ID and the reference to the optional 2nd TX PDU.
          integer FrNmTxPdu2Id: 0..65536, origin=AUTOSAR_ECUC V1.1.0  # 2nd L-PDU identifier configured for the repsective FlexRay Channel. It is used for the optional second PDU referring to the Flexray Interface Transmit function and must be consistent wuth the value configured in the FlexRay interface. Available only if FrNmDualChannelPduEnable is set to ON.
          reference def FrNmTxPdu2Ref: lower-multiplicity=1, upper-multiplicity=1, origin=AUTOSAR_ECUC V1.1.0, destination=Pdu  # The reference to a PDU in the global PDU structure.
      container FrNmChannelSwitches  # This container contains instance-specific switches related to the respective FlexRay NM PDU.
        boolean FrNmChannelActive: origin=AUTOSAR_ECUC V1.1.0  # It determines if the respective NM channel is active or not.
      container FrNmChannelTiming  # This container contains instance-specific timing related to the respective FlexRay Channel.
        enumeration FrNmDataCycle: {CycleValue1, CycleValue16, CycleValue2, CycleValue32, CycleValue4, CycleValue64, CycleValue8}, origin=AUTOSAR_ECUC V1.1.0  # Number of FlexRay Schedule Cycles needed to transmit the NM Data of all ECUs on the FlexRay bus
        integer FrNmMsgTimeoutTime: 0..65535, origin=AUTOSAR_ECUC V1.1.0  # Timeout of a NM-message [number of communication cycles]. It determines how long the NM shall wait with notification of transmission failure while communication errors occur on the bus.
        integer FrNmReadySleepCnt: 1..65535, origin=AUTOSAR_ECUC V1.1.0  # Numbers of repetitions in the ready sleep state before NM switches to bus sleep mode. On a value of "1", the NM-State Machine will leave the Ready Sleep State after one NM Repetition Cycle with no "keep awake" votes.
        integer FrNmRemoteSleepIndTime: 0..65535, origin=AUTOSAR_ECUC V1.1.0  # Timeout for Remote Sleep Indication. It defines the time [number of communication cycles] how long it shall take to recognize that all other nodes are ready to sleep. The value "0" denotes that no Remote Sleep Indication functionality is configured.
        integer FrNmRepeatMessageTime: 0..65535, origin=AUTOSAR_ECUC V1.1.0  # Timeout for Repeat Message State. Defines the time [ms] how long the NM shall stay in the Repeat Message State. The value "0" denotes that no Repeat Message State is configured, which means that Repeat Message State is transient and implies that it is left immediately after entry and consequently no startup stability is guaranteed and no node detection procedure is possible.
        enumeration FrNmRepetitionCycle: {CycleValue1, CycleValue16, CycleValue2, CycleValue32, CycleValue4, CycleValue64, CycleValue8}, origin=AUTOSAR_ECUC V1.1.0  # Number of Flexray Schedule Cycles used to repeat the transmission of the Nm vote of all ECUs on the Flexray Bus.
        enumeration FrNmVotingCycle: {CycleValue1, CycleValue16, CycleValue2, CycleValue32, CycleValue4, CycleValue64, CycleValue8}, origin=AUTOSAR_ECUC V1.1.0  # Number of FlexRay Schedule Cycles needed to transmit the Nm vote of all ECUs on the FlexRay Bus.
    container FrNmGlobalConfig  # This container contains all global configuration parameters for the FrNm module.
      container FrNmGlobalConstants  # This container contains module constants related to the Flexray NM functionality.
        integer FrNmNumberOfChannels: 1..255, origin=AUTOSAR_ECUC V1.1.0  # Number of AUTOSAR FR NM channels allowed within one ECU.
      container FrNmGlobalFeatures  # This container contains module features related to the FlexRay NM functionality.
        boolean FrNmBusSynchronizationEnabled: origin=AUTOSAR_ECUC V1.1.0  # Pre-processor switch for enabling the bus synchronisation.
        derived boolean FrNmControlBitVectorEnabled: origin=AUTOSAR_ECUC V1.1.0  # Pre-processor switch for enabling control bit vector support. calculationFormula = If (FrNmNodeDetectionEnabled == False) then Equal(False) else Equal(False or True)
        boolean FrNmDualChannelPduEnable: origin=AUTOSAR_ECUC V1.1.0  # Pre-processor switch for enabling the support of dual channel transmission and reception of NM messages.
        boolean FrNmNmDataDisabled: origin=AUTOSAR_ECUC V1.1.0  # Pre-processor switch for enabling the transmission of NM-Data.
        derived boolean FrNmNodeDetectionEnabled: origin=AUTOSAR_ECUC V1.1.0  # Pre-processor switch for enabling node detection support. calculationFormula = If (FrNmPassiveModeEnabled == False) then Equal(NmNodeDetectionEnabled) else Equal(False)
        derived boolean FrNmPassiveModeEnabled: origin=AUTOSAR_ECUC V1.1.0  # Pre-processor switch for enabling Passive Mode Configuration support. calculationFormula = Equal(NmPassiveModeEnabled)
        boolean FrNmPduRxIndicationEnabled: origin=AUTOSAR_ECUC V1.1.0  # Pre-processor switch for enabling PDU reception indication.
        derived boolean FrNmRemoteSleepIndicationEnabled: origin=AUTOSAR_ECUC V1.1.0  # Pre-processor switch for enabling remote sleep indication. calculationFormula = If (FrNmPassiveModeEnabled == True) then Equal(False) else Equal(False or True)
        derived boolean FrNmRepeatMessageBitEnabled: origin=AUTOSAR_ECUC V1.1.0  # Pre-processor switch for enabling the repeat message bit support. calculationFormula = If (FrNmControlBitVectorEnabled == False) then Equal(False) else Equal(False or True)
        boolean FrNmSourceNodeIdentifierEnabled: origin=AUTOSAR_ECUC V1.1.0  # Pre-processor switch for enabling SourceNodeIdentifier support.
        boolean FrNmStateChangeIndicationEnabled: origin=AUTOSAR_ECUC V1.1.0  # Pre-processor switch for enabling state change indication.
        boolean FrNmUserDataEnabled: origin=AUTOSAR_ECUC V1.1.0  # Pre-processor switch for enabling user data support.
        boolean FrNmVoteDynamicPduEnabled: origin=AUTOSAR_ECUC V1.1.0  # Pre-processor switch for voting with dynamic PDU occurrence.
      container FrNmGlobalProperties  # This container contains module properties related to the FlexRay NM functionality.
        boolean FrNmDevErrorDetect: origin=AUTOSAR_ECUC V1.1.0  # Pre-processor switch for enabling development error detection
        boolean FrNmVersionInfoApi: origin=AUTOSAR_ECUC V1.1.0  # Pre-processor switch for enabling version info API support.
  module definition FrTp [0..1]  # Configuration of the FrTp (FlexRay Transport Protocol) module.
    container CommonPublishedInformation  # Common container, aggregated by all modules. It contains published information about vendor and versions.
      integer ArMajorVersion: implementation-config-class=PUBLISHED-INFORMATION, origin=AUTOSAR_ECUC V1.0.0  # Major version number of AUTOSAR specification on which the appropriate implementation is based on.
      integer ArMinorVersion: implementation-config-class=PUBLISHED-INFORMATION, origin=AUTOSAR_ECUC V1.0.0  # Minor version number of AUTOSAR specification on which the appropriate implementation is based on.
      integer ArPatchVersion: implementation-config-class=PUBLISHED-INFORMATION, origin=AUTOSAR_ECUC V1.0.0  # Patch level version number of AUTOSAR specification on which the appropriate implementation is based on.
      integer ModuleId: implementation-config-class=PUBLISHED-INFORMATION, origin=AUTOSAR_ECUC V1.0.0  # Module ID of this module from Module List
      integer SwMajorVersion: implementation-config-class=PUBLISHED-INFORMATION, origin=AUTOSAR_ECUC V1.0.0  # Major version number of the vendor specific implementation of the module. The numbering is vendor specific.
      integer SwMinorVersion: implementation-config-class=PUBLISHED-INFORMATION, origin=AUTOSAR_ECUC V1.0.0  # Minor version number of the vendor specific implementation of the module. The numbering is vendor specific.
      integer SwPatchVersion: implementation-config-class=PUBLISHED-INFORMATION, origin=AUTOSAR_ECUC V1.0.0  # Patch level version number of the vendor specific implementation of the module. The numbering is vendor specific.
      string VendorApiInfix [0..1]: implementation-config-class=PUBLISHED-INFORMATION, origin=AUTOSAR_ECUC V1.0.0  # In driver modules which can be instantiated several times on a single ECU, BSW00347 requires that the name of APIs is extended by the VendorId and a vendor specific name. This parameter is used to specify the vendor specific name. In total, the implementation specific name is generated as follows: <ModuleName>_>VendorId>_<VendorApiInfix><Api name from SWS>. E.g. assuming that the VendorId of the implementor is 123 and the implementer chose a VendorApiInfix of "v11r456" a api name Can_Write defined in the SWS will translate to Can_123_v11r456Write. This parameter is mandatory for all modules with upper multiplicity > 1. It shall not be used for modules with upper multiplicity =1.
      integer VendorId: implementation-config-class=PUBLISHED-INFORMATION, origin=AUTOSAR_ECUC V1.0.0  # Vendor ID of the dedicated implementation of this module according to the AUTOSAR vendor list
    container FrTpGeneral  # This container contains the general configuration (parameters) of the FlexRay TP.
      integer FrTpChanNum: 1..32, origin=AUTOSAR_ECUC V1.1.0  # Preprocessor switch for defining the number of concurrent channels the module supports. Up to 32 channels shall be definable here.
      boolean FrTpDevErrorDetect: origin=AUTOSAR_ECUC V1.1.0  # Preprocessor switch for enabling development error detection.
      boolean FrTpHaveAckRt: origin=AUTOSAR_ECUC V1.1.0  # Preprocessor switch for enabling the Acknowledgement and retry mechanisms.
      boolean FrTpHaveGrpSeg: origin=AUTOSAR_ECUC V1.1.0  # Preprocessor switch for enabling segmentation of 1:n messages.
      boolean FrTpHaveLm: origin=AUTOSAR_ECUC V1.1.0  # Preprocessor switch for enabling the mechanism for message longer than allowed by.
      boolean FrTpHaveTc: origin=AUTOSAR_ECUC V1.1.0  # Preprocessor switch for enabling Transmit Cancellation.
      integer FrTpMainFuncCycle: origin=AUTOSAR_ECUC V1.1.0  # This parameter contains the calling period of the TPs Main Function.
      boolean FrTpVersionInfoApi: origin=AUTOSAR_ECUC V1.1.0  # Preprocessor switch for enabling the Version info API.
    container FrTpMultipleConfig  # This container holds one or several multiple configuration sets.
      container FrTpChannel [1..*]  # This container contains the configuration (parameters) of one FlexRay TP channel.
        enumeration FrTpAckType: {FrTpAckWithRt, FrTpAckWithoutRt, FrTpNo}, origin=AUTOSAR_ECUC V1.1.0  # This parameter defines the type of acknowledgement which is used for the specific channel.
        enumeration FrTpAdrType: {FrTpOB, FrTpTB}, origin=AUTOSAR_ECUC V1.1.0  # This parameter states the addressing type this connection has. The meanings of the values are one byte and two byte.
        integer FrTpChannelId: 1.., origin=AUTOSAR_ECUC V1.1.0, symbolic-name-value=true  # The Id of the channel.
        integer FrTpConNum: origin=AUTOSAR_ECUC V1.1.0  # This parameter states the number of connections used in this channel. At least 256 shall be configurable here.
        boolean FrTpGrpSeg: origin=AUTOSAR_ECUC V1.1.0  # Here can be specified, whether segmentation within a 1:n connection is allowed or not.
        enumeration FrTpLm: {FrTpIso, FrTpIso6, FrTpL16m, FrTpL4g}, origin=AUTOSAR_ECUC V1.1.0  # This specifies the maximum message length for the particular channel.
        integer FrTpMaxAr: 0..255, origin=AUTOSAR_ECUC V1.1.0  # This parameter defines the maximum number of trying to send a frame when a TIMEOUT AR occurs (depending on whether retry is configured).
        integer FrTpMaxAs: 0..255, origin=AUTOSAR_ECUC V1.1.0  # This parameter defines the maximum number of trying t osend a frame when a TIMEOUT AS occurs (depending on whether retry is configured)
        integer FrTpMaxBs: 1..16, origin=AUTOSAR_ECUC V1.1.0  # This parameter is only relevant when having retry activated. It limits the maximal block size the FrTp can choose in order to limit the amount of Tx buffer that will be requested at the sender side in a segmented transfer.
        integer FrTpMaxBufReq: 0..255, origin=AUTOSAR_ECUC V1.1.0  # This parameter defines the maximum number of trying to get a buffer (Transmit / Receive), depending of the return value of PduR_FrTpProvideTxBuffer / PduR_FrTpProvideRxBuffer and on whether retry is configured.
        integer FrTpMaxFrIf: 0..255, origin=AUTOSAR_ECUC V1.1.0  # This parameter defines the maximum number of trying to send a frame when the FrIf returns an error.
        integer FrTpMaxRn: 0..255, origin=AUTOSAR_ECUC V1.1.0  # This parameter defines the maximum number of retries (if retry is configured for the particular channel).
        integer FrTpStMin: 0..255, origin=AUTOSAR_ECUC V1.1.0  # This parameter defines the minimum amount of time between two succeeding CFs.
        boolean FrTpTc: origin=AUTOSAR_ECUC V1.1.0  # With this switch Transmit Cancellation can be turned on or off for this channel.
        integer FrTpTimeBr: origin=AUTOSAR_ECUC V1.1.0  # This parameter defines the time in ms between receiving the last CF of a block or an FF-x (or SF-x) and sending out an FC or AF. It is obvious that FRTP_TIME_BR + FRTP_TIMEOUT_AR < FRTP_TIMEOUT_BS must hold (because the transmission duration on the bus has also to be considered). This parameter is defined in ISO 15765-2. It is contained in the configuration as a performance requirement.
        integer FrTpTimeBuffer: 0..255, origin=AUTOSAR_ECUC V1.1.0  # This parameter defines the time in s of waiting for the next try (if retry is activated) to get a Tx or Rx buffer.
        integer FrTpTimeCr: 0..65535, origin=AUTOSAR_ECUC V1.1.0  # This parameter defines the timeout value in s for waiting for a CF or FF-x (in case of retry) after receiving the last CF or after sending an FC or AF on the receiver side.
        integer FrTpTimeCs: origin=AUTOSAR_ECUC V1.1.0  # This parameter defines the time between the sending of two consecutive CFs or between a CF and a FC (for Transmit Cancellation) or between reception of an FC or AF and sending of the next CF or a FC (for Transmit Cancellation). It is obvious that FRTP_TIME_CS + FRTP_TIMEOUT_AS < FRTP_TIMEOUT_CR must hold (because the transmission duration on the bus has also to be considered). This parameter is defined in ISO 15765-2. It is contained in the configuration as a performance requirement.
        integer FrTpTimeFrIf: 0..255, origin=AUTOSAR_ECUC V1.1.0  # This parameter defines the time in s of waiting for the next try (if retry is activated) to send via FrIf_Transmit.
        integer FrTpTimeoutAr: 0..65535, origin=AUTOSAR_ECUC V1.1.0  # This parameter states the timeout in s between the PDU transmit request of the Transport Layer to the FlexRay Interface and the corresponding confirmation of the FlexRay Interface on the receiver side (for FC or AF).
        integer FrTpTimeoutAs: 0..65535, origin=AUTOSAR_ECUC V1.1.0  # This parameter states the timeout in s between the PDU transmit request for the first PDU of the group used in the current connection of the Transport Layer to the FlexRay Interface and the corresponding confirmation of the FlexRay Interface (when having sent the last PDU of the group used in this connection) on the sender side (SF-x, FF-x, CF or FC (in case of Transmit Cancellation)).
        integer FrTpTimeoutBs: 0..65535, origin=AUTOSAR_ECUC V1.1.0  # This parameter defines the timeout for waiting for an FC or AF on the sender side in a 1:1 connection. in [s]
        boolean FrTpUsePduFc: origin=AUTOSAR_ECUC V1.1.0  # This switch defines, whether within this channel the dedicated FC/ACK PDU (FrTpPduFc) shall be used or not. If this is not used FC / ACK frames are sent using the normal IDs, otherwise only FrTpPduFc shall be used for sending / receiving FC / ACK frames.
        container FrTpConnection [1..*]  # This container contains the configuration (parameters) of one FlexRay TP connection. A connection can only belong to one channel.
          integer FrTpLa: 0..65535, origin=AUTOSAR_ECUC V1.1.0  # This parameter defines the Local Address for the respective connection. When the local instance is the sender, this is the Source Address within the TP frame. When the local instance is the receiver, this is the Target Address within the TP frame. Note that in case of 1 byte addressing only the values from 0x0000 - 0x00FF are valid.
          boolean FrTpMultRec: origin=AUTOSAR_ECUC V1.1.0  # This parameter defines, whether this connection is an 1:1 ('false') or an 1:n ('true') connection. Of course, if the channel to which the connection is configured has retry or acknowledgement enabled, no retry or acknowledgement will occur in case the connection is an 1:n connection.
          integer FrTpRa: 0..65535, origin=AUTOSAR_ECUC V1.1.0  # This parameter defines the Remote Address for the respective connection. When the local instance is the sender, this is the Target Address within the TP frame. When the local instance is the receiver, this is the Source Address within the TP frame. Note that in case of 1 byte addressing only the values from 0x0000 - 0x00FF are valid.
          reference def FrTpConPduRef: lower-multiplicity=1, upper-multiplicity=*, origin=AUTOSAR_ECUC V1.1.0, destination=FrTpPdu  # Each value defines a PDU to be used for this connection. Thus each value is a PDU-ID given in FRTP_PDUID and this array cannot be longer than the array FRTP_PDUID. Please note: Only PDUs of the same size shall be used within a connection. Of course the PDU having the TxConfirmation configured has to be used by every connection.
          container FrTpRxSdu [0..1]
            reference def FrTpRxSduRef: lower-multiplicity=1, upper-multiplicity=1, origin=AUTOSAR_ECUC V1.1.0, destination=Pdu
          container FrTpTxSdu [0..1]
            integer FrTpSduTxId: origin=AUTOSAR_ECUC V1.1.0, symbolic-name-value=true  # This is a unique identifier for a received or a to be transmitted message. With this (and by means of e.g. a lookup table) the PDU Router can route the message appropriately without dealing with the particularities of the Transport Layer. This parameter can also be seen as the identifier of a connection.
            reference def FrTpTxSduRef: lower-multiplicity=1, upper-multiplicity=1, origin=AUTOSAR_ECUC V1.1.0, destination=Pdu
        container FrTpPdu [1..*]
          enumeration FrTpPduDirection: {FrTpRx, FrTpTx}, origin=AUTOSAR_ECUC V1.1.0  # This parameter defines the direction of the PDU.
          integer FrTpPduId: origin=AUTOSAR_ECUC V1.1.0, symbolic-name-value=true  # This is the identifier of the FlexRay Interface PDUs (Fr N-PDU, Fr L-SDU) in which the Transport Layer Flow Control and Acknowledgement Frames of this channel should be transmitted.
          reference def FrTpPduRef: lower-multiplicity=1, upper-multiplicity=1, origin=AUTOSAR_ECUC V1.1.0, destination=Pdu
        container FrTpPduFc [0..*]  # This is the identifier of the FlexRay Interface PDUs (Fr N-PDU, Fr L-SDU) in which the Transport Layer Flow Control and Acknowledgement Frames of this channel should be transmitted.
          enumeration FrTpPduFcDirection: {FrTpFcRx, FrTpFcTx}, origin=AUTOSAR_ECUC V1.1.0  # This parameter defines the direction of the PDU.
          integer FrTpPduFcId: origin=AUTOSAR_ECUC V1.1.0, symbolic-name-value=true  # This is the identifier of the FlexRay Interface PDUs (Fr N-PDU, Fr L-SDU) in which the Transport Layer Flow Control and Acknowledgement Frames of this channel should be transmitted.
          reference def FrTpPduFcRef: lower-multiplicity=1, upper-multiplicity=1, origin=AUTOSAR_ECUC V1.1.0, destination=Pdu
  module definition FrTrcv [0..*]  # Configuration of the FrTrcv (FlexRay Transceiver driver) module.
    container CommonPublishedInformation  # Common container, aggregated by all modules. It contains published information about vendor and versions.
      integer ArMajorVersion: implementation-config-class=PUBLISHED-INFORMATION, origin=AUTOSAR_ECUC V1.0.0  # Major version number of AUTOSAR specification on which the appropriate implementation is based on.
      integer ArMinorVersion: implementation-config-class=PUBLISHED-INFORMATION, origin=AUTOSAR_ECUC V1.0.0  # Minor version number of AUTOSAR specification on which the appropriate implementation is based on.
      integer ArPatchVersion: implementation-config-class=PUBLISHED-INFORMATION, origin=AUTOSAR_ECUC V1.0.0  # Patch level version number of AUTOSAR specification on which the appropriate implementation is based on.
      integer ModuleId: implementation-config-class=PUBLISHED-INFORMATION, origin=AUTOSAR_ECUC V1.0.0  # Module ID of this module from Module List
      integer SwMajorVersion: implementation-config-class=PUBLISHED-INFORMATION, origin=AUTOSAR_ECUC V1.0.0  # Major version number of the vendor specific implementation of the module. The numbering is vendor specific.
      integer SwMinorVersion: implementation-config-class=PUBLISHED-INFORMATION, origin=AUTOSAR_ECUC V1.0.0  # Minor version number of the vendor specific implementation of the module. The numbering is vendor specific.
      integer SwPatchVersion: implementation-config-class=PUBLISHED-INFORMATION, origin=AUTOSAR_ECUC V1.0.0  # Patch level version number of the vendor specific implementation of the module. The numbering is vendor specific.
      string VendorApiInfix [0..1]: implementation-config-class=PUBLISHED-INFORMATION, origin=AUTOSAR_ECUC V1.0.0  # In driver modules which can be instantiated several times on a single ECU, BSW00347 requires that the name of APIs is extended by the VendorId and a vendor specific name. This parameter is used to specify the vendor specific name. In total, the implementation specific name is generated as follows: <ModuleName>_>VendorId>_<VendorApiInfix><Api name from SWS>. E.g. assuming that the VendorId of the implementor is 123 and the implementer chose a VendorApiInfix of "v11r456" a api name Can_Write defined in the SWS will translate to Can_123_v11r456Write. This parameter is mandatory for all modules with upper multiplicity > 1. It shall not be used for modules with upper multiplicity =1.
      integer VendorId: implementation-config-class=PUBLISHED-INFORMATION, origin=AUTOSAR_ECUC V1.0.0  # Vendor ID of the dedicated implementation of this module according to the AUTOSAR vendor list
    container FrTrcvGeneral  # Container gives CAN transceiver driver basic information.
      boolean FrTrcvDevErrorDetect: origin=AUTOSAR_ECUC V1.0.0  # Switches development error detection and notification on and off. If switched on, #define FRTRCV_DEV _ERROR_DETECT ON shall be generated. If switched off, #define FRTRCV_DEV_ERROR _DETECT OFF shall be generated. Define shall be part of file FrTrcv_Cfg.h.
      boolean FrTrcvGetVersionInfo: origin=AUTOSAR_ECUC V1.0.0  # Switches version information API on and off. If switched off, function need not be present in compiled code.
      float FrTrcvMainFunctionCycleTime: origin=AUTOSAR_ECUC V1.0.0  # Cyclic call time for function FrTrcvMainFunction in seconds. A call time of 0ms indicates no calls for this function. In this case function need not be present in compiled code.
      boolean FrTrcvReceiveonlySupport: origin=AUTOSAR_ECUC V1.1.0  # Information if the optional transceiver state RECEIVEONLY is supported by the driver and hardware.
      boolean FrTrcvSleepSupported: origin=AUTOSAR_ECUC V1.1.0  # Information if the optional transceiver state SLEEP is supported by the driver and hardware.
    container FrTrcvNode [1..*]  # Container gives FlexRay transceiver driver information about a single FlexRay transceiver node. Any FlexRay transceiver driver has such FlexRay transceiver nodes.
      boolean FrTrcvControlsPowerSupply: origin=AUTOSAR_ECUC V1.0.0  # Is ECU power supply controlled by this transceiver?
      enumeration FrTrcvInitState: {FrTrcvTrcvmodeNormal, FrTrcvTrcvmodeReceiveonly, FrTrcvTrcvmodeSleep, FrTrcvTrcvmodeStandby}, origin=AUTOSAR_ECUC V1.0.0  # State of FlexRay transceiver after power on.
      integer FrTrcvMaxBaudrate: origin=AUTOSAR_ECUC V1.1.0  # Max baudrate for transceiver hardware type. Only used for validation purposes. Value shall be configured by configuration tool based on FRTRCV_HARDWARE_NAME and internal information about ability of this hardware typel.
      integer FrTrcvNodeId: origin=AUTOSAR_ECUC V1.1.0, symbolic-name-value=true  # Unique node id. It is used by ComM by Icu and internally.
      boolean FrTrcvWakeupByNodeUsed: origin=AUTOSAR_ECUC V1.1.0  # Is wake up by node supported? If FlexRay transceiver hardware does not support wake up by node value is always FALSE. If FlexRay transceiver hardware supports wake up by node value is TRUE or FALSE depending whether it is used or not.
      boolean FrTrcvWakeupPolling: origin=AUTOSAR_ECUC V1.1.0  # Information of this entitiy is only relevant if parameter FrTrcvWakeup-ByTransceiverUsed is TRUE. Information whether wake up events will be performed in main function (TRUE) or by a callback function called by an interrupt service (FALSE).
  module definition Gpt [0..1]  # Configuration of the Gpt (General Purpose Timer) module.
    container CommonPublishedInformation  # Common container, aggregated by all modules. It contains published information about vendor and versions.
      integer ArMajorVersion: implementation-config-class=PUBLISHED-INFORMATION, origin=AUTOSAR_ECUC V1.0.0  # Major version number of AUTOSAR specification on which the appropriate implementation is based on.
      integer ArMinorVersion: implementation-config-class=PUBLISHED-INFORMATION, origin=AUTOSAR_ECUC V1.0.0  # Minor version number of AUTOSAR specification on which the appropriate implementation is based on.
      integer ArPatchVersion: implementation-config-class=PUBLISHED-INFORMATION, origin=AUTOSAR_ECUC V1.0.0  # Patch level version number of AUTOSAR specification on which the appropriate implementation is based on.
      integer ModuleId: implementation-config-class=PUBLISHED-INFORMATION, origin=AUTOSAR_ECUC V1.0.0  # Module ID of this module from Module List
      integer SwMajorVersion: implementation-config-class=PUBLISHED-INFORMATION, origin=AUTOSAR_ECUC V1.0.0  # Major version number of the vendor specific implementation of the module. The numbering is vendor specific.
      integer SwMinorVersion: implementation-config-class=PUBLISHED-INFORMATION, origin=AUTOSAR_ECUC V1.0.0  # Minor version number of the vendor specific implementation of the module. The numbering is vendor specific.
      integer SwPatchVersion: implementation-config-class=PUBLISHED-INFORMATION, origin=AUTOSAR_ECUC V1.0.0  # Patch level version number of the vendor specific implementation of the module. The numbering is vendor specific.
      string VendorApiInfix [0..1]: implementation-config-class=PUBLISHED-INFORMATION, origin=AUTOSAR_ECUC V1.0.0  # In driver modules which can be instantiated several times on a single ECU, BSW00347 requires that the name of APIs is extended by the VendorId and a vendor specific name. This parameter is used to specify the vendor specific name. In total, the implementation specific name is generated as follows: <ModuleName>_>VendorId>_<VendorApiInfix><Api name from SWS>. E.g. assuming that the VendorId of the implementor is 123 and the implementer chose a VendorApiInfix of "v11r456" a api name Can_Write defined in the SWS will translate to Can_123_v11r456Write. This parameter is mandatory for all modules with upper multiplicity > 1. It shall not be used for modules with upper multiplicity =1.
      integer VendorId: implementation-config-class=PUBLISHED-INFORMATION, origin=AUTOSAR_ECUC V1.0.0  # Vendor ID of the dedicated implementation of this module according to the AUTOSAR vendor list
    container GptChannelConfigSet  # This container is the base of an Configuration Set which contains the configured GPT channels. This way, different configuration sets can be defined for post-build process.
      container GptChannelConfiguration [1..*]  # This container contains the channel-wide configuration (parameters) of the GPT Driver
        integer GptChannelClkSrc [0..1]: origin=AUTOSAR_ECUC V1.0.0  # The GPT module specific clock input for the timer unit can statically be configured and allows to select different clock sources (external clock, internal GPT specific clock) per channel
        integer GptChannelId: 0.., origin=AUTOSAR_ECUC V1.0.0, symbolic-name-value=true  # Channel Id of the GPT channel. This value will be assigned to the symbolic name derived of the GptChannelConfiguration container short name.
        enumeration GptChannelMode: {GptModeContinuous, GptModeOneshot}, origin=AUTOSAR_ECUC V1.0.0  # Specifies the behaviour of the timerchannel after the timeout has expired
        integer GptChannelPrescale [0..1]: origin=AUTOSAR_ECUC V1.0.0  # GPT module specific prescaler factor per channel
        boolean GptEnableWakeup: origin=AUTOSAR_ECUC V1.0.0  # Enables wakeup capability of CPU for a channel when timeout period expires. This might be different to enabling the notification depending on hardware capabilities
        function name GptNotification: origin=AUTOSAR_ECUC V1.1.0  # Function pointer to callback function
        container GptWakeupConfiguration [0..1]
          integer GptChannelWakeupInfo: origin=AUTOSAR_ECUC V1.0.0  # In case the wakeup-capability is true this value is transmitted to the Ecu State Manager
    container GptConfigurationOfOptApiServices  # This container contains all configuration switches for configuring optional API services of the GPT driver
      boolean GptDeinitApi: origin=AUTOSAR_ECUC V1.0.0  # Adds / removes the service Gpt_DeInit() from the code.
      boolean GptEnableDisableNotificationApi: origin=AUTOSAR_ECUC V1.0.0  # Adds / removes the services Gpt_EnableNotification() and Gpt_DisableNotification from the code.
      boolean GptStartStopTimerApi: origin=AUTOSAR_ECUC V1.0.0  # Adds / removes the services Gpt_StartTimer() and Gpt_StopTimer() from the code.
      boolean GptTimeElapsedApi: origin=AUTOSAR_ECUC V1.0.0  # Adds / removes the service Gpt_GetTimeElapsed() from the code
      boolean GptTimeRemainingApi: origin=AUTOSAR_ECUC V1.0.0  # Adds / removes the service Gpt_GetTimeRemaining() from the code.
      boolean GptVersionInfoApi: origin=AUTOSAR_ECUC V1.0.0  # Adds / removes the service Gpt_GetVersionInfo() from the code.
      boolean GptWakeupFunctionalityApi: origin=AUTOSAR_ECUC V1.1.0  # Adds / removes the services Gpt_SetMode(), Gpt_EnableWakeup() and Gpt_DisableWakeup() from the code
    container GptDriverConfiguration  # This container contains the module-wide configuration (parameters) of the GPT Driver
      boolean GptDevErrorDetect: origin=AUTOSAR_ECUC V1.0.0  # Enables/Disables development error detection
      boolean GptReportWakeupSource: origin=AUTOSAR_ECUC V1.0.0  # Enables/Disables wakeup source reporting
  module definition IPduMplex [0..1]  # Configuration of the IPduMplex (IPdu Multiplexer) module.
    container CommonPublishedInformation  # Common container, aggregated by all modules. It contains published information about vendor and versions.
      integer ArMajorVersion: implementation-config-class=PUBLISHED-INFORMATION, origin=AUTOSAR_ECUC V1.0.0  # Major version number of AUTOSAR specification on which the appropriate implementation is based on.
      integer ArMinorVersion: implementation-config-class=PUBLISHED-INFORMATION, origin=AUTOSAR_ECUC V1.0.0  # Minor version number of AUTOSAR specification on which the appropriate implementation is based on.
      integer ArPatchVersion: implementation-config-class=PUBLISHED-INFORMATION, origin=AUTOSAR_ECUC V1.0.0  # Patch level version number of AUTOSAR specification on which the appropriate implementation is based on.
      integer ModuleId: implementation-config-class=PUBLISHED-INFORMATION, origin=AUTOSAR_ECUC V1.0.0  # Module ID of this module from Module List
      integer SwMajorVersion: implementation-config-class=PUBLISHED-INFORMATION, origin=AUTOSAR_ECUC V1.0.0  # Major version number of the vendor specific implementation of the module. The numbering is vendor specific.
      integer SwMinorVersion: implementation-config-class=PUBLISHED-INFORMATION, origin=AUTOSAR_ECUC V1.0.0  # Minor version number of the vendor specific implementation of the module. The numbering is vendor specific.
      integer SwPatchVersion: implementation-config-class=PUBLISHED-INFORMATION, origin=AUTOSAR_ECUC V1.0.0  # Patch level version number of the vendor specific implementation of the module. The numbering is vendor specific.
      string VendorApiInfix [0..1]: implementation-config-class=PUBLISHED-INFORMATION, origin=AUTOSAR_ECUC V1.0.0  # In driver modules which can be instantiated several times on a single ECU, BSW00347 requires that the name of APIs is extended by the VendorId and a vendor specific name. This parameter is used to specify the vendor specific name. In total, the implementation specific name is generated as follows: <ModuleName>_>VendorId>_<VendorApiInfix><Api name from SWS>. E.g. assuming that the VendorId of the implementor is 123 and the implementer chose a VendorApiInfix of "v11r456" a api name Can_Write defined in the SWS will translate to Can_123_v11r456Write. This parameter is mandatory for all modules with upper multiplicity > 1. It shall not be used for modules with upper multiplicity =1.
      integer VendorId: implementation-config-class=PUBLISHED-INFORMATION, origin=AUTOSAR_ECUC V1.0.0  # Vendor ID of the dedicated implementation of this module according to the AUTOSAR vendor list
    container IPduMGeneral  # Contains the general configuration parameters of IPduMplex.
      float IPduMConfigurationTimeBase: origin=AUTOSAR_ECUC V1.0.0  # The period between successive ticks of AUTOSAR COM in seconds.
      boolean IPduMDevErrorDetect: origin=AUTOSAR_ECUC V1.0.0  # Active/Deactivate the detection of development errors, for production code this parameter has to be OFF.
      boolean IPduMStaticPartExists: origin=AUTOSAR_ECUC V1.0.0  # This is to allow optimizations in the case the IPduM will never be used with a static part. Note that this is a pre-compile option. If this is set to NO then it will not be possible to add static parts after compilation.
      boolean IPduMVersionInfoApi: origin=AUTOSAR_ECUC V1.0.0  # Active/Deactivate the version information API.
    container IPduMRxPathway [0..*]  # Contains the configuration parameters received I-PDUs by the IPduM module.
      container IPduMRxIndication  # Contains the configuration for incoming RxIndication calls.
        integer IPduMRxHandleId: origin=AUTOSAR_ECUC V1.0.0, symbolic-name-value=true  # This is the I-PDU ID of the incoming I-PDU. If an incoming RxIndication's I-PDU ID matches this value then it is unpacked according to the specification in this container.
        reference def IPduMRxIndicationPduRef: lower-multiplicity=1, upper-multiplicity=1, origin=AUTOSAR_ECUC V1.0.0, destination=Pdu  # Reference to the received Pdu representation in the ECU Configuration Description exchange file.
        container IPduMBitField  # This is used to specify a contiguous range of bits within an I-PDU. The range is inclusive.
          integer IPduMEndBit: 0..63, origin=AUTOSAR_ECUC V1.0.0  # Bit position in an I-PDU of the end of the bit field.
          integer IPduMStartBit: 0..63, origin=AUTOSAR_ECUC V1.0.0  # Bit position in an I-PDU of the start of the bit field.
        container IPduMRxDynamicPart [1..*]  # This container contains the configuration for the dynamic part of incoming RxIndication calls. When an incoming received I-PDU's selector field matches the IPDUM_SELECTOR_VALUE the I-PDU is unpacked according to the values in the IPDUM_COPY_BITFIELD and then the new I-PDU constructed and sent out with the I-PDU ID in IPDUM_OUTGOING_HANDLE_ID.
          integer IPduMRxSelectorValue: 0..255, origin=AUTOSAR_ECUC V1.0.0  # This is the selector value that this container refers to.
          reference def IPduMOutgoingDynamicPduRef: lower-multiplicity=1, upper-multiplicity=1, origin=AUTOSAR_ECUC V1.0.0, destination=Pdu  # When the new I-PDU is sent out it is sent with this I-PDU ID. Reference to the sent Pdu representation in the ECU Configuration Description exchange file.
          container IPduMCopyBitField [1..*]  # Two bit fields are specified, a source and a destination, so that the bits in the source can be copied to the bits in the destination. Within one I-PDU multiple instances of this container are used to specify the bit fields in that I-PDU. Adjacent bit fields could be merged in order to reduce the number of instances of this container.
            container IPduMBitField  # This is used to specify a contiguous range of bits within an I-PDU. The range is inclusive.
              integer IPduMEndBit: 0..63, origin=AUTOSAR_ECUC V1.0.0  # Bit position in an I-PDU of the end of the bit field.
              integer IPduMStartBit: 0..63, origin=AUTOSAR_ECUC V1.0.0  # Bit position in an I-PDU of the start of the bit field.
        container IPduMRxStaticPart [0..1]  # This container contains the information on how to unpack the static part of an incoming I-PDU.
          reference def IPduMOutgoingStaticPduRef: lower-multiplicity=1, upper-multiplicity=1, origin=AUTOSAR_ECUC V1.0.0, destination=Pdu  # When the new I-PDU is sent out it is sent with this I-PDU ID. Reference to the sent Pdu representation in the ECU Configuration Description exchange file.
          container IPduMCopyBitField [1..*]  # Two bit fields are specified, a source and a destination, so that the bits in the source can be copied to the bits in the destination. Within one I-PDU multiple instances of this container are used to specify the bit fields in that I-PDU. Adjacent bit fields could be merged in order to reduce the number of instances of this container.
            container IPduMBitField  # This is used to specify a contiguous range of bits within an I-PDU. The range is inclusive.
              integer IPduMEndBit: 0..63, origin=AUTOSAR_ECUC V1.0.0  # Bit position in an I-PDU of the end of the bit field.
              integer IPduMStartBit: 0..63, origin=AUTOSAR_ECUC V1.0.0  # Bit position in an I-PDU of the start of the bit field.
    container IPduMTxPathway [0..*]  # Contains the configuration parameters transmitted I-PDUs by the IPduM module.
      container IPduMTxConfirmation [0..1]  # A transmit request can be confirmed by the lower layer. This container is used to generate the matching confirmations for the static and dynamic parts of a multiplexed I-PDU. When an I-PDU is transmitted by the IPduM, the selector field value in that PDU needs to be stored in the IPduM so that the confirmation for the correct dynamic part can be generated. This is state internal to the IPduM at run-time. For the purposes of this container and IPDUM_DYNAMIC_CONFIRMATION this stored state is called Stored_Selector.
        reference def IPduMConfirmedIPduRef: lower-multiplicity=1, upper-multiplicity=1, origin=AUTOSAR_ECUC V1.0.0, destination=Pdu  # This is the I-PDU ID of the previously transmitted I-PDU that is to be confirmed. Therefore, the value of this entity must match one of the set of IPDUM_OUTGOING_IPDU_ID in IPDUM_TX_REQUEST_CONFIGURATION. This is the ID of the IPduM I-PDU.
        reference def IPduMStaticTxConfirmationIPduRef: lower-multiplicity=1, upper-multiplicity=1, origin=AUTOSAR_ECUC V1.0.0, destination=Pdu  # This is the I-PDU ID to use in the TxConfirmation for the static part. It is a COM I-PDU ID.
        container IPduMDynamicTxConfirmation [1..*]  # The dynamic part of an I-PDU can have more than one I-PDU IDs for confirmations. The correct I-PDU ID for the confirmation is found from the selector field value of a previously transmitted I-PDU. It is assumed that this selector field is stored in some internal value called Stored_Selector. When a transmit confirmation is received the Stored_Selector is used to select an instance of IPDUM_DYNAMIC_CONFIRMATION by matching the Stored_Selector with the IPDUM_SELECTOR_VALUE.
          integer IPduMSelectorValue: origin=AUTOSAR_ECUC V1.0.0  # When the selector field of the confirmed I-PDU matches the value in here then generate a TxConfirmation with the I-PDU ID indicated using the IPDUM_CONFIRMATION_ID value.
          reference def IPduMDynamicTxConfirmIPduRef: lower-multiplicity=1, upper-multiplicity=1, origin=AUTOSAR_ECUC V1.0.0, destination=Pdu  # This is the I-PDU ID to use in the outgoing confirmation (confirmation for the COM I-PDU) when an incoming confirmation (for an IPduM I-PDU) is received and matches the stored Stored_Selector.
      container IPduMTxRequest  # This is used to specify the configuration for Transmit requests. There will one instance of this container for each I-PDU that can be requested for transmission (the outgoing I-PDUs) by the IPduM.
        integer IPduMIPduUnusedAreasDefault [0..1]: 0..255, origin=AUTOSAR_ECUC V1.0.0  # IPduM module fills not used areas of an I-PDU with this bit-pattern If this attribute is omitted the IPduM module does not fill the I-PDU.
        integer IPduMInitialSelectorValue: 0..255, origin=AUTOSAR_ECUC V1.0.0  # This value is used by the initialization function to set the initial value of the selector field.
        integer IPduMSize: 1..64, origin=AUTOSAR_ECUC V1.0.0  # Size of the outgoing I-PDU in bits.
        float IPduMTxConfirmationTimeout [0..1]: origin=AUTOSAR_ECUC V1.0.0  # This timeout defines the timeout period for monitoring the reception of the TxConfirmation. It is not used when an I-PDU is requested using the trigger transmit API.
        enumeration IPduMTxTriggerMode: {DynamicPartTrigger, None, StaticOrDynamicPartTrigger, StaticPartTrigger}, origin=AUTOSAR_ECUC V1.0.0  # Selects whether to send the multiplexed I-PDU immediately or at some later date.
        reference def IPduMOutgoingPduRef: lower-multiplicity=1, upper-multiplicity=1, origin=AUTOSAR_ECUC V1.0.0, destination=Pdu  # Reference to the Pdu defining the outgoing I-Pdu. When the outgoing I-PDU is sent this is the I-Pdu ID to give it. It is the IPduM I-PDU ID of the assembled I-PDU.
        container IPduMBitField  # This is used to specify a contiguous range of bits within an I-PDU. The range is inclusive.
          integer IPduMEndBit: 0..63, origin=AUTOSAR_ECUC V1.0.0  # Bit position in an I-PDU of the end of the bit field.
          integer IPduMStartBit: 0..63, origin=AUTOSAR_ECUC V1.0.0  # Bit position in an I-PDU of the start of the bit field.
        container IPduMTxDynamicPart [1..*]  # Configuration parameters for an instance of a Tx_Request call into the IPduM. When a Tx Request with the IPDUM_HANDLE_ID is received by the IPduM, the bit fields in the incoming I-PDU are packed into the outgoing I-PDU buffer and then the send mode honored. This container is used the dynamic part of a TxRequest configuration. Therefore, for each outgoing I-PDU there will be one instance of this container for the dynamic part.
          integer IPduMTxDynamicHandleId: origin=AUTOSAR_ECUC V1.0.0, symbolic-name-value=true  # This is an incoming handle id. When the handle of an incoming Tx Request matches this, the bits fields (see Ipdum_CopyBitField) are copied and the Ipdum_TxTriggerMode is honored.
          reference def IPduMTxDynamicPduRef: lower-multiplicity=1, upper-multiplicity=1, origin=AUTOSAR_ECUC V1.0.0, destination=Pdu  # Reference to the Pdu representation in the ECU Configuration Description exchange file to be transmitted.
          container IPduMCopyBitField [1..*]  # Two bit fields are specified, a source and a destination, so that the bits in the source can be copied to the bits in the destination. Within one I-PDU multiple instances of this container are used to specify the bit fields in that I-PDU. Adjacent bit fields could be merged in order to reduce the number of instances of this container.
            container IPduMBitField  # This is used to specify a contiguous range of bits within an I-PDU. The range is inclusive.
              integer IPduMEndBit: 0..63, origin=AUTOSAR_ECUC V1.0.0  # Bit position in an I-PDU of the end of the bit field.
              integer IPduMStartBit: 0..63, origin=AUTOSAR_ECUC V1.0.0  # Bit position in an I-PDU of the start of the bit field.
        container IPduMTxStaticPart [0..1]  # Configuration parameters for an instance of a Tx_Request call into the IPduM. When a Tx Request with the IPDUM_HANDLE_ID is received by the IPduM, the bit fields in the incoming I-PDU are packed into the outgoing I-PDU buffer and then the send mode honored. This container is used for the static part of a TxRequest configuration. Therefore, for each outgoing I-PDU there will be one instance of this container for the static part if it exists.
          integer IPduMTxStaticHandleId: origin=AUTOSAR_ECUC V1.0.0, symbolic-name-value=true  # This is an incoming handle id. When the handle of an incoming Tx Request matches this, the bits fields (see Ipdum_CopyBitField) are copied and the Ipdum_TxTriggerMode is honored.
          reference def IPduMTxStaticPduRef: lower-multiplicity=1, upper-multiplicity=1, origin=AUTOSAR_ECUC V1.0.0, destination=Pdu  # Reference to the Pdu representation in the ECU Configuration Description exchange file to be transmitted.
          container IPduMCopyBitField [1..*]  # Two bit fields are specified, a source and a destination, so that the bits in the source can be copied to the bits in the destination. Within one I-PDU multiple instances of this container are used to specify the bit fields in that I-PDU. Adjacent bit fields could be merged in order to reduce the number of instances of this container.
            container IPduMBitField  # This is used to specify a contiguous range of bits within an I-PDU. The range is inclusive.
              integer IPduMEndBit: 0..63, origin=AUTOSAR_ECUC V1.0.0  # Bit position in an I-PDU of the end of the bit field.
              integer IPduMStartBit: 0..63, origin=AUTOSAR_ECUC V1.0.0  # Bit position in an I-PDU of the start of the bit field.
  module definition Icu [0..*]  # Configuration of the Icu (Input Capture Unit) module.
    container CommonPublishedInformation  # Common container, aggregated by all modules. It contains published information about vendor and versions.
      integer ArMajorVersion: implementation-config-class=PUBLISHED-INFORMATION, origin=AUTOSAR_ECUC V1.0.0  # Major version number of AUTOSAR specification on which the appropriate implementation is based on.
      integer ArMinorVersion: implementation-config-class=PUBLISHED-INFORMATION, origin=AUTOSAR_ECUC V1.0.0  # Minor version number of AUTOSAR specification on which the appropriate implementation is based on.
      integer ArPatchVersion: implementation-config-class=PUBLISHED-INFORMATION, origin=AUTOSAR_ECUC V1.0.0  # Patch level version number of AUTOSAR specification on which the appropriate implementation is based on.
      integer ModuleId: implementation-config-class=PUBLISHED-INFORMATION, origin=AUTOSAR_ECUC V1.0.0  # Module ID of this module from Module List
      integer SwMajorVersion: implementation-config-class=PUBLISHED-INFORMATION, origin=AUTOSAR_ECUC V1.0.0  # Major version number of the vendor specific implementation of the module. The numbering is vendor specific.
      integer SwMinorVersion: implementation-config-class=PUBLISHED-INFORMATION, origin=AUTOSAR_ECUC V1.0.0  # Minor version number of the vendor specific implementation of the module. The numbering is vendor specific.
      integer SwPatchVersion: implementation-config-class=PUBLISHED-INFORMATION, origin=AUTOSAR_ECUC V1.0.0  # Patch level version number of the vendor specific implementation of the module. The numbering is vendor specific.
      string VendorApiInfix [0..1]: implementation-config-class=PUBLISHED-INFORMATION, origin=AUTOSAR_ECUC V1.0.0  # In driver modules which can be instantiated several times on a single ECU, BSW00347 requires that the name of APIs is extended by the VendorId and a vendor specific name. This parameter is used to specify the vendor specific name. In total, the implementation specific name is generated as follows: <ModuleName>_>VendorId>_<VendorApiInfix><Api name from SWS>. E.g. assuming that the VendorId of the implementor is 123 and the implementer chose a VendorApiInfix of "v11r456" a api name Can_Write defined in the SWS will translate to Can_123_v11r456Write. This parameter is mandatory for all modules with upper multiplicity > 1. It shall not be used for modules with upper multiplicity =1.
      integer VendorId: implementation-config-class=PUBLISHED-INFORMATION, origin=AUTOSAR_ECUC V1.0.0  # Vendor ID of the dedicated implementation of this module according to the AUTOSAR vendor list
    container IcuConfigSet  # This container is the base for a multiple configuration set
      derived integer IcuMaxChannel: 0.., origin=AUTOSAR_ECUC V1.0.0  # This parameter contains the number of Channels configured. It will be gathered by tools during the configuration stage. calculationFormula = Number of configured Icu Channels
      container IcuChannel [1..*]  # Configuration of an individual ICU channel.
        integer IcuChannelId: 0.., origin=AUTOSAR_ECUC V1.0.0, symbolic-name-value=true  # Channel Id of the ICU channel. This value will be assigned to the symbolic name derived of the IcuChannel container short name.
        enumeration IcuDefaultStartEdge: {IcuBothEdges, IcuFallingEdge, IcuRisingEdge}, origin=AUTOSAR_ECUC V1.0.0  # Configures the default-activation-edge which shall be used for this channel if there was no activation-edge configured by the call of service Icu_SetActivationCondition(). In case the Measurement Mode is "SignalMeasurement" and the properties DutyCycle or Period are set, the edge configured here is used as Default Period Start Edge.
        enumeration IcuMeasurementMode: {IcuEdgeCounter, IcuSignalEdgeDetection, IcuSignalMeasurement, IcuTimestamp}, origin=AUTOSAR_ECUC V1.0.0  # Configures the measurement mode of this channel.
        boolean IcuWakeupCapability: origin=AUTOSAR_ECUC V1.0.0  # Boolean flag whether wake-up on this channel is supported or not.
        container IcuEdgeCounterMeasurement [0..1]  # This container contains the configuration (parameters) in case the measurement mode is "IcuEdgeCounter"
        container IcuSignalEdgeDetection [0..1]  # This container contains the configuration (parameters) in case the measurement mode is "IcuSignalEdgeDetection"
          function name IcuSignalNotification: origin=AUTOSAR_ECUC V1.0.0, default-value="NULL"  # Notification function for signal notification.
        container IcuSignalMeasurement [0..1]  # This container contains the configuration (parameters) in case the measurement mode is "IcuSignalMeasurement"
          enumeration IcuSignalMeasurementProperty: {IcuDutyCycle, IcuHighTime, IcuLowTime, IcuPeriodTime}, origin=AUTOSAR_ECUC V1.0.0  # Configures the property that could be measured in case the mode is "IcuSignalMeasurement". This property can not be changed during runtime.
        container IcuTimestampMeasurement [0..1]  # This container contains the configuration (parameters) in case the measurement mode is "IcuTimestamp"
          enumeration IcuTimestampMeasurementProperty: {IcuCircularBuffer, IcuLinearBuffer}, origin=AUTOSAR_ECUC V1.0.0  # Configures the handling of the buffer in case the mode is "Timestamp"
          function name IcuTimestampNotification: origin=AUTOSAR_ECUC V1.0.0  # Notification function if the number of requested timestamps (Notification interval > 0) are acquired.
        container IcuWakeup [0..1]  # This container contains the configuration (parameters) needed to configure a wakeup capable channel
          symbolic name reference IcuChannelWakeupInfo: origin=AUTOSAR_ECUC V1.0.0, destination=EcuMWakeupSourceConfig  # If the wakeup-capability is true the wakeup source referenced is transmitted to the ECU State Manager (EcuM) .
    container IcuGeneral  # Configuration of general ICU parameters.
      boolean IcuDevErrorDetect: origin=AUTOSAR_ECUC V1.0.0  # Switches the Development Error Detection and Notification ON or OFF
      boolean IcuReportWakeupSource: origin=AUTOSAR_ECUC V1.0.0  # Switch for enabling Wakeup source reporting.
    container IcuOptionalApis  # This container contains all configuration switches for configuring optional API services of the ICU driver.
      boolean IcuDeInitApi: origin=AUTOSAR_ECUC V1.0.0  # Adds / removes the service Icu_DeInit() from the code
      boolean IcuDisableWakeupApi: origin=AUTOSAR_ECUC V1.0.0  # Adds / removes the service Icu_DisableWakeup() from the code.
      boolean IcuEdgeCountApi: origin=AUTOSAR_ECUC V1.0.0  # Adds / removes all services related to the edge counting functionality as listed below, from the code: Icu_ResetEdgeCount(), Icu_EnableEdgeCount(), Icu_DisableEdgeCount(), Icu_GetEdgeNumbers()
      boolean IcuEnableWakeupApi: origin=AUTOSAR_ECUC V1.0.0  # Adds / removes the service Icu_EnableWakeup() from the code.
      boolean IcuGetDutyCycleValuesApi: origin=AUTOSAR_ECUC V1.0.0  # Adds / removes the service Icu_GetDutyCycleValues() from the code.
      boolean IcuGetInputStateApi: origin=AUTOSAR_ECUC V1.0.0  # Adds / removes the service Icu_GetInputState() from the code.
      boolean IcuGetTimeElapsedApi: origin=AUTOSAR_ECUC V1.0.0  # Adds / removes the service Icu_GetTimeElapsed() from the code.
      boolean IcuGetVersionInfoApi: origin=AUTOSAR_ECUC V1.0.0  # Adds / removes the service Icu_ GetVersionInfo() from the code.
      boolean IcuSetModeApi: origin=AUTOSAR_ECUC V1.0.0  # Adds / removes the service Icu_SetMode() from the code
      boolean IcuTimestampApi: origin=AUTOSAR_ECUC V1.0.0  # Adds / removes all services related to the timestamping functionality as listed below from the code: Icu_StartTimestamp(), Icu_StopTimestamp(), Icu_GetTimestampIndex()
