AUTOSAR XML (schema 3.0.1)
package /MICROSAR
  bsw implementation GenyAsrBase_Impl: programming-language=C, vendor-id=30, ar-major-version=3, ar-minor-version=0, ar-patch-version=1, vendor-specific-module-def=GenTool_GenyAsrBase_Def
  module definition GenTool_GenyAsrBase_Def: variants pre-compile
    container General
      enumeration AsrBaseMaxShortnameLength: {L32, L128}, origin=Vector Informatik, default-value=32  # If a Short Name exeeds this length during import/export, warnings will be displayed
