AUTOSAR XML (schema 3.1.4)
package /TTTECH
  bsw implementation WdgIf_Impl: code-generator=TTTech, programming-language=C, sw-major-version=2, sw-minor-version=0, sw-patch-version=2, vendor-id=46, ar-major-version=4, ar-minor-version=0, ar-patch-version=1, preconfigured-configuration=WdgIf_Pre, vendor-specific-module-def=WdgIf
  module definition WdgIf [0..1]: refined-module-def=WdgIf, variants pre-compile  # Configuration of the WdgIf (Watchdog Interface) module.
    container WdgIfDevice [1..*]
      integer WdgIfDeviceIndex: set at pre-compile, symbolic-name-value=true  # Represents the watchdog Device ID so that it can be referenced by the watchdog manager.
      symbolic name reference WdgIfDriverRef: set at pre-compile, destination=WdgGeneral  # Reference to the watchdog driver of this watchdog device.
    container WdgIfGeneral  # This container collects all generic watchdog interface parameters.
      boolean WdgIfDevErrorDetect: set at pre-compile  # Pre-processor switch for enabling the development error reporting. true: Development error reporting enabled false: Development error reporting disabled
      boolean WdgIfDemReport: set at pre-compile  # Compile switch to enable / disable calls to DEM in case of production error detection. True: DEM calls enabled in case of production errors False: DEM calls disabled in case of production errors
      boolean WdgIfVersionInfoApi: set at pre-compile  # Pre-processor switch to enable / disable the service returning the version information. true: Version information service enabled false: Version information service disabled
      choice reference WdgIfInternalTickCounterRef [0..1]: set at pre-compile, destination=Wdg  # If this parameter references a driver which implements an internal tick counter then the API WdgIf_InternalTickCounter() is compiled and can be used by the Safe Watchdog Manager. Otherwise the API is not compiled. Note: If a driver is selected then it must support internal tick counter and its parameter WdgInternalTickCounter must be set to true.
  module config WdgIf_Pre: definition=WdgIf, implementation-config-variant=VARIANT-PRE-COMPILE
