AUTOSAR XML (schema 3.1.0)
package /TMS570PSFC66
  bsw implementation BSWMD: code-generator=cMICROSAR, programming-language=C, preconfigured-configuration=Fee_Pre, vendor-specific-module-def=Fee
  module config Fee_Pre: definition=Fee
    FeePublishedInformation: FeeBlockOverhead=24, FeeMaximumBlockingTime=600.0, FeePageOverhead=0, FeeVirtualSectorOverhead=16
    FeeGeneral: FeeDeviceIndex=0, FeeVirtualPageSize=8
