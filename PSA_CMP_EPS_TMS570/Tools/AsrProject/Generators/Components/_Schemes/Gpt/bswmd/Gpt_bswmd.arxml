AUTOSAR XML (schema 3.0.1)
# COPYRIGHT
# Copyright (c) 2009 by Vector Informatik GmbH. All rights reserved.
# This software is copyright protected and proprietary to Vector Informatik GmbH.
# Vector Informatik GmbH grants to you only those rights as set out in the license conditions.
package /MICROSAR
  module definition Gpt [0..1]: refined-module-def=Gpt, variants post-build  # Configuration of the Gpt (General Purpose Timer) module.
    container GptChannelConfigSet [1..*]: multiple-configuration-container=true  # This container is the base of an Configuration Set which contains the configured GPT channels. This way, different configuration sets can be defined for post-build process.
      string GptClockFrequency: set at post-build, origin=Vector Informatik, default-value=0  # Clock Frequency derived from Mcu RTICLK
      string GptMainclock: set at post-build, origin=Vector Informatik  # Clock Source derived from Mcu (RTICLK1 or RTICLK2)
      string GptMcuClockconfig: set at post-build, origin=Vector Informatik  # Clock Configuration derived from Mcu
      string GptMcuVariant: set at post-build, origin=Vector Informatik  # Runtime derived from Mcu
      integer GptChannelPrescaleClk0: 1..255, set at post-build, origin=Vector Informatik, default-value=1  # Prescale Value for Counter Block 0
      integer GptChannelPrescaleClk1: 1..255, set at post-build, origin=Vector Informatik, default-value=1  # Prescale Value for Counter Block 1
      container GptChannelConfiguration [1..2]  # This container contains the channel-wide configuration (parameters) of the GPT Driver
        integer GptChannelClkSrc: 0..1, set at post-build, default-value=0  # The GPT module specific clock input for the timer unit can statically be configured and allows to select different clock sources (external clock, internal GPT specific clock) per channel
        integer GptChannelId: 0..1, set at post-build, symbolic-name-value=true, default-value=0  # Channel Id of the GPT channel. This value will be assigned to the symbolic name derived of the GptChannelConfiguration container short name. Parameter not used.
        enumeration GptChannelMode: {GPT_MODE_CONTINUOUS, GPT_MODE_ONESHOT}, set at post-build, default-value=GPT_MODE_ONESHOT  # Specifies the behaviour of the timerchannel after the timeout has expired
        integer GptChannelPrescale: 0..1, set at post-build, default-value=0  # GPT module specific prescaler factor per channel
        boolean GptEnableWakeup: set at post-build, default-value=false  # Enables wakeup capability of CPU for a channel when timeout period expires. This might be different to enabling the notification depending on hardware capabilities
        function name GptNotification: set at post-build, default-value=NULL_PTR  # Function pointer to callback function
        string GptHwChannel: set at post-build, origin=Vector Informatik, default-value=COMP0_on_Counter0  # This parameter describes the hardware module where the timer channel is assigned to
        float GptResolution: 0.., set at post-build, origin=Vector Informatik, default-value=0  # This parameter contents the calculated resolution value in ms for 1000 ticks depending on Clock Prescaler and Clock Frequency
        container GptWakeupConfiguration [0..1]
          symbolic name reference GptWakeupSourceRef: set at post-build, destination=EcuMWakeupSource  # In case the wakeup-capability is true this value is transmitted to the Ecu State Manager. Implementation Type: reference to EcuM_WakeupSourceType
    container GptConfigurationOfOptApiServices  # This container contains all configuration switches for configuring optional API services of the GPT driver
      boolean GptDeinitApi: set at pre-compile, default-value=true  # Adds / removes the service Gpt_DeInit() from the code.
      boolean GptEnableDisableNotificationApi: set at pre-compile, default-value=true  # Adds / removes the services Gpt_EnableNotification() and Gpt_DisableNotification from the code.
      boolean GptTimeElapsedApi: set at pre-compile, default-value=true  # Adds / removes the service Gpt_GetTimeElapsed() from the code
      boolean GptTimeRemainingApi: set at pre-compile, default-value=true  # Adds / removes the service Gpt_GetTimeRemaining() from the code.
      boolean GptVersionInfoApi: set at pre-compile, default-value=false  # Adds / removes the service Gpt_GetVersionInfo() from the code.
      boolean GptWakeupFunctionalityApi: set at pre-compile, default-value=true  # Adds / removes the services Gpt_SetMode(), Gpt_EnableWakeup() Gpt_DisableWakeup() and Gpt_Cbk_CheckWakeup() from the code.
    container GptDriverConfiguration  # This container contains the module-wide configuration (parameters) of the GPT Driver
      boolean GptDevErrorDetect: set at pre-compile, default-value=false  # Enables/Disables development error detection
      boolean GptSpecRegAccEnabled: set at pre-compile, origin=Vector Informatik, default-value=false  # Register Access Via OS Functions | Enables/disables all access to the peripheral registers via a special function. The special function allows the access to the registers even if they are protected by MPU or supervisor mode. The function is provided by the Os.
      boolean GptSpecRegAccOnlyForWrite: set at pre-compile, origin=Vector Informatik, default-value=true  # Special Register Access Only For Write | This parameter disables the usage of the special function to access the periphery registers for the read access.
      boolean GptSpecRegAccOnlyForPrivModeReg: set at pre-compile, origin=Vector Informatik, default-value=true  # Special Register Access Only For Privileged Mode Registers | This parameter disables the usage of the special function to access the periphery registers for the read and write access. Only the registers which need supervisor rights will be accessed with the special function.
      boolean GptSpecRegAccNotInInit: set at pre-compile, origin=Vector Informatik, default-value=true  # Special Register Access Not During Initialization | This parameter disables the usage of the special function to access the periphery registers during the initialization.
      boolean GptReportWakeupSource: set at pre-compile, default-value=true  # Enables/Disables wakeup source reporting
      function name GptErrorhook: set at pre-compile, origin=Vector Informatik, default-value=Det_ReportError  # The name of the Errorhook function
      string GptCfgIncludeDet: set at pre-compile, origin=Vector Informatik, default-value=Det.h  # Name of the include-file which contains Errorhook function (the file name has to be an absolute path)
      boolean GptCfgChkUninit: set at pre-compile, origin=Vector Informatik, default-value=true  # Option to enable/disable the check whether the driver has not been initialized
      boolean GptCfgChkParamChl: set at pre-compile, origin=Vector Informatik, default-value=true  # Option to enable/disable the check whether the channel number is in valid range
      boolean GptCfgChkParamMode: set at pre-compile, origin=Vector Informatik, default-value=true  # Option to enable/disable the check whether the mode ID is in valid range
      boolean GptCfgChkParamValue: set at pre-compile, origin=Vector Informatik, default-value=true  # Option to enable/disable the check whether the value for a time out period is not zero
      boolean GptCfgChkParamVinfo: set at pre-compile, origin=Vector Informatik, default-value=true  # Option to enable/disable the check whether the pointer passed to Gpt_GetVersionInfo() is not NULL_PTR
      boolean GptCfgChkBusy: set at pre-compile, origin=Vector Informatik, default-value=true  # Option to enable/disable the check whether the timer channel is still busy
      string GptCfgIncludeList [1..*]: set at post-build, origin=Vector Informatik  # Specifies additional include files for the configured notification functions
      boolean GptCfgChkParamConfig: set at pre-compile, origin=Vector Informatik, default-value=true  # Option to enable/disable the check whether the Configuration Structure Pointer is NULL_PTR
      boolean GptCfgDoParamChk: set at pre-compile, origin=Vector Informatik, default-value=true  # Option to enable/disable the parameter checks
      boolean GptCfgChkParamWakeupchl: set at pre-compile, origin=Vector Informatik, default-value=true  # Option to enable/disable the check whether the channel is configured as wakeup capable
      boolean GptCfgChkNotifptr: set at pre-compile, origin=Vector Informatik, default-value=true  # Option to enable/disable the check whether the configured notification function is not NULL_PTR
      boolean GptCfgDebugReporting: set at pre-compile, origin=Vector Informatik, default-value=true  # Option to enable/disable the check whether development errors shall be reported to Det
      boolean GptCfgChkAlreadyInit: set at pre-compile, origin=Vector Informatik, default-value=true  # Option to enable/disable the check whether the driver has already been initialized
      boolean GptCfgChkNotStarted: set at pre-compile, origin=Vector Informatik, default-value=true  # Option to enable/disable the check whether the timer channel has not been started before
      string GptCfgWakeupInclude: set at pre-compile, origin=Vector Informatik  # Include File for Wakeup Functionalities
      enumeration GptNativeIsr: set at pre-compile, origin=Vector Informatik, default-value=GPT_ISR_CAT1  # ISR Implementation - here the user can choose, which kind of interrupt he wants to use: - Category 1: use compilers interrupt declaration mechanism - Category 2: use OSEK interrupts - void Functions
        GPT_ISR_CAT1  # Category 1
        GPT_ISR_CAT2  # Category 2
        GPT_ISR_VOID  # Void Function
      reference GptIrqHandling: set at pre-compile, origin=Vector Informatik, destination=InterruptFunctionSet  # This specifies the used functions to handle Interrupt locking and unlocking.
    container VectorCommonData  # This configuration container contains Vector specific vendor data, which are relevant for configuration management purposes.
      string BswmdVersion: set at published-information, origin=Vector Informatik, default-value=1.00.07  # This parameter specifies the version of this bswmd file.
  bsw implementation Gpt_Impl: code-generator=cMICROSAR, programming-language=C, sw-major-version=1, sw-minor-version=0, sw-patch-version=6, vendor-id=30, ar-major-version=2, ar-minor-version=2, ar-patch-version=0, preconfigured-configuration=Gpt_Pre, recommended-configuration=Gpt_Rec, vendor-specific-module-def=Gpt
  module config Gpt_Pre: definition=Gpt
  module config Gpt_Rec: definition=Gpt
