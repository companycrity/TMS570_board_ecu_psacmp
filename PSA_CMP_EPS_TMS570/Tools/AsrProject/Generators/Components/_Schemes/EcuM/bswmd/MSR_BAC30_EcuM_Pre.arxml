AUTOSAR XML (schema 3.0.1)
package /MICROSAR
  module config EcuM_Pre: definition=EcuM
  module config EcuM_Rec: definition=EcuM, implementation-config-variant=VARIANT-PRE-COMPILE
    EcuMGeneral:
      EcuMMainFunctionPeriod = 0.01
      EcuMIncludeDem = true
      EcuMIncludeDet = true
      EcuMIncludeNvramMgr = true
      EcuMIncludeWdgM = true
      EcuMIncludeComM = true
      EcuMIncludeRte = true
      EcuMIncludeSchM = true
      EcuMTTIIEnabled = false
      EcuMVersionInfoApi = false
      EcuMDevErrorDetect = true
      EcuMCheckParameter = true
      EcuMCheckPointerParameter = true
      EcuMCheckConfigType = true
      EcuMCheckUnInit = true
      EcuMCheckStateParameter = true
      EcuMCheckWkSourceParameter = true
      EcuMCheckBootTargetParameter = true
      EcuMCheckSleepModeParameter = true
      EcuMCheckUserParameter = true
      EcuMEnableProdErrorReporting = true
      EcuMDetErrorhookFunction = Det_ReportError
      EcuMDemSetError = Dem_ReportErrorStatus
      EcuMMcuIncludeFile = Mcu.h
      EcuMWdgMIncludeFile = WdgM.h
      EcuMComMIncludeFile = ComM.h
      EcuMSchMIncludeFile = SchM.h
      EcuMComMCallbackFile = ComM_EcuM.h
      EcuMRteIncludeFile = Rte_Main.h
      EcuMNvmIncludeFile = Nvm.h
      EcuMDetIncludeFile = Det.h
      EcuMDemIncludeFile = Dem.h
      EcuMOsIncludeFile = Os.h
      EcuMProdErrorDetectIncludeFile = Dem.h
      EcuMDevErrorDetectIncludeFile = Det.h
      EcuMAdditionalIncludes = ApplMain.h
      EcuMNvmCancelWriteAllTimeout = 1.0
      EcuMIrqHandling = SuspendAllInterrupts
      EcuMWkupIsrHandling = SuspendAllInterrupts
      EcuMApiSwitches: EcuMKillAllRUNRequestApi=true, EcuMGetValidatedWakeupEventsApi=false, EcuMGetExpiredWakeupEventsApi=false, EcuMGetStatusOfWakeupSourceApi=false
      EcuMCalloutSwitches:
        EcuMOnRTEStartupCallout = false
        EcuMOnEnterRunCallout = true
        EcuMOnExitRunCallout = false
        EcuMOnExitPostRunCallout = false
        EcuMOnPrepShutdownCallout = false
        EcuMOnGoSleepCallout = false
        EcuMOnGoOffOneCallout = true
        EcuMOnGoOffTwoCallout = false
        EcuMOnWakeupReactionCallout = false
        EcuMGeneratorCompatibilityError = false
      EcuMServicePortConfig:
        EcuMGenStateRequestPort = true
        EcuMGenBootTargetPort = true
        EcuMGenApplicationModePort = true
        EcuMGenShutdownTargetPort = true
        EcuMGenModeSwitchPort = true
        EcuMModeSwitchCbkName = Rte_Switch_currentMode_currentMode
        EcuMServiceComponentName = EcuM
        EcuMModeSwitchRteAck = false
