AUTOSAR XML (schema 3.1.4)
package /TTTECH/TMS570LS3x
  bsw implementation Wdg_Impl: code-generator=TTTech, programming-language=C, sw-major-version=2, sw-minor-version=0, sw-patch-version=3, vendor-id=46, ar-major-version=4, ar-minor-version=0, ar-patch-version=1, preconfigured-configuration=Wdg_Pre, vendor-api-infix=TMS570LS3x, vendor-specific-module-def=Wdg
  module definition Wdg [0..*]: refined-module-def=Wdg, variants pre-compile/link-time/post-build  # Configuration of the Wdg (Watchdog driver) module. This is the TMS570LS3x internal watchdog driver.
    container WdgGeneral  # All general parameters of the watchdog driver are collected here.
      boolean WdgDevErrorDetect: set at pre-compile  # Compile switch to enable / disable development error detection for this module. True: Development error detection enabled False: Development error detection disabled
      boolean WdgDemReport: set at pre-compile  # Compile switch to enable / disable calls to DEM in case of production error detection. True: DEM calls enabled in case of production errors False: DEM calls disabled in case of production errors
      boolean WdgDisableAllowed: set at pre-compile  # Compile switch to allow / forbid disabling the watchdog driver during runtime. True: Disabling the watchdog driver at runtime is allowed. False: Disabling the watchdog driver at runtime is not allowed.
      boolean WdgVersionInfoApi: set at pre-compile  # Compile switch to enable / disable the version information API True: API enabled False: API disables
      boolean WdgInternalTickCounter: set at pre-compile  # Compile switch to enable / disable the usage of an internal tick counter. Free running counter 1 (RTIFRC1) from RTI module will be used. True: Internal counter enabled False: Internal counter disabled
      boolean WdgUseOsSuspendInterrupt: set at pre-compile  # This preprocessor switch enables/disables the usage of OS suspend and resume interrupt services within the driver.
      float WdgInitialTimeout: set at pre-compile  # The initial timeout (sec) for the trigger condition to be initialized during Init function. It shall be not larger than WdgMaxTimeout. Please, note that this parameter must match the corresponding settings in the S-WdgM module (parameter WdgMTriggerConditionValue), since the timeout of the TMS570LS3x's internal watchdog cannot be reconfigured.
      choice reference WdgGlobalMemoryAppTaskRef [0..1]: set at pre-compile, destination=[OsTask, OsApplication]  # Reference to an OS Application or Task. In case of OS SC3 the global variables of this Watchdog driver module should be placed in the same memory segment as the application / task that the overlying Watchdog Manager module is part of.
    container WdgSettingsConfig: multiple-configuration-container=true  # Configuration items for the different watchdog settings, including those for external watchdog hardware. Note: All postbuild parameters are handled via this container.
      enumeration WdgDefaultMode: {WDGIF_FAST_MODE, WDGIF_SLOW_MODE}, set at post-build in variant link-time+post-build / pre-compile in variant pre-compile  # Default mode for watchdog driver initialization. ImplementationType: WdgIf_ModeType
      container WdgWindowStart  # Duration from a watchdog trigger to the earliest point in time when the next watchdog trigger is allowed.
        float Value: set at pre-compile, origin=TTTECH  # Value of the initial window start in seconds.
      container WdgRtiKhz  # RTI frequency in kHz (for the TMS570LS3x internal watchdog).
        float Value: set at pre-compile, origin=TTTECH  # Value of the RTI frequency in kHz.
    container WdgModeConfig: multiple-configuration-container=true  # Configuration items for the different watchdog modes
  module config Wdg_Pre: definition=Wdg
