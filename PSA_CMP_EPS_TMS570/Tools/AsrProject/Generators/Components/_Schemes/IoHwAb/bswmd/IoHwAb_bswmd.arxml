AUTOSAR XML (schema 3.0.1)
package /MICROSAR
  bsw implementation IoHwAbstraction_Impl: code-generator=cMICROSAR, programming-language=C, sw-major-version=1, sw-minor-version=3, sw-patch-version=0, vendor-id=30, ar-major-version=2, ar-minor-version=0, ar-patch-version=0, preconfigured-configuration=IoHwAbstraction_Pre, recommended-configuration=IoHwAbstraction_Rec, vendor-api-infix=254, vendor-specific-module-def=IoHwAbstraction
  module definition IoHwAbstraction [0..1]: refined-module-def=IoHwAbstraction, variants pre-compile  # Configuration of IO HW Abstraction.
    container IoHwAbCalSignals  # CAL Signals | This container holds CAL Dio signals, i.e. Dio Channels, Dio Channel Groups and Dio Ports can be configured as discrete signals or discrete signal groups. Add a CAL signal by right-click 'Add'.
      container IoHwAbDiscrete [0..*]  # CAL Signal Name | This is a discrete signal or signal group that contains a certain Dio entity (Channel, Channel Group or Port). Adjust the name of the entitiy to your needs.
        boolean IoHwAbCreateOpSet: set at pre-compile, origin=Vector Informatik, default-value=true  # Create OP_SET for Signal | This checkbox enables the generation of an OP_SET function for the certain signal. The name of the operation function will be generated according to the following pattern: IoHwAb_Set<SignalName>
        boolean IoHwAbCreateOpGet: set at pre-compile, origin=Vector Informatik, default-value=false  # Create OP_GET for Signal | This checkbox enables the generation of an OP_GET function for the certain signal. The name of the operation function will be generated according to the following pattern: IoHwAb_Get<SignalName>
        boolean IoHwAbCreateOpDiag: set at pre-compile, origin=Vector Informatik, default-value=false  # Create OP_DIAG for Signal | This checkbox enables the generation of an OP_DIAG function for the certain signal. The OP_DIAG operation is a diagnosis function for the output operation OP_SET and can only be used if this is enabled. The name of the operation function will be generated according to the following pattern: IoHwAb_Diag<SignalName>
        boolean IoHwAbDcmAccess: set at pre-compile, origin=Vector Informatik, default-value=false  # Enable DCM Access Functionality | This checkbox enables the generation of a DCM interface function for the certain signal. The enabling of this option produces one additional function per enabled operation (OP_SET, OP_GET or OP_DIAG), as well as additional state variables. The name of the DCM access function will be generated according to the following pattern: IoHwAb_DCM<Set/Get/Diag><SignalName>
        enumeration IoHwAbCalSourceType: {DioChannel, DioPort, DioChannelGroup}, set at pre-compile, origin=Vector Informatik, default-value=DioChannel  # This field contains the type of Dio source that is selected.
        string IoHwAbRequirementId: set at pre-compile, origin=Vector Informatik  # ReqirementID | This optional field contains a requirement identifier for project-traceability. This value is just for documentation and does not affect the code.
        integer IoHwAbDcmDefaultValue [0..1]: set at pre-compile, origin=Vector Informatik, default-value=0  # Default Value | This control configures the default value for the signal. If the signal's DCM service is called with the parameter 'ResetToDefault', the signal is reset to this value.
        choice reference IoHwAbDioEntity: set at pre-compile, origin=Vector Informatik, destination=[DioChannel, DioChannelGroup, DioPort]  # Used DIO Entity | This is the selection, where a certain Dio entity can be assigned to a IoHwAb Discrete entitiy.
    container IoHwAbUserDefSignals  # User Defined Signals | This container holds user defined ports, that contain operations of any but discrete type. Add a port by right-click 'Add'.
      container IoHwAbUserDefPort [0..*]  # User Defined Port | This is a signal port that can contain several user defined operations. Adjust the name of the entitiy to your needs. Add an operation by right-click 'Add'.
        container IoHwAbUserDefinedOp [1..*]  # User Defined Operation | This is a user defined signal. Adjust the name of the entitiy to your needs. The name of the operation function will be generated according to the following pattern: IoHwAb_<Input/Ouput><OperationName>
          enumeration IoHwAbAccess: {Input, Output}, set at pre-compile, origin=Vector Informatik, default-value=Output  # Access | This field configures the signal-direction of the operation. Input: Read a value from the hardware Output: Write a value to the hardware
          enumeration IoHwAbDataType: set at pre-compile, origin=Vector Informatik, default-value=uint8  # Data Type | This field determines the data type of the current signal. This data type will be the data type of the operation function's attribute.
            IoHwAbBoolType  # IoHwAb_BoolType
            IoHwAbCurrentType  # IoHwAb_CurrentType
            IoHwAbVoltageType  # IoHwAb_VoltageType
            IoHwAbResistanceType  # IoHwAb_ResistanceType
            IoHwAbSignalDiagnosisType  # IoHwAb_SignalDiagnosisType
            IoHwAbPwxPeriodType  # IoHwAb_PwxPeriodType
            IoHwAbPwxDutyCycleType  # IoHwAb_PwxDutyCycleType
            sint8
            uint8
            sint16
            uint16
            sint32
            uint32
            float32
            float64
          enumeration IoHwAbUnit: set at pre-compile, origin=Vector Informatik, default-value=n/a  # Unit | This field contains the Unit of the signal. (Caution! This option is not used to generate any code. It is only used for documentation)
            MilliVolts  # mV
            Volts
            Ohm
            KiloOhm  # kOhm
            Ampere
            MilliAmpere  # mA
            MicroAmpere  # µA
            DegreesCelsius  # °C
            Percent
            None  # n/a
          integer IoHwAbRangeMin: set at pre-compile, origin=Vector Informatik, default-value=0  # Range Min | This field contains the minimum numerical value of the signal. (Caution! This option is not used to generate any code. It is only used for documentation)
          integer IoHwAbRangeMax: set at pre-compile, origin=Vector Informatik  # Range Max | This field contains the maximum numerical value of the signal. (Caution! This option is not used to generate any code. It is only used for documentation)
          float IoHwAbResolution: set at pre-compile, origin=Vector Informatik  # Resolution | This field contains the hardware resolution of the signal. (Caution! This option is not used to generate any code. It is only used for documentation)
          boolean IoHwAbDcmAccess: set at pre-compile, origin=Vector Informatik, default-value=false  # Enable DCM Access Functionality | This checkbox enables the generation of a DCM interface function for the certain operation. The enabling of this option produces one additional function as well as additional state variables. The name of the DCM access function will be generated according to the following pattern: IoHwAb_DCM<Input/Ouput><OperationName>
          string IoHwAbRequirementId: set at pre-compile, origin=Vector Informatik  # ReqirementID | This optional field contains a requirement identifier for project-traceability. This value is just for documentation and does not affect the code.
          float IoHwAbDcmDefaultValue [0..1]: set at pre-compile, origin=Vector Informatik, default-value=0  # Default Value | This control configures the default value for the signal. If the signal's DCM service is called with the parameter 'ResetToDefault', the signal is reset to this value.
    container IoHwAbHandlers  # This container holds the user defined handler functions. Add a handler by right-click 'Add'.
      container IoHwAbHandler [0..*]  # IoHwAb Signal Handlers | This is a user defined handler function. Adjust the name of the entitiy to your needs.
        integer IoHwAbTriggerPeriod: 0..65535, set at pre-compile, origin=Vector Informatik, default-value=10  # Trigger Period | This contains the trigger time of the handler function.
        enumeration IoHwAbTimebase: set at pre-compile, origin=Vector Informatik, default-value=IoHwAbMSec  # Timebase | This field contains the timebase of the trigger's time.
          IoHwAbSec  # sec
          IoHwAbMSec  # msec
    container IoHwAbGeneral  # This container contains common description for the IO Hardware Abstraction module
      boolean IoHwAbDevErrorDetect: set at pre-compile, default-value=false  # Development Mode | This parameter enables/disables development error detection and reporting.
      boolean IoHwAbVersionInfoApi: set at pre-compile, default-value=true  # Enable IoHwAb_GetVersionInfo | Pre-processor switch to enable / disable the API to read out the modules version information.
      boolean IoHwAbUseInitFunction: set at pre-compile, origin=Vector Informatik, default-value=true  # Enable IoHwAb_Init | Pre-processor switch to enable / disable the Initialization-API.
      boolean IoHwAbUseRte: set at pre-compile, origin=Vector Informatik, default-value=true  # Use RTE | This parameter enables/disables the uasge of the RTE. If RTE usage is OFF the file IoHwAb_Types.h will be generated. The function prototypes of the IoHwAb services will be generated into IoHwAb_Cfg.h.
      string IoHwAbServiceComponentName: set at pre-compile, origin=Vector Informatik, default-value=IoHwAbstraction  # Component Name | Component Name for the import of IoHwAb into higher layer development tools (e.g. Vector DaVinc Developer)
      function name IoHwAbErrorhook: set at pre-compile, origin=Vector Informatik, default-value=Det_ReportError  # Errorhook Function | This parameter specifies the function that shall be called if a development error has occurred. The function must have the signature of the DET. Refer to the DET specification for more details.
      string IoHwAbCfgIncludeDet: set at pre-compile, origin=Vector Informatik, default-value=Det.h  # Include File | This parameter specifies the file that shall be included if development error reporting shall be used.
      string IoHwAbCfgIncludeList [0..*]: set at pre-compile, origin=Vector Informatik, default-value=Dio.h  # Include List for used basic software component's headers
      boolean IoHwAbUseServicePorts: set at pre-compile, origin=Vector Informatik, default-value=false  # Export As Service Component | This parameter enables/disables the generation of the I/O Hardware Abstraction as a Service Component. By Default the I/O Hardware Abstraction is an Application Component. By enabling this option, the module can be declared as a Service Component.
      boolean IoHwAbDevErrorReport: set at pre-compile, origin=Vector Informatik, default-value=true  # Development Error Reporting | This switch enables/disables the Development error reporting.
      reference IoHwAbIrqHandling: set at pre-compile, origin=Vector Informatik  # Critical Section Handling | Preprocessor switch to determine the IRQ function set which is used to protect critical sections.
      container IoHwAbErrorChecks  # This container contains all the error checks
        boolean IoHwAbCfgChkParamPointer: set at pre-compile, origin=Vector Informatik, default-value=true  # Check Parameter Pointer | This parameter enables/disables checking of parameters for not being NULL_PTR.
      container IoHwAbDataTypeSizes
        enumeration IoHwAbDiscreteGroupSize: set at pre-compile, origin=Vector Informatik, default-value=IOHWAB_UINT8  # Size Of IoHwAb_DiscreteGroupType
          IOHWAB_UINT8  # uint8
          IOHWAB_UINT16  # uint16
          IOHWAB_UINT32  # uint32
        enumeration IoHwAbCurrentType: set at pre-compile, origin=Vector Informatik, default-value=IOHWAB_UINT16  # Size Of IoHwAb_CurrentType | This option determines the type of the IoHwAb_CurrentType.
          IOHWAB_UINT16  # uint16
          IOHWAB_UINT32  # uint32
        enumeration IoHwAbVoltageType: set at pre-compile, origin=Vector Informatik, default-value=IOHWAB_UINT16  # Size Of IoHwAb_VoltageType | This option determines the type of the IoHwAb_VoltageType.
          IOHWAB_UINT16  # uint16
          IOHWAB_UINT32  # uint32
        enumeration IoHwAbResistanceType: set at pre-compile, origin=Vector Informatik, default-value=IOHWAB_UINT16  # Size Of IoHwAb_ResistanceType | This option determines the type of the IoHwAb_ResistanceType.
          IOHWAB_UINT16  # uint16
          IOHWAB_UINT32  # uint32
        enumeration IoHwAbSignalDiagnosisType: set at pre-compile, origin=Vector Informatik, default-value=IOHWAB_UINT16  # Size Of IoHwAb_SignalDiagnosisType
          IOHWAB_UINT16  # uint16
          IOHWAB_UINT32  # uint32
        enumeration IoHwAbPwxPeriodType: set at pre-compile, origin=Vector Informatik, default-value=IOHWAB_UINT16  # Size Of IoHwAb_PwxPeriodType | This option determines the type of the IoHwAb_PwxPeriodType.
          IOHWAB_UINT16  # uint16
          IOHWAB_UINT32  # uint32
        enumeration IoHwAbPwxDutyCycleType: set at pre-compile, origin=Vector Informatik, default-value=IOHWAB_UINT16  # Size Of IoHwAb_PwxDutyCycleType | This option determines the type of the IoHwAb_DutyCycleType.
          IOHWAB_UINT16  # uint16
          IOHWAB_UINT32  # uint32
    container VectorCommonData
      string BswmdVersion: set at published-information, origin=Vector Informatik, default-value=1.04.06
  module config IoHwAbstraction_Pre: definition=IoHwAbstraction
  module config IoHwAbstraction_Rec: definition=IoHwAbstraction
