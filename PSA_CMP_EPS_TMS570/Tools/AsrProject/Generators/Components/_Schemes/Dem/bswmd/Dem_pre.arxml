AUTOSAR XML (schema 3.0.1)
package /MICROSAR
  module config Dem_Pre: definition=Dem, implementation-config-variant=VARIANT-LINK-TIME
    DemGeneral: DemTypeOfDTCSupported=1
      4 x DemOperationCycleTgt:
        DEM_IGNITION: DemOperationCycle=DEM_IGNITION
        DEM_OBD_DCY: DemOperationCycle=DEM_OBD_DCY
        DEM_POWER: DemOperationCycle=DEM_POWER
        DEM_WARMUP: DemOperationCycle=DEM_WARMUP
  module config Dem_Rec: definition=Dem, implementation-config-variant=VARIANT-LINK-TIME
    DemGeneral: DemMaxNumberEventEntryPrm=8
  module config Dem_Pre_Class1: definition=Dem
    DemConfigSet
      4 x DemGroupOfDTC:
        DEM_DTC_GROUP_POWERTRAIN_DTCS: DemGroupDTCs=1
        DEM_DTC_GROUP_CHASSIS_DTCS: DemGroupDTCs=4194304
        DEM_DTC_GROUP_BODY_DTCS: DemGroupDTCs=8388608
        DEM_DTC_GROUP_NETWORK_COM_DTCS: DemGroupDTCs=12582912
