AUTOSAR XML (schema 3.1.4)
package /MICROSAR
  module config Dio_Pre: definition=Dio, implementation-config-variant=VARIANT-LINK-TIME  # Preconfiguration for hardware specific parameters
    23 x DioPortDefinition:
      DioPortGioA: DioPortDefMaskInPkgA=255, DioPortDefMaskInPkgB=231, DioPortDefPortId=12046, DioPortDefName=GIOA
      DioPortGioB: DioPortDefMaskInPkgA=255, DioPortDefMaskInPkgB=255, DioPortDefPortId=12054, DioPortDefName=GIOB
      DioPortNHet1: DioPortDefMaskInPkgA=4294967295, DioPortDefMaskInPkgB=4292870143, DioPortDefPortId=11796, DioPortDefName=NHET1
      DioPortNHet2: DioPortDefMaskInPkgA=393215, DioPortDefMaskInPkgB=2796171, DioPortDefPortId=11860, DioPortDefName=NHET2
      DioPortCan1Tx: DioPortDefMaskInPkgA=1, DioPortDefMaskInPkgB=1, DioPortDefPortId=79736, DioPortDefName=CAN1
      DioPortCan1Rx: DioPortDefMaskInPkgA=1, DioPortDefMaskInPkgB=1, DioPortDefPortId=79737, DioPortDefName=CAN1
      DioPortCan2Tx: DioPortDefMaskInPkgA=1, DioPortDefMaskInPkgB=1, DioPortDefPortId=79864, DioPortDefName=CAN2
      DioPortCan2Rx: DioPortDefMaskInPkgA=1, DioPortDefMaskInPkgB=1, DioPortDefPortId=79865, DioPortDefName=CAN2
      DioPortCan3Tx: DioPortDefMaskInPkgA=1, DioPortDefMaskInPkgB=1, DioPortDefPortId=79992, DioPortDefName=CAN3
      DioPortCan3Rx: DioPortDefMaskInPkgA=1, DioPortDefMaskInPkgB=1, DioPortDefPortId=79993, DioPortDefName=CAN3
      DioPortAdc1: DioPortDefMaskInPkgA=1, DioPortDefMaskInPkgB=1, DioPortDefPortId=274496, DioPortDefName=ADC1
      DioPortAdc2: DioPortDefMaskInPkgA=1, DioPortDefMaskInPkgB=1, DioPortDefPortId=274624, DioPortDefName=ADC2
      DioPortLin: DioPortDefMaskInPkgA=6, DioPortDefMaskInPkgB=6, DioPortDefPortId=14609, DioPortDefName=LIN
      DioPortSci: DioPortDefMaskInPkgA=6, DioPortDefMaskInPkgB=6, DioPortDefPortId=14673, DioPortDefName=SCI
      DioPortIic: DioPortDefMaskInPkgA=3, DioPortDefMaskInPkgB=3, DioPortDefPortId=13588, DioPortDefName=IIC
      DioPortSpi1: DioPortDefMaskInPkgA=33689407, DioPortDefMaskInPkgB=33689399, DioPortDefPortId=15623, DioPortDefName=SPI1
      DioPortSpi2: DioPortDefMaskInPkgA=3843, DioPortDefMaskInPkgB=0, DioPortDefPortId=15751, DioPortDefName=SPI2
      DioPortSpi3: DioPortDefMaskInPkgA=3903, DioPortDefMaskInPkgB=3903, DioPortDefPortId=15879, DioPortDefName=SPI3
      DioPortSpi4: DioPortDefMaskInPkgA=3841, DioPortDefMaskInPkgB=3841, DioPortDefPortId=16007, DioPortDefName=SPI4
      DioPortSpi5: DioPortDefMaskInPkgA=235802383, DioPortDefMaskInPkgB=3841, DioPortDefPortId=16135, DioPortDefName=SPI5
      DioPortRtp: DioPortDefMaskInPkgA=524287, DioPortDefMaskInPkgB=0, DioPortDefPortId=147087, DioPortDefName=RTP
      DioPortEclk: DioPortDefMaskInPkgA=1, DioPortDefMaskInPkgB=1, DioPortDefPortId=147394, DioPortDefName=SYS
      DioPortDmm: DioPortDefMaskInPkgA=524287, DioPortDefMaskInPkgB=36224, DioPortDefPortId=146909, DioPortDefName=DMMDATA
    DioPackageMapping337 (DioPackageMapping): DioPackageName=Pin_337, DioPortDefMaskName=DIO_PORT_DEF_MASK_IN_PKG_A
    DioPackageMapping144 (DioPackageMapping): DioPackageName=Pin_144, DioPortDefMaskName=DIO_PORT_DEF_MASK_IN_PKG_B
