AUTOSAR XML (schema 3.1.4)
package /MICROSAR
  module definition Dio [0..1]: refined-module-def=Dio, variants link-time  # Configuration of the Dio (Digital IO) module.
    container DioGeneral  # General DIO module configuration parameters.
      boolean DioDevErrorDetect: set at pre-compile, default-value=true  # Switches the Development Error Detection and Notification ON or OFF
      boolean DioMaskedWritePortApi: set at pre-compile, default-value=false  # Adds / removes the service Dio_MaskedWritePort() from the code.
      boolean DioVersionInfoApi: set at pre-compile, default-value=true  # Adds / removes the service Dio_ GetVersionInfo() from the code.
      boolean DioCfgSupportGio: set at pre-compile, origin=Vector Informatik, default-value=true  # Enables or disables support of ports, channels and channel groups with GIO register layout.
      boolean DioCfgSupportCan: set at pre-compile, origin=Vector Informatik, default-value=false  # Enables or disables support of ports, channels and channel groups located in the CAN hardware.
      boolean DioCfgDoParamCheck: set at pre-compile, origin=Vector Informatik, default-value=true  # Enables checking of parameter values passed to the API globally.
      boolean DioCfgReportDet: set at pre-compile, origin=Vector Informatik, default-value=true  # Enables reporting of detected development errors to DET.
      boolean DioCfgChkParamChannel: set at pre-compile, origin=Vector Informatik, default-value=true  # Enables checking of parameter ChannelId in Dio_ReadChannel and Dio_WriteChannel.
      boolean DioCfgChkParamPort: set at pre-compile, origin=Vector Informatik, default-value=true  # Enables cecking of parameter PortId in Dio_ReadPort and Dio_WritePort.
      boolean DioCfgChkParamGroup: set at pre-compile, origin=Vector Informatik, default-value=true  # Enables checking of parameter ChannelGroupIdPtr in Dio_ReadChannelGroup and Dio_WriteChannelGroup.
      boolean DioCfgChkParamVinfo: set at pre-compile, origin=Vector Informatik, default-value=true  # Enables checking of parameter VersionInfo in Dio_GetVersionInfo.
      function name DioReportDet: set at pre-compile, origin=Vector Informatik, default-value=Det_ReportError  # Configures the name of the Det API that should be used for reporting development errors.
      string DioCfgIncludeDet: set at pre-compile, origin=Vector Informatik, default-value=Det.h  # Specifies the include file in which the prototype for the development error reporting API is defined.
      boolean DioCfgChannelApi: set at pre-compile, origin=Vector Informatik, default-value=true  # Enable Channel Access APIs
      boolean DioCfgPortApi: set at pre-compile, origin=Vector Informatik, default-value=true  # Enable Port Access APIs
      boolean DioCfgGroupApi: set at pre-compile, origin=Vector Informatik, default-value=true  # Enable Channel Group Access APIs
      boolean DioSpecialRegisterAccessEnabled: set at pre-compile, origin=Vector Informatik, default-value=false  # Register Access Via OS Functions | Enables/disables all access to the periphery register via a special function. The special function allows the access to the registers even if they are protected by MPU or supervisor mode. The function shall be provided by the Os.
      boolean DioSpecialRegisterAccessOnlyForWrite: set at pre-compile, origin=Vector Informatik, default-value=true  # Special Register Access Only For Write | This parameter disables the usage of the special function to access the periphery registers for the read access.
      boolean DioSpecialRegisterAccessOnlyForPrivilegedModeRegisters: set at pre-compile, origin=Vector Informatik, default-value=true  # Special Register Access Only For Privileged Mode Registers
      boolean DioSpecialRegisterAccessNotInInit: set at pre-compile, origin=Vector Informatik, default-value=true  # Special Register Access Not During Initialization | This parameter disables the usage of the special function to access the periphery registers during the initialization
      reference DioIrqHandling: set at pre-compile, origin=Vector Informatik, destination=InterruptFunctionSet  # Determines the IRQ function set which is used to protect critical sections.
    container DioPort [1..*]  # Configuration of individual DIO ports, consisting of channels and possible channel groups. Nothe that this container definition does not explicitly define a symbolic name parameter. Instead, the container's short name will be used in the Ecu Configuration Description to specify the symbolic name of the port.
      integer DioPortId: 0..4294967295, set at link, symbolic-name-value=true  # Numeric identifier of the DIO port. Not all MCU ports may be used for DIO, thus there may be "gaps" in the list of all IDs. This value will be assigned to the DIO port symbolic name (i.e. the SHORT-NAME of the DioPort container).
      reference DioPortDefRef: set at link, origin=Vector Informatik, destination=DioPortDefinition  # reference to the definition of the port (including its attributes)
      container DioChannel [0..*]  # Configuration of an individual DIO channel. Besides a HW specific channel name which is typically fixed for a specific micro controller, additional symbolic names can be defined per channel. Note hat this container definition does not explicitly define a symbolic name parameter. Instead, the container's short name will be used in the Ecu Configuration Description to specify the symbolic name of the channel.
        integer DioChannelId: 0..31, set at link, symbolic-name-value=true  # Channel Id of the DIO channel. This value will be assigned to the symbolic names.
      container DioChannelGroup [0..*]  # Definition and configuration of DIO channel groups. A channel group represents several adjoining DIO channels represented by a logical group. Note hat this container definition does not explicitly define a symbolic name parameter. Instead, the container's short name will be used in the Ecu Configuration Description to specify the symbolic name of the channel group.
        string DioChannelGroupIdentification: set at link, symbolic-name-value=true  # The DIO channel group is identified in DIO API by a pointer to a data structure (of type Dio_ChannelGroupType). That data structure contains the channel group information. This parameter contains the code fragment that has to be inserted in the API call of the calling module to get the address of the variable in memory which holds the channel group information. Example values are "&MyDioGroup1" or "&MyDioGroupArray[0]"
        integer DioPortMask: 0..4294967295, set at link  # This shall be the mask which defines the positions of the channel group. The data type depends on the port width
        derived integer DioPortOffset: 0..31, set at link, calculation-formula=position of the first bit of dioportmask which is set to '1' counted from lsb, calculation-language=INFORMAL  # The position of the Channel Group on the port, counted from the LSB. This value can be derived from DioPortMask. calculationFormula = Position of the first bit of DioPortMask which is set to '1' counted from LSB
    container DioPortDefinition [1..*]  # Definition of a port. Has to be set in preconfiguration.
      string DioPortDefName: set at pre-compile, origin=Vector Informatik  # Port name.
      integer DioPortDefPortId: 0..4294967295, set at pre-compile, origin=Vector Informatik  # Address of the port's data register
      integer DioPortDefMaskInPkgE: 0..4294967295, set at pre-compile, origin=Vector Informatik, default-value=0  # Mask of the physically existent pins in the port in this pin package.
      integer DioPortDefMaskInPkgC: 0..4294967295, set at pre-compile, origin=Vector Informatik, default-value=0  # Mask of the physically existent pins in the port in this pin package.
      integer DioPortDefMaskInPkgB: 0..4294967295, set at pre-compile, origin=Vector Informatik, default-value=0  # Mask of the physically existent pins in the port in this pin package.
      integer DioPortDefMaskInPkgA: 0..4294967295, set at pre-compile, origin=Vector Informatik, default-value=0  # Mask of the physically existent pins in the port in this pin package.
      integer DioPortDefMaskInPkgG: 0..4294967295, set at pre-compile, origin=Vector Informatik, default-value=0  # Mask of the physically existent pins in the port in this pin package.
      integer DioPortDefMaskInPkgF: 0..4294967295, set at pre-compile, origin=Vector Informatik, default-value=0  # Mask of the physically existent pins in the port in this pin package.
      integer DioPortDefMaskInPkgD: 0..4294967295, set at pre-compile, origin=Vector Informatik, default-value=0  # Mask of the physically existent pins in the port in this pin package.
      integer DioPortDefMaskInPkgH: 0..4294967295, set at pre-compile, origin=Vector Informatik, default-value=0  # Mask of the physically existent pins in the port in this pin package.
      integer DioPortDefMaskInPkgI: 0..4294967295, set at pre-compile, origin=Vector Informatik, default-value=0  # Mask of the physically existent pins in the port in this pin package.
      integer DioPortDefMaskInPkgJ: 0..4294967295, set at pre-compile, origin=Vector Informatik, default-value=0  # Mask of the physically existent pins in the port in this pin package.
    container VectorCommonData
      string BswmdVersion: set at published-information, origin=Vector Informatik GmbH, default-value=2.01.00  # This parameter specifies the version of this bswmd file.
    container DioPackageMapping [1..*]
      string DioPortDefMaskName: set at pre-compile, origin=Vector Informatik  # Name of a port pin mask in container DioPortDefinition.
      string DioPackageName: set at pre-compile, origin=Vector Informatik  # Name of a controller's pin package according to module Boards
  bsw implementation Dio_Impl: code-generator=MicrosarGen, programming-language=C, sw-major-version=1, sw-minor-version=1, sw-patch-version=0, vendor-id=30, ar-major-version=2, ar-minor-version=3, ar-patch-version=0, preconfigured-configuration=Dio_Pre, recommended-configuration=Dio_Rec, vendor-specific-module-def=Dio
