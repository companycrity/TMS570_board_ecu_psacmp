AUTOSAR XML (schema 3.0.1)
# COPYRIGHT
# Copyright (c) 2008 by Vector Informatik GmbH. All rights reserved.
# This software is copyright protected and proprietary to Vector Informatik GmbH.
# Vector Informatik GmbH grants to you only those rights as set out in the license conditions.
package /MICROSAR
  bsw implementation Bswmd_Crc: code-generator=cMICROSAR, programming-language=C, sw-major-version=4, sw-minor-version=0, sw-patch-version=1, vendor-id=30, ar-major-version=3, ar-minor-version=0, ar-patch-version=0, preconfigured-configuration=Crc_Pre, recommended-configuration=Crc_Rec, vendor-specific-module-def=Crc
  module definition Crc [0..1]: refined-module-def=Crc, variants pre-compile  # Configuration of the Crc (Crc routines) module.
    container CrcGeneral  # General configuration of CRC module
      enumeration Crc16Mode: set at pre-compile, default-value=CRC_16_RUNTIME  # Switch to select one of the available CRC16 calculation methods.
        CRC_16_RUNTIME  # Runtime
        CRC_16_TABLE  # Table based
      enumeration Crc32Mode: set at pre-compile, default-value=CRC_32_RUNTIME  # Switch to select one of the available CRC32 calculation methods.
        CRC_32_RUNTIME  # Runtime
        CRC_32_TABLE  # Table based
      boolean CrcVersionInfoApi: set at pre-compile, default-value=true  # Pre-processor switch to enable / disable the API to read out the modules version information. true: Version info API enabled. false: Version info API disabled.
      enumeration Crc8Mode: set at pre-compile, origin=Vector Informatik, default-value=CRC_8_RUNTIME  # Switch to select one of the available CRC8 calculation methods.
        CRC_8_RUNTIME  # Runtime
        CRC_8_TABLE  # Table based
    container CrcPublishedInformation  # Additional published parameters not covered by CommonPublishedInformation container.
      integer CrcInitialValue16: 65535..65535, set at published-information, default-value=65535  # Initial value for the 16-bit CRC calculation.
      integer CrcInitialValue32: 4294967295..4294967295, set at published-information, default-value=4294967295  # Initial value for the 32-bit CRC calculation.
      integer CrcInitialValue8: 0..0, set at published-information, origin=Vector Informatik, default-value=0  # Initial value for the 8-bit CRC calculation.
  module config Crc_Pre: definition=Crc
  module config Crc_Rec: definition=Crc
