AUTOSAR XML (schema 3.0.1)
standard types defined: Boolean, UInt8
package /ComponentType
  service component type NvM: category=ServiceComponent  # Software Component description for NvM generated from Ecuc Package: ActiveEcuC
    90 x provide port:
      PS_NVM_BLOCK_DIAGMGR_NTCSTRG: provided-interface=NvM_AC3_SRBS_Srv  # PPort_NVM_BLOCK_DIAGMGR_NTCSTRG : NvM_AC3_SRBS_Srv | P-Port Prototype of NvM_AC3_SRBS_Srv for NVRAM Block NVM_BLOCK_DIAGMGR_NTCSTRG
      PS_ConfigBlock: provided-interface=NvM_AC3_SRBS_Srv  # PPort_ConfigBlock : NvM_AC3_SRBS_Srv | P-Port Prototype of NvM_AC3_SRBS_Srv for NVRAM Block ConfigBlock
      PS_NVM_BLOCK_EPSDEFEATS: provided-interface=NvM_AC3_SRBS_Srv  # PPort_NVM_BLOCK_EPSDEFEATS : NvM_AC3_SRBS_Srv | P-Port Prototype of NvM_AC3_SRBS_Srv for NVRAM Block NVM_BLOCK_EPSDEFEATS
      PS_Rte_NvmBlock_StaMd_TypeHRamBuffer: provided-interface=NvM_AC3_SRBS_Srv  # PPort_Rte_NvmBlock_StaMd_TypeHRamBuffer : NvM_AC3_SRBS_Srv | P-Port Prototype of NvM_AC3_SRBS_Srv for NVRAM Block Rte_NvmBlock_StaMd_TypeHRamBuffer
      PS_Rte_NvmBlock_Polarity_Polarity_Cnt_Str: provided-interface=NvM_AC3_SRBS_Srv  # PPort_Rte_NvmBlock_Polarity_Polarity_Cnt_Str : NvM_AC3_SRBS_Srv | P-Port Prototype of NvM_AC3_SRBS_Srv for NVRAM Block Rte_NvmBlock_Polarity_Polarity_Cnt_Str
      PS_Rte_NvmBlock_CurrParamComp_EOLNomMtrParam: provided-interface=NvM_AC3_SRBS_Srv  # PPort_Rte_NvmBlock_CurrParamComp_EOLNomMtrParam : NvM_AC3_SRBS_Srv | P-Port Prototype of NvM_AC3_SRBS_Srv for NVRAM Block Rte_NvmBlock_CurrParamComp_EOLNomMtrParam
      PS_NVM_BLOCK_CMS_NXTRMEC: provided-interface=NvM_AC3_SRBS_Srv  # PPort_NVM_BLOCK_CMS_NXTRMEC : NvM_AC3_SRBS_Srv | P-Port Prototype of NvM_AC3_SRBS_Srv for NVRAM Block NVM_BLOCK_CMS_NXTRMEC
      PS_NVM_BLOCK_CMS_ECUSRLNUM: provided-interface=NvM_AC3_SRBS_Srv  # PPort_NVM_BLOCK_CMS_ECUSRLNUM : NvM_AC3_SRBS_Srv | P-Port Prototype of NvM_AC3_SRBS_Srv for NVRAM Block NVM_BLOCK_CMS_ECUSRLNUM
      PS_NVM_BLOCK_CMS_EPSSRLNUM: provided-interface=NvM_AC3_SRBS_Srv  # PPort_NVM_BLOCK_CMS_EPSSRLNUM : NvM_AC3_SRBS_Srv | P-Port Prototype of NvM_AC3_SRBS_Srv for NVRAM Block NVM_BLOCK_CMS_EPSSRLNUM
      PS_NVM_BLOCK_CMS_ECUHWPN: provided-interface=NvM_AC3_SRBS_Srv  # PPort_NVM_BLOCK_CMS_ECUHWPN : NvM_AC3_SRBS_Srv | P-Port Prototype of NvM_AC3_SRBS_Srv for NVRAM Block NVM_BLOCK_CMS_ECUHWPN
      PS_NVM_BLOCK_CMS_NXTRMANUFSCRATCHPAD: provided-interface=NvM_AC3_SRBS_Srv  # PPort_NVM_BLOCK_CMS_NXTRMANUFSCRATCHPAD : NvM_AC3_SRBS_Srv | P-Port Prototype of NvM_AC3_SRBS_Srv for NVRAM Block NVM_BLOCK_CMS_NXTRMANUFSCRATCHPAD
      PS_NVM_BLOCK_CMS_IGNCNTR: provided-interface=NvM_AC3_SRBS_Srv  # PPort_NVM_BLOCK_CMS_IGNCNTR : NvM_AC3_SRBS_Srv | P-Port Prototype of NvM_AC3_SRBS_Srv for NVRAM Block NVM_BLOCK_CMS_IGNCNTR
      PS_Rte_NvmBlock_StaMd_CloseCheckData: provided-interface=NvM_AC3_SRBS_Srv  # PPort_Rte_NvmBlock_StaMd_CloseCheckData : NvM_AC3_SRBS_Srv | P-Port Prototype of NvM_AC3_SRBS_Srv for NVRAM Block Rte_NvmBlock_StaMd_CloseCheckData
      PS_Rte_NvmBlock_Sa_DigMSB_DigMSBEOLData: provided-interface=NvM_AC3_SRBS_Srv  # PPort_Rte_NvmBlock_Sa_DigMSB_DigMSBEOLData : NvM_AC3_SRBS_Srv | P-Port Prototype of NvM_AC3_SRBS_Srv for NVRAM Block Rte_NvmBlock_Sa_DigMSB_DigMSBEOLData
      PS_NVM_BLOCK_DIAGMGR_BLACKBOX: provided-interface=NvM_AC3_SRBS_Srv  # PPort_NVM_BLOCK_DIAGMGR_BLACKBOX : NvM_AC3_SRBS_Srv | P-Port Prototype of NvM_AC3_SRBS_Srv for NVRAM Block NVM_BLOCK_DIAGMGR_BLACKBOX
      PS_Rte_NvmBlock_BatteryVoltage_OvervoltageData: provided-interface=NvM_AC3_SRBS_Srv  # PPort_Rte_NvmBlock_BatteryVoltage_OvervoltageData : NvM_AC3_SRBS_Srv | P-Port Prototype of NvM_AC3_SRBS_Srv for NVRAM Block Rte_NvmBlock_BatteryVoltage_OvervoltageData
      PS_Rte_NvmBlock_ThrmlDutyCycle_ThrmlDutyCycle_FltStVal: provided-interface=NvM_AC3_SRBS_Srv  # PPort_Rte_NvmBlock_ThrmlDutyCycle_ThrmlDutyCycle_FltStVal : NvM_AC3_SRBS_Srv | P-Port Prototype of NvM_AC3_SRBS_Srv for NVRAM Block Rte_NvmBlock_ThrmlDutyCycle_ThrmlDutyCycle_FltStVal
      PS_NVM_BLOCK_DIAGMGR_LATCHCNTRS: provided-interface=NvM_AC3_SRBS_Srv  # PPort_NVM_BLOCK_DIAGMGR_LATCHCNTRS : NvM_AC3_SRBS_Srv | P-Port Prototype of NvM_AC3_SRBS_Srv for NVRAM Block NVM_BLOCK_DIAGMGR_LATCHCNTRS
      PS_NVM_BLOCK_SER_FLASHLOGA: provided-interface=NvM_AC3_SRBS_Srv  # PPort_NVM_BLOCK_SER_FLASHLOGA : NvM_AC3_SRBS_Srv | P-Port Prototype of NvM_AC3_SRBS_Srv for NVRAM Block NVM_BLOCK_SER_FLASHLOGA
      PS_NVM_BLOCK_SER_FLASHLOGB: provided-interface=NvM_AC3_SRBS_Srv  # PPort_NVM_BLOCK_SER_FLASHLOGB : NvM_AC3_SRBS_Srv | P-Port Prototype of NvM_AC3_SRBS_Srv for NVRAM Block NVM_BLOCK_SER_FLASHLOGB
      PS_NVM_BLOCK_SER_SECURITYVIOLATION: provided-interface=NvM_AC3_SRBS_Srv  # PPort_NVM_BLOCK_SER_SECURITYVIOLATION : NvM_AC3_SRBS_Srv | P-Port Prototype of NvM_AC3_SRBS_Srv for NVRAM Block NVM_BLOCK_SER_SECURITYVIOLATION
      PS_Rte_NvmBlock_VehDyn_MotPosReset: provided-interface=NvM_AC3_SRBS_Srv  # PPort_Rte_NvmBlock_VehDyn_MotPosReset : NvM_AC3_SRBS_Srv | P-Port Prototype of NvM_AC3_SRBS_Srv for NVRAM Block Rte_NvmBlock_VehDyn_MotPosReset
      PS_NVM_BLOCK_SER_AUTHENTICATIONZONE: provided-interface=NvM_AC3_SRBS_Srv_Defs  # PPort_NVM_BLOCK_SER_AUTHENTICATIONZONE : NvM_AC3_SRBS_Srv_Defs | P-Port Prototype of NvM_AC3_SRBS_Srv_Defs for NVRAM Block NVM_BLOCK_SER_AUTHENTICATIONZONE
      PS_NVM_BLOCK_SER_ECUMANUFACTURINGDATE: provided-interface=NvM_AC3_SRBS_Srv_Defs  # PPort_NVM_BLOCK_SER_ECUMANUFACTURINGDATE : NvM_AC3_SRBS_Srv_Defs | P-Port Prototype of NvM_AC3_SRBS_Srv_Defs for NVRAM Block NVM_BLOCK_SER_ECUMANUFACTURINGDATE
      PS_NVM_BLOCK_SER_EMCSTANDARDIZATIONLABEL: provided-interface=NvM_AC3_SRBS_Srv_Defs  # PPort_NVM_BLOCK_SER_EMCSTANDARDIZATIONLABEL : NvM_AC3_SRBS_Srv_Defs | P-Port Prototype of NvM_AC3_SRBS_Srv_Defs for NVRAM Block NVM_BLOCK_SER_EMCSTANDARDIZATIONLABEL
      PS_NVM_BLOCK_SER_CUSTECUSRLNUM: provided-interface=NvM_AC3_SRBS_Srv_Defs  # PPort_NVM_BLOCK_SER_CUSTECUSRLNUM : NvM_AC3_SRBS_Srv_Defs | P-Port Prototype of NvM_AC3_SRBS_Srv_Defs for NVRAM Block NVM_BLOCK_SER_CUSTECUSRLNUM
      PS_NVM_BLOCK_SER_SECURITYKEY: provided-interface=NvM_AC3_SRBS_Srv_Defs  # PPort_NVM_BLOCK_SER_SECURITYKEY : NvM_AC3_SRBS_Srv_Defs | P-Port Prototype of NvM_AC3_SRBS_Srv_Defs for NVRAM Block NVM_BLOCK_SER_SECURITYKEY
      PS_Rte_NvmBlock_SrlComInput_VVHTYPEData: provided-interface=NvM_AC3_SRBS_Srv  # PPort_Rte_NvmBlock_SrlComInput_VVHTYPEData : NvM_AC3_SRBS_Srv | P-Port Prototype of NvM_AC3_SRBS_Srv for NVRAM Block Rte_NvmBlock_SrlComInput_VVHTYPEData
      PS_Rte_NvmBlock_SrlComInput_ElecIntData: provided-interface=NvM_AC3_SRBS_Srv  # PPort_Rte_NvmBlock_SrlComInput_ElecIntData : NvM_AC3_SRBS_Srv | P-Port Prototype of NvM_AC3_SRBS_Srv for NVRAM Block Rte_NvmBlock_SrlComInput_ElecIntData
      PS_NVM_BLOCK_SER_TUNINGSELECT: provided-interface=NvM_AC3_SRBS_Srv_Defs  # PPort_NVM_BLOCK_SER_TUNINGSELECT : NvM_AC3_SRBS_Srv_Defs | P-Port Prototype of NvM_AC3_SRBS_Srv_Defs for NVRAM Block NVM_BLOCK_SER_TUNINGSELECT
      PS_Rte_NvmBlock_CmMtrCurr_ShCurrCal: provided-interface=NvM_AC3_SRBS_Srv  # PPort_Rte_NvmBlock_CmMtrCurr_ShCurrCal : NvM_AC3_SRBS_Srv | P-Port Prototype of NvM_AC3_SRBS_Srv for NVRAM Block Rte_NvmBlock_CmMtrCurr_ShCurrCal
      PS_Rte_NvmBlock_TrqCanc_CogTrqCal: provided-interface=NvM_AC3_SRBS_Srv  # PPort_Rte_NvmBlock_TrqCanc_CogTrqCal : NvM_AC3_SRBS_Srv | P-Port Prototype of NvM_AC3_SRBS_Srv for NVRAM Block Rte_NvmBlock_TrqCanc_CogTrqCal
      PS_Rte_NvmBlock_TrqCanc_CogTrqRplComp: provided-interface=NvM_AC3_SRBS_Srv  # PPort_Rte_NvmBlock_TrqCanc_CogTrqRplComp : NvM_AC3_SRBS_Srv | P-Port Prototype of NvM_AC3_SRBS_Srv for NVRAM Block Rte_NvmBlock_TrqCanc_CogTrqRplComp
      PS_Rte_NvmBlock_LrnEOT_LearnedEOT: provided-interface=NvM_AC3_SRBS_Srv  # PPort_Rte_NvmBlock_LrnEOT_LearnedEOT : NvM_AC3_SRBS_Srv | P-Port Prototype of NvM_AC3_SRBS_Srv for NVRAM Block Rte_NvmBlock_LrnEOT_LearnedEOT
      PS_Rte_NvmBlock_AvgFricLrn_AvgFricLrnData: provided-interface=NvM_AC3_SRBS_Srv  # PPort_Rte_NvmBlock_AvgFricLrn_AvgFricLrnData : NvM_AC3_SRBS_Srv | P-Port Prototype of NvM_AC3_SRBS_Srv for NVRAM Block Rte_NvmBlock_AvgFricLrn_AvgFricLrnData
      PS_Rte_NvmBlock_CmMtrCurr_CurrTempOffset: provided-interface=NvM_AC3_SRBS_Srv  # PPort_Rte_NvmBlock_CmMtrCurr_CurrTempOffset : NvM_AC3_SRBS_Srv | P-Port Prototype of NvM_AC3_SRBS_Srv for NVRAM Block Rte_NvmBlock_CmMtrCurr_CurrTempOffset
      PS_Rte_NvmBlock_FaultLog_FaultLog: provided-interface=NvM_AC3_SRBS_Srv  # PPort_Rte_NvmBlock_FaultLog_FaultLog : NvM_AC3_SRBS_Srv | P-Port Prototype of NvM_AC3_SRBS_Srv for NVRAM Block Rte_NvmBlock_FaultLog_FaultLog
      PS_Rte_NvmBlock_SrlComInput_ShutdownTimeData: provided-interface=NvM_AC3_SRBS_Srv  # PPort_Rte_NvmBlock_SrlComInput_ShutdownTimeData : NvM_AC3_SRBS_Srv | P-Port Prototype of NvM_AC3_SRBS_Srv for NVRAM Block Rte_NvmBlock_SrlComInput_ShutdownTimeData
      PS_Rte_NvmBlock_AbsHwPos_EOLVehCntrOffset: provided-interface=NvM_AC3_SRBS_Srv  # PPort_Rte_NvmBlock_AbsHwPos_EOLVehCntrOffset : NvM_AC3_SRBS_Srv | P-Port Prototype of NvM_AC3_SRBS_Srv for NVRAM Block Rte_NvmBlock_AbsHwPos_EOLVehCntrOffset
      PS_Rte_NvmBlock_HwTqCorrln_HwTqCorrlnCh1CMCLPFSvData: provided-interface=NvM_AC3_SRBS_Srv  # PPort_Rte_NvmBlock_HwTqCorrln_HwTqCorrlnCh1CMCLPFSvData : NvM_AC3_SRBS_Srv | P-Port Prototype of NvM_AC3_SRBS_Srv for NVRAM Block Rte_NvmBlock_HwTqCorrln_HwTqCorrlnCh1CMCLPFSvData
      PS_NVM_BLOCK_SER_POWERPACKCONFIG: provided-interface=NvM_AC3_SRBS_Srv_Defs  # PPort_NVM_BLOCK_SER_POWERPACKCONFIG : NvM_AC3_SRBS_Srv_Defs | P-Port Prototype of NvM_AC3_SRBS_Srv_Defs for NVRAM Block NVM_BLOCK_SER_POWERPACKCONFIG
      PS_Rte_NvmBlock_HwTqArbn_HwTqArbnEOLCh1OffsetTrimData: provided-interface=NvM_AC3_SRBS_Srv  # PPort_Rte_NvmBlock_HwTqArbn_HwTqArbnEOLCh1OffsetTrimData : NvM_AC3_SRBS_Srv | P-Port Prototype of NvM_AC3_SRBS_Srv for NVRAM Block Rte_NvmBlock_HwTqArbn_HwTqArbnEOLCh1OffsetTrimData
      PS_Rte_NvmBlock_TrqCmdScl_TorqueCmdSF_Uls_f32: provided-interface=NvM_AC3_SRBS_Srv  # PPort_Rte_NvmBlock_TrqCmdScl_TorqueCmdSF_Uls_f32 : NvM_AC3_SRBS_Srv | P-Port Prototype of NvM_AC3_SRBS_Srv for NVRAM Block Rte_NvmBlock_TrqCmdScl_TorqueCmdSF_Uls_f32
      PS_Rte_NvmBlock_PsaAgArbn_PsaAgArbnLrndOffsData: provided-interface=NvM_AC3_SRBS_Srv  # PPort_Rte_NvmBlock_PsaAgArbn_PsaAgArbnLrndOffsData : NvM_AC3_SRBS_Srv | P-Port Prototype of NvM_AC3_SRBS_Srv for NVRAM Block Rte_NvmBlock_PsaAgArbn_PsaAgArbnLrndOffsData
      PS_Rte_NvmBlock_ActivePull_PullCmpLTComp_HwNm_f32: provided-interface=NvM_AC3_SRBS_Srv  # PPort_Rte_NvmBlock_ActivePull_PullCmpLTComp_HwNm_f32 : NvM_AC3_SRBS_Srv | P-Port Prototype of NvM_AC3_SRBS_Srv for NVRAM Block Rte_NvmBlock_ActivePull_PullCmpLTComp_HwNm_f32
      PAdmin_NVM_BLOCK_DIAGMGR_NTCSTRG: provided-interface=NvM_Administration  # PPort_NVM_BLOCK_DIAGMGR_NTCSTRG : NvM_Administration | P-Port Prototype of NvM_Administration for NVRAM Block NVM_BLOCK_DIAGMGR_NTCSTRG
      PAdmin_ConfigBlock: provided-interface=NvM_Administration  # PPort_ConfigBlock : NvM_Administration | P-Port Prototype of NvM_Administration for NVRAM Block ConfigBlock
      PAdmin_NVM_BLOCK_EPSDEFEATS: provided-interface=NvM_Administration  # PPort_NVM_BLOCK_EPSDEFEATS : NvM_Administration | P-Port Prototype of NvM_Administration for NVRAM Block NVM_BLOCK_EPSDEFEATS
      PAdmin_Rte_NvmBlock_StaMd_TypeHRamBuffer: provided-interface=NvM_Administration  # PPort_Rte_NvmBlock_StaMd_TypeHRamBuffer : NvM_Administration | P-Port Prototype of NvM_Administration for NVRAM Block Rte_NvmBlock_StaMd_TypeHRamBuffer
      PAdmin_Rte_NvmBlock_Polarity_Polarity_Cnt_Str: provided-interface=NvM_Administration  # PPort_Rte_NvmBlock_Polarity_Polarity_Cnt_Str : NvM_Administration | P-Port Prototype of NvM_Administration for NVRAM Block Rte_NvmBlock_Polarity_Polarity_Cnt_Str
      PAdmin_Rte_NvmBlock_CurrParamComp_EOLNomMtrParam: provided-interface=NvM_Administration  # PPort_Rte_NvmBlock_CurrParamComp_EOLNomMtrParam : NvM_Administration | P-Port Prototype of NvM_Administration for NVRAM Block Rte_NvmBlock_CurrParamComp_EOLNomMtrParam
      PAdmin_NVM_BLOCK_CMS_NXTRMEC: provided-interface=NvM_Administration  # PPort_NVM_BLOCK_CMS_NXTRMEC : NvM_Administration | P-Port Prototype of NvM_Administration for NVRAM Block NVM_BLOCK_CMS_NXTRMEC
      PAdmin_NVM_BLOCK_CMS_ECUSRLNUM: provided-interface=NvM_Administration  # PPort_NVM_BLOCK_CMS_ECUSRLNUM : NvM_Administration | P-Port Prototype of NvM_Administration for NVRAM Block NVM_BLOCK_CMS_ECUSRLNUM
      PAdmin_NVM_BLOCK_CMS_EPSSRLNUM: provided-interface=NvM_Administration  # PPort_NVM_BLOCK_CMS_EPSSRLNUM : NvM_Administration | P-Port Prototype of NvM_Administration for NVRAM Block NVM_BLOCK_CMS_EPSSRLNUM
      PAdmin_NVM_BLOCK_CMS_ECUHWPN: provided-interface=NvM_Administration  # PPort_NVM_BLOCK_CMS_ECUHWPN : NvM_Administration | P-Port Prototype of NvM_Administration for NVRAM Block NVM_BLOCK_CMS_ECUHWPN
      PAdmin_NVM_BLOCK_CMS_NXTRMANUFSCRATCHPAD: provided-interface=NvM_Administration  # PPort_NVM_BLOCK_CMS_NXTRMANUFSCRATCHPAD : NvM_Administration | P-Port Prototype of NvM_Administration for NVRAM Block NVM_BLOCK_CMS_NXTRMANUFSCRATCHPAD
      PAdmin_NVM_BLOCK_CMS_IGNCNTR: provided-interface=NvM_Administration  # PPort_NVM_BLOCK_CMS_IGNCNTR : NvM_Administration | P-Port Prototype of NvM_Administration for NVRAM Block NVM_BLOCK_CMS_IGNCNTR
      PAdmin_Rte_NvmBlock_StaMd_CloseCheckData: provided-interface=NvM_Administration  # PPort_Rte_NvmBlock_StaMd_CloseCheckData : NvM_Administration | P-Port Prototype of NvM_Administration for NVRAM Block Rte_NvmBlock_StaMd_CloseCheckData
      PAdmin_Rte_NvmBlock_Sa_DigMSB_DigMSBEOLData: provided-interface=NvM_Administration  # PPort_Rte_NvmBlock_Sa_DigMSB_DigMSBEOLData : NvM_Administration | P-Port Prototype of NvM_Administration for NVRAM Block Rte_NvmBlock_Sa_DigMSB_DigMSBEOLData
      PAdmin_NVM_BLOCK_DIAGMGR_BLACKBOX: provided-interface=NvM_Administration  # PPort_NVM_BLOCK_DIAGMGR_BLACKBOX : NvM_Administration | P-Port Prototype of NvM_Administration for NVRAM Block NVM_BLOCK_DIAGMGR_BLACKBOX
      PAdmin_Rte_NvmBlock_BatteryVoltage_OvervoltageData: provided-interface=NvM_Administration  # PPort_Rte_NvmBlock_BatteryVoltage_OvervoltageData : NvM_Administration | P-Port Prototype of NvM_Administration for NVRAM Block Rte_NvmBlock_BatteryVoltage_OvervoltageData
      PAdmin_Rte_NvmBlock_ThrmlDutyCycle_ThrmlDutyCycle_FltStVal: provided-interface=NvM_Administration  # PPort_Rte_NvmBlock_ThrmlDutyCycle_ThrmlDutyCycle_FltStVal : NvM_Administration | P-Port Prototype of NvM_Administration for NVRAM Block Rte_NvmBlock_ThrmlDutyCycle_ThrmlDutyCycle_FltStVal
      PAdmin_NVM_BLOCK_DIAGMGR_LATCHCNTRS: provided-interface=NvM_Administration  # PPort_NVM_BLOCK_DIAGMGR_LATCHCNTRS : NvM_Administration | P-Port Prototype of NvM_Administration for NVRAM Block NVM_BLOCK_DIAGMGR_LATCHCNTRS
      PAdmin_NVM_BLOCK_SER_FLASHLOGA: provided-interface=NvM_Administration  # PPort_NVM_BLOCK_SER_FLASHLOGA : NvM_Administration | P-Port Prototype of NvM_Administration for NVRAM Block NVM_BLOCK_SER_FLASHLOGA
      PAdmin_NVM_BLOCK_SER_FLASHLOGB: provided-interface=NvM_Administration  # PPort_NVM_BLOCK_SER_FLASHLOGB : NvM_Administration | P-Port Prototype of NvM_Administration for NVRAM Block NVM_BLOCK_SER_FLASHLOGB
      PAdmin_NVM_BLOCK_SER_SECURITYVIOLATION: provided-interface=NvM_Administration  # PPort_NVM_BLOCK_SER_SECURITYVIOLATION : NvM_Administration | P-Port Prototype of NvM_Administration for NVRAM Block NVM_BLOCK_SER_SECURITYVIOLATION
      PAdmin_Rte_NvmBlock_VehDyn_MotPosReset: provided-interface=NvM_Administration  # PPort_Rte_NvmBlock_VehDyn_MotPosReset : NvM_Administration | P-Port Prototype of NvM_Administration for NVRAM Block Rte_NvmBlock_VehDyn_MotPosReset
      PAdmin_NVM_BLOCK_SER_AUTHENTICATIONZONE: provided-interface=NvM_Administration  # PPort_NVM_BLOCK_SER_AUTHENTICATIONZONE : NvM_Administration | P-Port Prototype of NvM_Administration for NVRAM Block NVM_BLOCK_SER_AUTHENTICATIONZONE
      PAdmin_NVM_BLOCK_SER_ECUMANUFACTURINGDATE: provided-interface=NvM_Administration  # PPort_NVM_BLOCK_SER_ECUMANUFACTURINGDATE : NvM_Administration | P-Port Prototype of NvM_Administration for NVRAM Block NVM_BLOCK_SER_ECUMANUFACTURINGDATE
      PAdmin_NVM_BLOCK_SER_EMCSTANDARDIZATIONLABEL: provided-interface=NvM_Administration  # PPort_NVM_BLOCK_SER_EMCSTANDARDIZATIONLABEL : NvM_Administration | P-Port Prototype of NvM_Administration for NVRAM Block NVM_BLOCK_SER_EMCSTANDARDIZATIONLABEL
      PAdmin_NVM_BLOCK_SER_CUSTECUSRLNUM: provided-interface=NvM_Administration  # PPort_NVM_BLOCK_SER_CUSTECUSRLNUM : NvM_Administration | P-Port Prototype of NvM_Administration for NVRAM Block NVM_BLOCK_SER_CUSTECUSRLNUM
      PAdmin_NVM_BLOCK_SER_SECURITYKEY: provided-interface=NvM_Administration  # PPort_NVM_BLOCK_SER_SECURITYKEY : NvM_Administration | P-Port Prototype of NvM_Administration for NVRAM Block NVM_BLOCK_SER_SECURITYKEY
      PAdmin_Rte_NvmBlock_SrlComInput_VVHTYPEData: provided-interface=NvM_Administration  # PPort_Rte_NvmBlock_SrlComInput_VVHTYPEData : NvM_Administration | P-Port Prototype of NvM_Administration for NVRAM Block Rte_NvmBlock_SrlComInput_VVHTYPEData
      PAdmin_Rte_NvmBlock_SrlComInput_ElecIntData: provided-interface=NvM_Administration  # PPort_Rte_NvmBlock_SrlComInput_ElecIntData : NvM_Administration | P-Port Prototype of NvM_Administration for NVRAM Block Rte_NvmBlock_SrlComInput_ElecIntData
      PAdmin_NVM_BLOCK_SER_TUNINGSELECT: provided-interface=NvM_Administration  # PPort_NVM_BLOCK_SER_TUNINGSELECT : NvM_Administration | P-Port Prototype of NvM_Administration for NVRAM Block NVM_BLOCK_SER_TUNINGSELECT
      PAdmin_Rte_NvmBlock_CmMtrCurr_ShCurrCal: provided-interface=NvM_Administration  # PPort_Rte_NvmBlock_CmMtrCurr_ShCurrCal : NvM_Administration | P-Port Prototype of NvM_Administration for NVRAM Block Rte_NvmBlock_CmMtrCurr_ShCurrCal
      PAdmin_Rte_NvmBlock_TrqCanc_CogTrqCal: provided-interface=NvM_Administration  # PPort_Rte_NvmBlock_TrqCanc_CogTrqCal : NvM_Administration | P-Port Prototype of NvM_Administration for NVRAM Block Rte_NvmBlock_TrqCanc_CogTrqCal
      PAdmin_Rte_NvmBlock_TrqCanc_CogTrqRplComp: provided-interface=NvM_Administration  # PPort_Rte_NvmBlock_TrqCanc_CogTrqRplComp : NvM_Administration | P-Port Prototype of NvM_Administration for NVRAM Block Rte_NvmBlock_TrqCanc_CogTrqRplComp
      PAdmin_Rte_NvmBlock_LrnEOT_LearnedEOT: provided-interface=NvM_Administration  # PPort_Rte_NvmBlock_LrnEOT_LearnedEOT : NvM_Administration | P-Port Prototype of NvM_Administration for NVRAM Block Rte_NvmBlock_LrnEOT_LearnedEOT
      PAdmin_Rte_NvmBlock_AvgFricLrn_AvgFricLrnData: provided-interface=NvM_Administration  # PPort_Rte_NvmBlock_AvgFricLrn_AvgFricLrnData : NvM_Administration | P-Port Prototype of NvM_Administration for NVRAM Block Rte_NvmBlock_AvgFricLrn_AvgFricLrnData
      PAdmin_Rte_NvmBlock_CmMtrCurr_CurrTempOffset: provided-interface=NvM_Administration  # PPort_Rte_NvmBlock_CmMtrCurr_CurrTempOffset : NvM_Administration | P-Port Prototype of NvM_Administration for NVRAM Block Rte_NvmBlock_CmMtrCurr_CurrTempOffset
      PAdmin_Rte_NvmBlock_FaultLog_FaultLog: provided-interface=NvM_Administration  # PPort_Rte_NvmBlock_FaultLog_FaultLog : NvM_Administration | P-Port Prototype of NvM_Administration for NVRAM Block Rte_NvmBlock_FaultLog_FaultLog
      PAdmin_Rte_NvmBlock_SrlComInput_ShutdownTimeData: provided-interface=NvM_Administration  # PPort_Rte_NvmBlock_SrlComInput_ShutdownTimeData : NvM_Administration | P-Port Prototype of NvM_Administration for NVRAM Block Rte_NvmBlock_SrlComInput_ShutdownTimeData
      PAdmin_Rte_NvmBlock_AbsHwPos_EOLVehCntrOffset: provided-interface=NvM_Administration  # PPort_Rte_NvmBlock_AbsHwPos_EOLVehCntrOffset : NvM_Administration | P-Port Prototype of NvM_Administration for NVRAM Block Rte_NvmBlock_AbsHwPos_EOLVehCntrOffset
      PAdmin_Rte_NvmBlock_HwTqCorrln_HwTqCorrlnCh1CMCLPFSvData: provided-interface=NvM_Administration  # PPort_Rte_NvmBlock_HwTqCorrln_HwTqCorrlnCh1CMCLPFSvData : NvM_Administration | P-Port Prototype of NvM_Administration for NVRAM Block Rte_NvmBlock_HwTqCorrln_HwTqCorrlnCh1CMCLPFSvData
      PAdmin_NVM_BLOCK_SER_POWERPACKCONFIG: provided-interface=NvM_Administration  # PPort_NVM_BLOCK_SER_POWERPACKCONFIG : NvM_Administration | P-Port Prototype of NvM_Administration for NVRAM Block NVM_BLOCK_SER_POWERPACKCONFIG
      PAdmin_Rte_NvmBlock_HwTqArbn_HwTqArbnEOLCh1OffsetTrimData: provided-interface=NvM_Administration  # PPort_Rte_NvmBlock_HwTqArbn_HwTqArbnEOLCh1OffsetTrimData : NvM_Administration | P-Port Prototype of NvM_Administration for NVRAM Block Rte_NvmBlock_HwTqArbn_HwTqArbnEOLCh1OffsetTrimData
      PAdmin_Rte_NvmBlock_TrqCmdScl_TorqueCmdSF_Uls_f32: provided-interface=NvM_Administration  # PPort_Rte_NvmBlock_TrqCmdScl_TorqueCmdSF_Uls_f32 : NvM_Administration | P-Port Prototype of NvM_Administration for NVRAM Block Rte_NvmBlock_TrqCmdScl_TorqueCmdSF_Uls_f32
      PAdmin_Rte_NvmBlock_PsaAgArbn_PsaAgArbnLrndOffsData: provided-interface=NvM_Administration  # PPort_Rte_NvmBlock_PsaAgArbn_PsaAgArbnLrndOffsData : NvM_Administration | P-Port Prototype of NvM_Administration for NVRAM Block Rte_NvmBlock_PsaAgArbn_PsaAgArbnLrndOffsData
      PAdmin_Rte_NvmBlock_ActivePull_PullCmpLTComp_HwNm_f32: provided-interface=NvM_Administration  # PPort_Rte_NvmBlock_ActivePull_PullCmpLTComp_HwNm_f32 : NvM_Administration | P-Port Prototype of NvM_Administration for NVRAM Block Rte_NvmBlock_ActivePull_PullCmpLTComp_HwNm_f32
  swc implementation NvM_Impl: behavior=NvM_Behavior
  internal behavior NvM_Behavior: component=NvM
    322 x operation invoked event:
      V_2_GetErrorStatus: start-on-event=GetErrorStatus, operation=PS_NVM_BLOCK_DIAGMGR_NTCSTRG.GetErrorStatus
      V_2_SetRamBlockStatus: start-on-event=SetRamBlockStatus, operation=PS_NVM_BLOCK_DIAGMGR_NTCSTRG.SetRamBlockStatus
      V_2_ReadBlock: start-on-event=ReadBlock, operation=PS_NVM_BLOCK_DIAGMGR_NTCSTRG.ReadBlock
      V_2_WriteBlock: start-on-event=WriteBlock, operation=PS_NVM_BLOCK_DIAGMGR_NTCSTRG.WriteBlock
      V_2_InvalidateNvBlock: start-on-event=InvalidateNvBlock, operation=PS_NVM_BLOCK_DIAGMGR_NTCSTRG.InvalidateNvBlock
      V_2_EraseBlock: start-on-event=EraseBlock, operation=PS_NVM_BLOCK_DIAGMGR_NTCSTRG.EraseBlock
      V_2_SetBlockProtection: start-on-event=SetBlockProtection, operation=PAdmin_NVM_BLOCK_DIAGMGR_NTCSTRG.SetBlockProtection
      V_1_GetErrorStatus: start-on-event=GetErrorStatus, operation=PS_ConfigBlock.GetErrorStatus
      V_1_SetRamBlockStatus: start-on-event=SetRamBlockStatus, operation=PS_ConfigBlock.SetRamBlockStatus
      V_1_ReadBlock: start-on-event=ReadBlock, operation=PS_ConfigBlock.ReadBlock
      V_1_WriteBlock: start-on-event=WriteBlock, operation=PS_ConfigBlock.WriteBlock
      V_1_InvalidateNvBlock: start-on-event=InvalidateNvBlock, operation=PS_ConfigBlock.InvalidateNvBlock
      V_1_EraseBlock: start-on-event=EraseBlock, operation=PS_ConfigBlock.EraseBlock
      V_1_SetBlockProtection: start-on-event=SetBlockProtection, operation=PAdmin_ConfigBlock.SetBlockProtection
      V_3_GetErrorStatus: start-on-event=GetErrorStatus, operation=PS_NVM_BLOCK_EPSDEFEATS.GetErrorStatus
      V_3_SetRamBlockStatus: start-on-event=SetRamBlockStatus, operation=PS_NVM_BLOCK_EPSDEFEATS.SetRamBlockStatus
      V_3_ReadBlock: start-on-event=ReadBlock, operation=PS_NVM_BLOCK_EPSDEFEATS.ReadBlock
      V_3_WriteBlock: start-on-event=WriteBlock, operation=PS_NVM_BLOCK_EPSDEFEATS.WriteBlock
      V_3_InvalidateNvBlock: start-on-event=InvalidateNvBlock, operation=PS_NVM_BLOCK_EPSDEFEATS.InvalidateNvBlock
      V_3_EraseBlock: start-on-event=EraseBlock, operation=PS_NVM_BLOCK_EPSDEFEATS.EraseBlock
      V_3_SetBlockProtection: start-on-event=SetBlockProtection, operation=PAdmin_NVM_BLOCK_EPSDEFEATS.SetBlockProtection
      V_5_GetErrorStatus: start-on-event=GetErrorStatus, operation=PS_Rte_NvmBlock_StaMd_TypeHRamBuffer.GetErrorStatus
      V_5_SetRamBlockStatus: start-on-event=SetRamBlockStatus, operation=PS_Rte_NvmBlock_StaMd_TypeHRamBuffer.SetRamBlockStatus
      V_5_ReadBlock: start-on-event=ReadBlock, operation=PS_Rte_NvmBlock_StaMd_TypeHRamBuffer.ReadBlock
      V_5_WriteBlock: start-on-event=WriteBlock, operation=PS_Rte_NvmBlock_StaMd_TypeHRamBuffer.WriteBlock
      V_5_InvalidateNvBlock: start-on-event=InvalidateNvBlock, operation=PS_Rte_NvmBlock_StaMd_TypeHRamBuffer.InvalidateNvBlock
      V_5_EraseBlock: start-on-event=EraseBlock, operation=PS_Rte_NvmBlock_StaMd_TypeHRamBuffer.EraseBlock
      V_5_SetBlockProtection: start-on-event=SetBlockProtection, operation=PAdmin_Rte_NvmBlock_StaMd_TypeHRamBuffer.SetBlockProtection
      V_6_GetErrorStatus: start-on-event=GetErrorStatus, operation=PS_Rte_NvmBlock_Polarity_Polarity_Cnt_Str.GetErrorStatus
      V_6_SetRamBlockStatus: start-on-event=SetRamBlockStatus, operation=PS_Rte_NvmBlock_Polarity_Polarity_Cnt_Str.SetRamBlockStatus
      V_6_ReadBlock: start-on-event=ReadBlock, operation=PS_Rte_NvmBlock_Polarity_Polarity_Cnt_Str.ReadBlock
      V_6_WriteBlock: start-on-event=WriteBlock, operation=PS_Rte_NvmBlock_Polarity_Polarity_Cnt_Str.WriteBlock
      V_6_InvalidateNvBlock: start-on-event=InvalidateNvBlock, operation=PS_Rte_NvmBlock_Polarity_Polarity_Cnt_Str.InvalidateNvBlock
      V_6_EraseBlock: start-on-event=EraseBlock, operation=PS_Rte_NvmBlock_Polarity_Polarity_Cnt_Str.EraseBlock
      V_6_SetBlockProtection: start-on-event=SetBlockProtection, operation=PAdmin_Rte_NvmBlock_Polarity_Polarity_Cnt_Str.SetBlockProtection
      V_7_GetErrorStatus: start-on-event=GetErrorStatus, operation=PS_Rte_NvmBlock_CurrParamComp_EOLNomMtrParam.GetErrorStatus
      V_7_SetRamBlockStatus: start-on-event=SetRamBlockStatus, operation=PS_Rte_NvmBlock_CurrParamComp_EOLNomMtrParam.SetRamBlockStatus
      V_7_ReadBlock: start-on-event=ReadBlock, operation=PS_Rte_NvmBlock_CurrParamComp_EOLNomMtrParam.ReadBlock
      V_7_WriteBlock: start-on-event=WriteBlock, operation=PS_Rte_NvmBlock_CurrParamComp_EOLNomMtrParam.WriteBlock
      V_7_InvalidateNvBlock: start-on-event=InvalidateNvBlock, operation=PS_Rte_NvmBlock_CurrParamComp_EOLNomMtrParam.InvalidateNvBlock
      V_7_EraseBlock: start-on-event=EraseBlock, operation=PS_Rte_NvmBlock_CurrParamComp_EOLNomMtrParam.EraseBlock
      V_7_SetBlockProtection: start-on-event=SetBlockProtection, operation=PAdmin_Rte_NvmBlock_CurrParamComp_EOLNomMtrParam.SetBlockProtection
      V_8_GetErrorStatus: start-on-event=GetErrorStatus, operation=PS_NVM_BLOCK_CMS_NXTRMEC.GetErrorStatus
      V_8_SetRamBlockStatus: start-on-event=SetRamBlockStatus, operation=PS_NVM_BLOCK_CMS_NXTRMEC.SetRamBlockStatus
      V_8_ReadBlock: start-on-event=ReadBlock, operation=PS_NVM_BLOCK_CMS_NXTRMEC.ReadBlock
      V_8_WriteBlock: start-on-event=WriteBlock, operation=PS_NVM_BLOCK_CMS_NXTRMEC.WriteBlock
      V_8_InvalidateNvBlock: start-on-event=InvalidateNvBlock, operation=PS_NVM_BLOCK_CMS_NXTRMEC.InvalidateNvBlock
      V_8_EraseBlock: start-on-event=EraseBlock, operation=PS_NVM_BLOCK_CMS_NXTRMEC.EraseBlock
      V_8_SetBlockProtection: start-on-event=SetBlockProtection, operation=PAdmin_NVM_BLOCK_CMS_NXTRMEC.SetBlockProtection
      V_9_GetErrorStatus: start-on-event=GetErrorStatus, operation=PS_NVM_BLOCK_CMS_ECUSRLNUM.GetErrorStatus
      V_9_SetRamBlockStatus: start-on-event=SetRamBlockStatus, operation=PS_NVM_BLOCK_CMS_ECUSRLNUM.SetRamBlockStatus
      V_9_ReadBlock: start-on-event=ReadBlock, operation=PS_NVM_BLOCK_CMS_ECUSRLNUM.ReadBlock
      V_9_WriteBlock: start-on-event=WriteBlock, operation=PS_NVM_BLOCK_CMS_ECUSRLNUM.WriteBlock
      V_9_InvalidateNvBlock: start-on-event=InvalidateNvBlock, operation=PS_NVM_BLOCK_CMS_ECUSRLNUM.InvalidateNvBlock
      V_9_EraseBlock: start-on-event=EraseBlock, operation=PS_NVM_BLOCK_CMS_ECUSRLNUM.EraseBlock
      V_9_SetBlockProtection: start-on-event=SetBlockProtection, operation=PAdmin_NVM_BLOCK_CMS_ECUSRLNUM.SetBlockProtection
      V_10_GetErrorStatus: start-on-event=GetErrorStatus, operation=PS_NVM_BLOCK_CMS_EPSSRLNUM.GetErrorStatus
      V_10_SetRamBlockStatus: start-on-event=SetRamBlockStatus, operation=PS_NVM_BLOCK_CMS_EPSSRLNUM.SetRamBlockStatus
      V_10_ReadBlock: start-on-event=ReadBlock, operation=PS_NVM_BLOCK_CMS_EPSSRLNUM.ReadBlock
      V_10_WriteBlock: start-on-event=WriteBlock, operation=PS_NVM_BLOCK_CMS_EPSSRLNUM.WriteBlock
      V_10_InvalidateNvBlock: start-on-event=InvalidateNvBlock, operation=PS_NVM_BLOCK_CMS_EPSSRLNUM.InvalidateNvBlock
      V_10_EraseBlock: start-on-event=EraseBlock, operation=PS_NVM_BLOCK_CMS_EPSSRLNUM.EraseBlock
      V_10_SetBlockProtection: start-on-event=SetBlockProtection, operation=PAdmin_NVM_BLOCK_CMS_EPSSRLNUM.SetBlockProtection
      V_11_GetErrorStatus: start-on-event=GetErrorStatus, operation=PS_NVM_BLOCK_CMS_ECUHWPN.GetErrorStatus
      V_11_SetRamBlockStatus: start-on-event=SetRamBlockStatus, operation=PS_NVM_BLOCK_CMS_ECUHWPN.SetRamBlockStatus
      V_11_ReadBlock: start-on-event=ReadBlock, operation=PS_NVM_BLOCK_CMS_ECUHWPN.ReadBlock
      V_11_WriteBlock: start-on-event=WriteBlock, operation=PS_NVM_BLOCK_CMS_ECUHWPN.WriteBlock
      V_11_InvalidateNvBlock: start-on-event=InvalidateNvBlock, operation=PS_NVM_BLOCK_CMS_ECUHWPN.InvalidateNvBlock
      V_11_EraseBlock: start-on-event=EraseBlock, operation=PS_NVM_BLOCK_CMS_ECUHWPN.EraseBlock
      V_11_SetBlockProtection: start-on-event=SetBlockProtection, operation=PAdmin_NVM_BLOCK_CMS_ECUHWPN.SetBlockProtection
      V_12_GetErrorStatus: start-on-event=GetErrorStatus, operation=PS_NVM_BLOCK_CMS_NXTRMANUFSCRATCHPAD.GetErrorStatus
      V_12_SetRamBlockStatus: start-on-event=SetRamBlockStatus, operation=PS_NVM_BLOCK_CMS_NXTRMANUFSCRATCHPAD.SetRamBlockStatus
      V_12_ReadBlock: start-on-event=ReadBlock, operation=PS_NVM_BLOCK_CMS_NXTRMANUFSCRATCHPAD.ReadBlock
      V_12_WriteBlock: start-on-event=WriteBlock, operation=PS_NVM_BLOCK_CMS_NXTRMANUFSCRATCHPAD.WriteBlock
      V_12_InvalidateNvBlock: start-on-event=InvalidateNvBlock, operation=PS_NVM_BLOCK_CMS_NXTRMANUFSCRATCHPAD.InvalidateNvBlock
      V_12_EraseBlock: start-on-event=EraseBlock, operation=PS_NVM_BLOCK_CMS_NXTRMANUFSCRATCHPAD.EraseBlock
      V_12_SetBlockProtection: start-on-event=SetBlockProtection, operation=PAdmin_NVM_BLOCK_CMS_NXTRMANUFSCRATCHPAD.SetBlockProtection
      V_13_GetErrorStatus: start-on-event=GetErrorStatus, operation=PS_NVM_BLOCK_CMS_IGNCNTR.GetErrorStatus
      V_13_SetRamBlockStatus: start-on-event=SetRamBlockStatus, operation=PS_NVM_BLOCK_CMS_IGNCNTR.SetRamBlockStatus
      V_13_ReadBlock: start-on-event=ReadBlock, operation=PS_NVM_BLOCK_CMS_IGNCNTR.ReadBlock
      V_13_WriteBlock: start-on-event=WriteBlock, operation=PS_NVM_BLOCK_CMS_IGNCNTR.WriteBlock
      V_13_InvalidateNvBlock: start-on-event=InvalidateNvBlock, operation=PS_NVM_BLOCK_CMS_IGNCNTR.InvalidateNvBlock
      V_13_EraseBlock: start-on-event=EraseBlock, operation=PS_NVM_BLOCK_CMS_IGNCNTR.EraseBlock
      V_13_SetBlockProtection: start-on-event=SetBlockProtection, operation=PAdmin_NVM_BLOCK_CMS_IGNCNTR.SetBlockProtection
      V_14_GetErrorStatus: start-on-event=GetErrorStatus, operation=PS_Rte_NvmBlock_StaMd_CloseCheckData.GetErrorStatus
      V_14_SetRamBlockStatus: start-on-event=SetRamBlockStatus, operation=PS_Rte_NvmBlock_StaMd_CloseCheckData.SetRamBlockStatus
      V_14_ReadBlock: start-on-event=ReadBlock, operation=PS_Rte_NvmBlock_StaMd_CloseCheckData.ReadBlock
      V_14_WriteBlock: start-on-event=WriteBlock, operation=PS_Rte_NvmBlock_StaMd_CloseCheckData.WriteBlock
      V_14_InvalidateNvBlock: start-on-event=InvalidateNvBlock, operation=PS_Rte_NvmBlock_StaMd_CloseCheckData.InvalidateNvBlock
      V_14_EraseBlock: start-on-event=EraseBlock, operation=PS_Rte_NvmBlock_StaMd_CloseCheckData.EraseBlock
      V_14_SetBlockProtection: start-on-event=SetBlockProtection, operation=PAdmin_Rte_NvmBlock_StaMd_CloseCheckData.SetBlockProtection
      V_15_GetErrorStatus: start-on-event=GetErrorStatus, operation=PS_Rte_NvmBlock_Sa_DigMSB_DigMSBEOLData.GetErrorStatus
      V_15_SetRamBlockStatus: start-on-event=SetRamBlockStatus, operation=PS_Rte_NvmBlock_Sa_DigMSB_DigMSBEOLData.SetRamBlockStatus
      V_15_ReadBlock: start-on-event=ReadBlock, operation=PS_Rte_NvmBlock_Sa_DigMSB_DigMSBEOLData.ReadBlock
      V_15_WriteBlock: start-on-event=WriteBlock, operation=PS_Rte_NvmBlock_Sa_DigMSB_DigMSBEOLData.WriteBlock
      V_15_InvalidateNvBlock: start-on-event=InvalidateNvBlock, operation=PS_Rte_NvmBlock_Sa_DigMSB_DigMSBEOLData.InvalidateNvBlock
      V_15_EraseBlock: start-on-event=EraseBlock, operation=PS_Rte_NvmBlock_Sa_DigMSB_DigMSBEOLData.EraseBlock
      V_15_SetBlockProtection: start-on-event=SetBlockProtection, operation=PAdmin_Rte_NvmBlock_Sa_DigMSB_DigMSBEOLData.SetBlockProtection
      V_16_GetErrorStatus: start-on-event=GetErrorStatus, operation=PS_NVM_BLOCK_DIAGMGR_BLACKBOX.GetErrorStatus
      V_16_SetRamBlockStatus: start-on-event=SetRamBlockStatus, operation=PS_NVM_BLOCK_DIAGMGR_BLACKBOX.SetRamBlockStatus
      V_16_ReadBlock: start-on-event=ReadBlock, operation=PS_NVM_BLOCK_DIAGMGR_BLACKBOX.ReadBlock
      V_16_WriteBlock: start-on-event=WriteBlock, operation=PS_NVM_BLOCK_DIAGMGR_BLACKBOX.WriteBlock
      V_16_InvalidateNvBlock: start-on-event=InvalidateNvBlock, operation=PS_NVM_BLOCK_DIAGMGR_BLACKBOX.InvalidateNvBlock
      V_16_EraseBlock: start-on-event=EraseBlock, operation=PS_NVM_BLOCK_DIAGMGR_BLACKBOX.EraseBlock
      V_16_SetBlockProtection: start-on-event=SetBlockProtection, operation=PAdmin_NVM_BLOCK_DIAGMGR_BLACKBOX.SetBlockProtection
      V_17_GetErrorStatus: start-on-event=GetErrorStatus, operation=PS_Rte_NvmBlock_BatteryVoltage_OvervoltageData.GetErrorStatus
      V_17_SetRamBlockStatus: start-on-event=SetRamBlockStatus, operation=PS_Rte_NvmBlock_BatteryVoltage_OvervoltageData.SetRamBlockStatus
      V_17_ReadBlock: start-on-event=ReadBlock, operation=PS_Rte_NvmBlock_BatteryVoltage_OvervoltageData.ReadBlock
      V_17_WriteBlock: start-on-event=WriteBlock, operation=PS_Rte_NvmBlock_BatteryVoltage_OvervoltageData.WriteBlock
      V_17_InvalidateNvBlock: start-on-event=InvalidateNvBlock, operation=PS_Rte_NvmBlock_BatteryVoltage_OvervoltageData.InvalidateNvBlock
      V_17_EraseBlock: start-on-event=EraseBlock, operation=PS_Rte_NvmBlock_BatteryVoltage_OvervoltageData.EraseBlock
      V_17_SetBlockProtection: start-on-event=SetBlockProtection, operation=PAdmin_Rte_NvmBlock_BatteryVoltage_OvervoltageData.SetBlockProtection
      V_18_GetErrorStatus: start-on-event=GetErrorStatus, operation=PS_Rte_NvmBlock_ThrmlDutyCycle_ThrmlDutyCycle_FltStVal.GetErrorStatus
      V_18_SetRamBlockStatus: start-on-event=SetRamBlockStatus, operation=PS_Rte_NvmBlock_ThrmlDutyCycle_ThrmlDutyCycle_FltStVal.SetRamBlockStatus
      V_18_ReadBlock: start-on-event=ReadBlock, operation=PS_Rte_NvmBlock_ThrmlDutyCycle_ThrmlDutyCycle_FltStVal.ReadBlock
      V_18_WriteBlock: start-on-event=WriteBlock, operation=PS_Rte_NvmBlock_ThrmlDutyCycle_ThrmlDutyCycle_FltStVal.WriteBlock
      V_18_InvalidateNvBlock: start-on-event=InvalidateNvBlock, operation=PS_Rte_NvmBlock_ThrmlDutyCycle_ThrmlDutyCycle_FltStVal.InvalidateNvBlock
      V_18_EraseBlock: start-on-event=EraseBlock, operation=PS_Rte_NvmBlock_ThrmlDutyCycle_ThrmlDutyCycle_FltStVal.EraseBlock
      V_18_SetBlockProtection: start-on-event=SetBlockProtection, operation=PAdmin_Rte_NvmBlock_ThrmlDutyCycle_ThrmlDutyCycle_FltStVal.SetBlockProtection
      V_19_GetErrorStatus: start-on-event=GetErrorStatus, operation=PS_NVM_BLOCK_DIAGMGR_LATCHCNTRS.GetErrorStatus
      V_19_SetRamBlockStatus: start-on-event=SetRamBlockStatus, operation=PS_NVM_BLOCK_DIAGMGR_LATCHCNTRS.SetRamBlockStatus
      V_19_ReadBlock: start-on-event=ReadBlock, operation=PS_NVM_BLOCK_DIAGMGR_LATCHCNTRS.ReadBlock
      V_19_WriteBlock: start-on-event=WriteBlock, operation=PS_NVM_BLOCK_DIAGMGR_LATCHCNTRS.WriteBlock
      V_19_InvalidateNvBlock: start-on-event=InvalidateNvBlock, operation=PS_NVM_BLOCK_DIAGMGR_LATCHCNTRS.InvalidateNvBlock
      V_19_EraseBlock: start-on-event=EraseBlock, operation=PS_NVM_BLOCK_DIAGMGR_LATCHCNTRS.EraseBlock
      V_19_SetBlockProtection: start-on-event=SetBlockProtection, operation=PAdmin_NVM_BLOCK_DIAGMGR_LATCHCNTRS.SetBlockProtection
      V_20_GetErrorStatus: start-on-event=GetErrorStatus, operation=PS_NVM_BLOCK_SER_FLASHLOGA.GetErrorStatus
      V_20_SetRamBlockStatus: start-on-event=SetRamBlockStatus, operation=PS_NVM_BLOCK_SER_FLASHLOGA.SetRamBlockStatus
      V_20_ReadBlock: start-on-event=ReadBlock, operation=PS_NVM_BLOCK_SER_FLASHLOGA.ReadBlock
      V_20_WriteBlock: start-on-event=WriteBlock, operation=PS_NVM_BLOCK_SER_FLASHLOGA.WriteBlock
      V_20_InvalidateNvBlock: start-on-event=InvalidateNvBlock, operation=PS_NVM_BLOCK_SER_FLASHLOGA.InvalidateNvBlock
      V_20_EraseBlock: start-on-event=EraseBlock, operation=PS_NVM_BLOCK_SER_FLASHLOGA.EraseBlock
      V_20_SetBlockProtection: start-on-event=SetBlockProtection, operation=PAdmin_NVM_BLOCK_SER_FLASHLOGA.SetBlockProtection
      V_21_GetErrorStatus: start-on-event=GetErrorStatus, operation=PS_NVM_BLOCK_SER_FLASHLOGB.GetErrorStatus
      V_21_SetRamBlockStatus: start-on-event=SetRamBlockStatus, operation=PS_NVM_BLOCK_SER_FLASHLOGB.SetRamBlockStatus
      V_21_ReadBlock: start-on-event=ReadBlock, operation=PS_NVM_BLOCK_SER_FLASHLOGB.ReadBlock
      V_21_WriteBlock: start-on-event=WriteBlock, operation=PS_NVM_BLOCK_SER_FLASHLOGB.WriteBlock
      V_21_InvalidateNvBlock: start-on-event=InvalidateNvBlock, operation=PS_NVM_BLOCK_SER_FLASHLOGB.InvalidateNvBlock
      V_21_EraseBlock: start-on-event=EraseBlock, operation=PS_NVM_BLOCK_SER_FLASHLOGB.EraseBlock
      V_21_SetBlockProtection: start-on-event=SetBlockProtection, operation=PAdmin_NVM_BLOCK_SER_FLASHLOGB.SetBlockProtection
      V_22_GetErrorStatus: start-on-event=GetErrorStatus, operation=PS_NVM_BLOCK_SER_SECURITYVIOLATION.GetErrorStatus
      V_22_SetRamBlockStatus: start-on-event=SetRamBlockStatus, operation=PS_NVM_BLOCK_SER_SECURITYVIOLATION.SetRamBlockStatus
      V_22_ReadBlock: start-on-event=ReadBlock, operation=PS_NVM_BLOCK_SER_SECURITYVIOLATION.ReadBlock
      V_22_WriteBlock: start-on-event=WriteBlock, operation=PS_NVM_BLOCK_SER_SECURITYVIOLATION.WriteBlock
      V_22_InvalidateNvBlock: start-on-event=InvalidateNvBlock, operation=PS_NVM_BLOCK_SER_SECURITYVIOLATION.InvalidateNvBlock
      V_22_EraseBlock: start-on-event=EraseBlock, operation=PS_NVM_BLOCK_SER_SECURITYVIOLATION.EraseBlock
      V_22_SetBlockProtection: start-on-event=SetBlockProtection, operation=PAdmin_NVM_BLOCK_SER_SECURITYVIOLATION.SetBlockProtection
      V_23_GetErrorStatus: start-on-event=GetErrorStatus, operation=PS_Rte_NvmBlock_VehDyn_MotPosReset.GetErrorStatus
      V_23_SetRamBlockStatus: start-on-event=SetRamBlockStatus, operation=PS_Rte_NvmBlock_VehDyn_MotPosReset.SetRamBlockStatus
      V_23_ReadBlock: start-on-event=ReadBlock, operation=PS_Rte_NvmBlock_VehDyn_MotPosReset.ReadBlock
      V_23_WriteBlock: start-on-event=WriteBlock, operation=PS_Rte_NvmBlock_VehDyn_MotPosReset.WriteBlock
      V_23_InvalidateNvBlock: start-on-event=InvalidateNvBlock, operation=PS_Rte_NvmBlock_VehDyn_MotPosReset.InvalidateNvBlock
      V_23_EraseBlock: start-on-event=EraseBlock, operation=PS_Rte_NvmBlock_VehDyn_MotPosReset.EraseBlock
      V_23_SetBlockProtection: start-on-event=SetBlockProtection, operation=PAdmin_Rte_NvmBlock_VehDyn_MotPosReset.SetBlockProtection
      V_24_GetErrorStatus: start-on-event=GetErrorStatus, operation=PS_NVM_BLOCK_SER_AUTHENTICATIONZONE.GetErrorStatus
      V_24_SetRamBlockStatus: start-on-event=SetRamBlockStatus, operation=PS_NVM_BLOCK_SER_AUTHENTICATIONZONE.SetRamBlockStatus
      V_24_ReadBlock: start-on-event=ReadBlock, operation=PS_NVM_BLOCK_SER_AUTHENTICATIONZONE.ReadBlock
      V_24_WriteBlock: start-on-event=WriteBlock, operation=PS_NVM_BLOCK_SER_AUTHENTICATIONZONE.WriteBlock
      V_24_RestoreBlockDefaults: start-on-event=RestoreBlockDefaults, operation=PS_NVM_BLOCK_SER_AUTHENTICATIONZONE.RestoreBlockDefaults
      V_24_InvalidateNvBlock: start-on-event=InvalidateNvBlock, operation=PS_NVM_BLOCK_SER_AUTHENTICATIONZONE.InvalidateNvBlock
      V_24_EraseBlock: start-on-event=EraseBlock, operation=PS_NVM_BLOCK_SER_AUTHENTICATIONZONE.EraseBlock
      V_24_SetBlockProtection: start-on-event=SetBlockProtection, operation=PAdmin_NVM_BLOCK_SER_AUTHENTICATIONZONE.SetBlockProtection
      V_25_GetErrorStatus: start-on-event=GetErrorStatus, operation=PS_NVM_BLOCK_SER_ECUMANUFACTURINGDATE.GetErrorStatus
      V_25_SetRamBlockStatus: start-on-event=SetRamBlockStatus, operation=PS_NVM_BLOCK_SER_ECUMANUFACTURINGDATE.SetRamBlockStatus
      V_25_ReadBlock: start-on-event=ReadBlock, operation=PS_NVM_BLOCK_SER_ECUMANUFACTURINGDATE.ReadBlock
      V_25_WriteBlock: start-on-event=WriteBlock, operation=PS_NVM_BLOCK_SER_ECUMANUFACTURINGDATE.WriteBlock
      V_25_RestoreBlockDefaults: start-on-event=RestoreBlockDefaults, operation=PS_NVM_BLOCK_SER_ECUMANUFACTURINGDATE.RestoreBlockDefaults
      V_25_InvalidateNvBlock: start-on-event=InvalidateNvBlock, operation=PS_NVM_BLOCK_SER_ECUMANUFACTURINGDATE.InvalidateNvBlock
      V_25_EraseBlock: start-on-event=EraseBlock, operation=PS_NVM_BLOCK_SER_ECUMANUFACTURINGDATE.EraseBlock
      V_25_SetBlockProtection: start-on-event=SetBlockProtection, operation=PAdmin_NVM_BLOCK_SER_ECUMANUFACTURINGDATE.SetBlockProtection
      V_26_GetErrorStatus: start-on-event=GetErrorStatus, operation=PS_NVM_BLOCK_SER_EMCSTANDARDIZATIONLABEL.GetErrorStatus
      V_26_SetRamBlockStatus: start-on-event=SetRamBlockStatus, operation=PS_NVM_BLOCK_SER_EMCSTANDARDIZATIONLABEL.SetRamBlockStatus
      V_26_ReadBlock: start-on-event=ReadBlock, operation=PS_NVM_BLOCK_SER_EMCSTANDARDIZATIONLABEL.ReadBlock
      V_26_WriteBlock: start-on-event=WriteBlock, operation=PS_NVM_BLOCK_SER_EMCSTANDARDIZATIONLABEL.WriteBlock
      V_26_RestoreBlockDefaults: start-on-event=RestoreBlockDefaults, operation=PS_NVM_BLOCK_SER_EMCSTANDARDIZATIONLABEL.RestoreBlockDefaults
      V_26_InvalidateNvBlock: start-on-event=InvalidateNvBlock, operation=PS_NVM_BLOCK_SER_EMCSTANDARDIZATIONLABEL.InvalidateNvBlock
      V_26_EraseBlock: start-on-event=EraseBlock, operation=PS_NVM_BLOCK_SER_EMCSTANDARDIZATIONLABEL.EraseBlock
      V_26_SetBlockProtection: start-on-event=SetBlockProtection, operation=PAdmin_NVM_BLOCK_SER_EMCSTANDARDIZATIONLABEL.SetBlockProtection
      V_27_GetErrorStatus: start-on-event=GetErrorStatus, operation=PS_NVM_BLOCK_SER_CUSTECUSRLNUM.GetErrorStatus
      V_27_SetRamBlockStatus: start-on-event=SetRamBlockStatus, operation=PS_NVM_BLOCK_SER_CUSTECUSRLNUM.SetRamBlockStatus
      V_27_ReadBlock: start-on-event=ReadBlock, operation=PS_NVM_BLOCK_SER_CUSTECUSRLNUM.ReadBlock
      V_27_WriteBlock: start-on-event=WriteBlock, operation=PS_NVM_BLOCK_SER_CUSTECUSRLNUM.WriteBlock
      V_27_RestoreBlockDefaults: start-on-event=RestoreBlockDefaults, operation=PS_NVM_BLOCK_SER_CUSTECUSRLNUM.RestoreBlockDefaults
      V_27_InvalidateNvBlock: start-on-event=InvalidateNvBlock, operation=PS_NVM_BLOCK_SER_CUSTECUSRLNUM.InvalidateNvBlock
      V_27_EraseBlock: start-on-event=EraseBlock, operation=PS_NVM_BLOCK_SER_CUSTECUSRLNUM.EraseBlock
      V_27_SetBlockProtection: start-on-event=SetBlockProtection, operation=PAdmin_NVM_BLOCK_SER_CUSTECUSRLNUM.SetBlockProtection
      V_28_GetErrorStatus: start-on-event=GetErrorStatus, operation=PS_NVM_BLOCK_SER_SECURITYKEY.GetErrorStatus
      V_28_SetRamBlockStatus: start-on-event=SetRamBlockStatus, operation=PS_NVM_BLOCK_SER_SECURITYKEY.SetRamBlockStatus
      V_28_ReadBlock: start-on-event=ReadBlock, operation=PS_NVM_BLOCK_SER_SECURITYKEY.ReadBlock
      V_28_WriteBlock: start-on-event=WriteBlock, operation=PS_NVM_BLOCK_SER_SECURITYKEY.WriteBlock
      V_28_RestoreBlockDefaults: start-on-event=RestoreBlockDefaults, operation=PS_NVM_BLOCK_SER_SECURITYKEY.RestoreBlockDefaults
      V_28_InvalidateNvBlock: start-on-event=InvalidateNvBlock, operation=PS_NVM_BLOCK_SER_SECURITYKEY.InvalidateNvBlock
      V_28_EraseBlock: start-on-event=EraseBlock, operation=PS_NVM_BLOCK_SER_SECURITYKEY.EraseBlock
      V_28_SetBlockProtection: start-on-event=SetBlockProtection, operation=PAdmin_NVM_BLOCK_SER_SECURITYKEY.SetBlockProtection
      V_29_GetErrorStatus: start-on-event=GetErrorStatus, operation=PS_Rte_NvmBlock_SrlComInput_VVHTYPEData.GetErrorStatus
      V_29_SetRamBlockStatus: start-on-event=SetRamBlockStatus, operation=PS_Rte_NvmBlock_SrlComInput_VVHTYPEData.SetRamBlockStatus
      V_29_ReadBlock: start-on-event=ReadBlock, operation=PS_Rte_NvmBlock_SrlComInput_VVHTYPEData.ReadBlock
      V_29_WriteBlock: start-on-event=WriteBlock, operation=PS_Rte_NvmBlock_SrlComInput_VVHTYPEData.WriteBlock
      V_29_InvalidateNvBlock: start-on-event=InvalidateNvBlock, operation=PS_Rte_NvmBlock_SrlComInput_VVHTYPEData.InvalidateNvBlock
      V_29_EraseBlock: start-on-event=EraseBlock, operation=PS_Rte_NvmBlock_SrlComInput_VVHTYPEData.EraseBlock
      V_29_SetBlockProtection: start-on-event=SetBlockProtection, operation=PAdmin_Rte_NvmBlock_SrlComInput_VVHTYPEData.SetBlockProtection
      V_30_GetErrorStatus: start-on-event=GetErrorStatus, operation=PS_Rte_NvmBlock_SrlComInput_ElecIntData.GetErrorStatus
      V_30_SetRamBlockStatus: start-on-event=SetRamBlockStatus, operation=PS_Rte_NvmBlock_SrlComInput_ElecIntData.SetRamBlockStatus
      V_30_ReadBlock: start-on-event=ReadBlock, operation=PS_Rte_NvmBlock_SrlComInput_ElecIntData.ReadBlock
      V_30_WriteBlock: start-on-event=WriteBlock, operation=PS_Rte_NvmBlock_SrlComInput_ElecIntData.WriteBlock
      V_30_InvalidateNvBlock: start-on-event=InvalidateNvBlock, operation=PS_Rte_NvmBlock_SrlComInput_ElecIntData.InvalidateNvBlock
      V_30_EraseBlock: start-on-event=EraseBlock, operation=PS_Rte_NvmBlock_SrlComInput_ElecIntData.EraseBlock
      V_30_SetBlockProtection: start-on-event=SetBlockProtection, operation=PAdmin_Rte_NvmBlock_SrlComInput_ElecIntData.SetBlockProtection
      V_31_GetErrorStatus: start-on-event=GetErrorStatus, operation=PS_NVM_BLOCK_SER_TUNINGSELECT.GetErrorStatus
      V_31_SetRamBlockStatus: start-on-event=SetRamBlockStatus, operation=PS_NVM_BLOCK_SER_TUNINGSELECT.SetRamBlockStatus
      V_31_ReadBlock: start-on-event=ReadBlock, operation=PS_NVM_BLOCK_SER_TUNINGSELECT.ReadBlock
      V_31_WriteBlock: start-on-event=WriteBlock, operation=PS_NVM_BLOCK_SER_TUNINGSELECT.WriteBlock
      V_31_RestoreBlockDefaults: start-on-event=RestoreBlockDefaults, operation=PS_NVM_BLOCK_SER_TUNINGSELECT.RestoreBlockDefaults
      V_31_InvalidateNvBlock: start-on-event=InvalidateNvBlock, operation=PS_NVM_BLOCK_SER_TUNINGSELECT.InvalidateNvBlock
      V_31_EraseBlock: start-on-event=EraseBlock, operation=PS_NVM_BLOCK_SER_TUNINGSELECT.EraseBlock
      V_31_SetBlockProtection: start-on-event=SetBlockProtection, operation=PAdmin_NVM_BLOCK_SER_TUNINGSELECT.SetBlockProtection
      V_33_GetErrorStatus: start-on-event=GetErrorStatus, operation=PS_Rte_NvmBlock_CmMtrCurr_ShCurrCal.GetErrorStatus
      V_33_SetRamBlockStatus: start-on-event=SetRamBlockStatus, operation=PS_Rte_NvmBlock_CmMtrCurr_ShCurrCal.SetRamBlockStatus
      V_33_ReadBlock: start-on-event=ReadBlock, operation=PS_Rte_NvmBlock_CmMtrCurr_ShCurrCal.ReadBlock
      V_33_WriteBlock: start-on-event=WriteBlock, operation=PS_Rte_NvmBlock_CmMtrCurr_ShCurrCal.WriteBlock
      V_33_InvalidateNvBlock: start-on-event=InvalidateNvBlock, operation=PS_Rte_NvmBlock_CmMtrCurr_ShCurrCal.InvalidateNvBlock
      V_33_EraseBlock: start-on-event=EraseBlock, operation=PS_Rte_NvmBlock_CmMtrCurr_ShCurrCal.EraseBlock
      V_33_SetBlockProtection: start-on-event=SetBlockProtection, operation=PAdmin_Rte_NvmBlock_CmMtrCurr_ShCurrCal.SetBlockProtection
      V_34_GetErrorStatus: start-on-event=GetErrorStatus, operation=PS_Rte_NvmBlock_TrqCanc_CogTrqCal.GetErrorStatus
      V_34_SetRamBlockStatus: start-on-event=SetRamBlockStatus, operation=PS_Rte_NvmBlock_TrqCanc_CogTrqCal.SetRamBlockStatus
      V_34_ReadBlock: start-on-event=ReadBlock, operation=PS_Rte_NvmBlock_TrqCanc_CogTrqCal.ReadBlock
      V_34_WriteBlock: start-on-event=WriteBlock, operation=PS_Rte_NvmBlock_TrqCanc_CogTrqCal.WriteBlock
      V_34_InvalidateNvBlock: start-on-event=InvalidateNvBlock, operation=PS_Rte_NvmBlock_TrqCanc_CogTrqCal.InvalidateNvBlock
      V_34_EraseBlock: start-on-event=EraseBlock, operation=PS_Rte_NvmBlock_TrqCanc_CogTrqCal.EraseBlock
      V_34_SetBlockProtection: start-on-event=SetBlockProtection, operation=PAdmin_Rte_NvmBlock_TrqCanc_CogTrqCal.SetBlockProtection
      V_35_GetErrorStatus: start-on-event=GetErrorStatus, operation=PS_Rte_NvmBlock_TrqCanc_CogTrqRplComp.GetErrorStatus
      V_35_SetRamBlockStatus: start-on-event=SetRamBlockStatus, operation=PS_Rte_NvmBlock_TrqCanc_CogTrqRplComp.SetRamBlockStatus
      V_35_ReadBlock: start-on-event=ReadBlock, operation=PS_Rte_NvmBlock_TrqCanc_CogTrqRplComp.ReadBlock
      V_35_WriteBlock: start-on-event=WriteBlock, operation=PS_Rte_NvmBlock_TrqCanc_CogTrqRplComp.WriteBlock
      V_35_InvalidateNvBlock: start-on-event=InvalidateNvBlock, operation=PS_Rte_NvmBlock_TrqCanc_CogTrqRplComp.InvalidateNvBlock
      V_35_EraseBlock: start-on-event=EraseBlock, operation=PS_Rte_NvmBlock_TrqCanc_CogTrqRplComp.EraseBlock
      V_35_SetBlockProtection: start-on-event=SetBlockProtection, operation=PAdmin_Rte_NvmBlock_TrqCanc_CogTrqRplComp.SetBlockProtection
      V_38_GetErrorStatus: start-on-event=GetErrorStatus, operation=PS_Rte_NvmBlock_LrnEOT_LearnedEOT.GetErrorStatus
      V_38_SetRamBlockStatus: start-on-event=SetRamBlockStatus, operation=PS_Rte_NvmBlock_LrnEOT_LearnedEOT.SetRamBlockStatus
      V_38_ReadBlock: start-on-event=ReadBlock, operation=PS_Rte_NvmBlock_LrnEOT_LearnedEOT.ReadBlock
      V_38_WriteBlock: start-on-event=WriteBlock, operation=PS_Rte_NvmBlock_LrnEOT_LearnedEOT.WriteBlock
      V_38_InvalidateNvBlock: start-on-event=InvalidateNvBlock, operation=PS_Rte_NvmBlock_LrnEOT_LearnedEOT.InvalidateNvBlock
      V_38_EraseBlock: start-on-event=EraseBlock, operation=PS_Rte_NvmBlock_LrnEOT_LearnedEOT.EraseBlock
      V_38_SetBlockProtection: start-on-event=SetBlockProtection, operation=PAdmin_Rte_NvmBlock_LrnEOT_LearnedEOT.SetBlockProtection
      V_39_GetErrorStatus: start-on-event=GetErrorStatus, operation=PS_Rte_NvmBlock_AvgFricLrn_AvgFricLrnData.GetErrorStatus
      V_39_SetRamBlockStatus: start-on-event=SetRamBlockStatus, operation=PS_Rte_NvmBlock_AvgFricLrn_AvgFricLrnData.SetRamBlockStatus
      V_39_ReadBlock: start-on-event=ReadBlock, operation=PS_Rte_NvmBlock_AvgFricLrn_AvgFricLrnData.ReadBlock
      V_39_WriteBlock: start-on-event=WriteBlock, operation=PS_Rte_NvmBlock_AvgFricLrn_AvgFricLrnData.WriteBlock
      V_39_InvalidateNvBlock: start-on-event=InvalidateNvBlock, operation=PS_Rte_NvmBlock_AvgFricLrn_AvgFricLrnData.InvalidateNvBlock
      V_39_EraseBlock: start-on-event=EraseBlock, operation=PS_Rte_NvmBlock_AvgFricLrn_AvgFricLrnData.EraseBlock
      V_39_SetBlockProtection: start-on-event=SetBlockProtection, operation=PAdmin_Rte_NvmBlock_AvgFricLrn_AvgFricLrnData.SetBlockProtection
      V_40_GetErrorStatus: start-on-event=GetErrorStatus, operation=PS_Rte_NvmBlock_CmMtrCurr_CurrTempOffset.GetErrorStatus
      V_40_SetRamBlockStatus: start-on-event=SetRamBlockStatus, operation=PS_Rte_NvmBlock_CmMtrCurr_CurrTempOffset.SetRamBlockStatus
      V_40_ReadBlock: start-on-event=ReadBlock, operation=PS_Rte_NvmBlock_CmMtrCurr_CurrTempOffset.ReadBlock
      V_40_WriteBlock: start-on-event=WriteBlock, operation=PS_Rte_NvmBlock_CmMtrCurr_CurrTempOffset.WriteBlock
      V_40_InvalidateNvBlock: start-on-event=InvalidateNvBlock, operation=PS_Rte_NvmBlock_CmMtrCurr_CurrTempOffset.InvalidateNvBlock
      V_40_EraseBlock: start-on-event=EraseBlock, operation=PS_Rte_NvmBlock_CmMtrCurr_CurrTempOffset.EraseBlock
      V_40_SetBlockProtection: start-on-event=SetBlockProtection, operation=PAdmin_Rte_NvmBlock_CmMtrCurr_CurrTempOffset.SetBlockProtection
      V_42_GetErrorStatus: start-on-event=GetErrorStatus, operation=PS_Rte_NvmBlock_FaultLog_FaultLog.GetErrorStatus
      V_42_SetRamBlockStatus: start-on-event=SetRamBlockStatus, operation=PS_Rte_NvmBlock_FaultLog_FaultLog.SetRamBlockStatus
      V_42_ReadBlock: start-on-event=ReadBlock, operation=PS_Rte_NvmBlock_FaultLog_FaultLog.ReadBlock
      V_42_WriteBlock: start-on-event=WriteBlock, operation=PS_Rte_NvmBlock_FaultLog_FaultLog.WriteBlock
      V_42_InvalidateNvBlock: start-on-event=InvalidateNvBlock, operation=PS_Rte_NvmBlock_FaultLog_FaultLog.InvalidateNvBlock
      V_42_EraseBlock: start-on-event=EraseBlock, operation=PS_Rte_NvmBlock_FaultLog_FaultLog.EraseBlock
      V_42_SetBlockProtection: start-on-event=SetBlockProtection, operation=PAdmin_Rte_NvmBlock_FaultLog_FaultLog.SetBlockProtection
      V_44_GetErrorStatus: start-on-event=GetErrorStatus, operation=PS_Rte_NvmBlock_SrlComInput_ShutdownTimeData.GetErrorStatus
      V_44_SetRamBlockStatus: start-on-event=SetRamBlockStatus, operation=PS_Rte_NvmBlock_SrlComInput_ShutdownTimeData.SetRamBlockStatus
      V_44_ReadBlock: start-on-event=ReadBlock, operation=PS_Rte_NvmBlock_SrlComInput_ShutdownTimeData.ReadBlock
      V_44_WriteBlock: start-on-event=WriteBlock, operation=PS_Rte_NvmBlock_SrlComInput_ShutdownTimeData.WriteBlock
      V_44_InvalidateNvBlock: start-on-event=InvalidateNvBlock, operation=PS_Rte_NvmBlock_SrlComInput_ShutdownTimeData.InvalidateNvBlock
      V_44_EraseBlock: start-on-event=EraseBlock, operation=PS_Rte_NvmBlock_SrlComInput_ShutdownTimeData.EraseBlock
      V_44_SetBlockProtection: start-on-event=SetBlockProtection, operation=PAdmin_Rte_NvmBlock_SrlComInput_ShutdownTimeData.SetBlockProtection
      V_46_GetErrorStatus: start-on-event=GetErrorStatus, operation=PS_Rte_NvmBlock_AbsHwPos_EOLVehCntrOffset.GetErrorStatus
      V_46_SetRamBlockStatus: start-on-event=SetRamBlockStatus, operation=PS_Rte_NvmBlock_AbsHwPos_EOLVehCntrOffset.SetRamBlockStatus
      V_46_ReadBlock: start-on-event=ReadBlock, operation=PS_Rte_NvmBlock_AbsHwPos_EOLVehCntrOffset.ReadBlock
      V_46_WriteBlock: start-on-event=WriteBlock, operation=PS_Rte_NvmBlock_AbsHwPos_EOLVehCntrOffset.WriteBlock
      V_46_InvalidateNvBlock: start-on-event=InvalidateNvBlock, operation=PS_Rte_NvmBlock_AbsHwPos_EOLVehCntrOffset.InvalidateNvBlock
      V_46_EraseBlock: start-on-event=EraseBlock, operation=PS_Rte_NvmBlock_AbsHwPos_EOLVehCntrOffset.EraseBlock
      V_46_SetBlockProtection: start-on-event=SetBlockProtection, operation=PAdmin_Rte_NvmBlock_AbsHwPos_EOLVehCntrOffset.SetBlockProtection
      V_47_GetErrorStatus: start-on-event=GetErrorStatus, operation=PS_Rte_NvmBlock_HwTqCorrln_HwTqCorrlnCh1CMCLPFSvData.GetErrorStatus
      V_47_SetRamBlockStatus: start-on-event=SetRamBlockStatus, operation=PS_Rte_NvmBlock_HwTqCorrln_HwTqCorrlnCh1CMCLPFSvData.SetRamBlockStatus
      V_47_ReadBlock: start-on-event=ReadBlock, operation=PS_Rte_NvmBlock_HwTqCorrln_HwTqCorrlnCh1CMCLPFSvData.ReadBlock
      V_47_WriteBlock: start-on-event=WriteBlock, operation=PS_Rte_NvmBlock_HwTqCorrln_HwTqCorrlnCh1CMCLPFSvData.WriteBlock
      V_47_InvalidateNvBlock: start-on-event=InvalidateNvBlock, operation=PS_Rte_NvmBlock_HwTqCorrln_HwTqCorrlnCh1CMCLPFSvData.InvalidateNvBlock
      V_47_EraseBlock: start-on-event=EraseBlock, operation=PS_Rte_NvmBlock_HwTqCorrln_HwTqCorrlnCh1CMCLPFSvData.EraseBlock
      V_47_SetBlockProtection: start-on-event=SetBlockProtection, operation=PAdmin_Rte_NvmBlock_HwTqCorrln_HwTqCorrlnCh1CMCLPFSvData.SetBlockProtection
      V_49_GetErrorStatus: start-on-event=GetErrorStatus, operation=PS_NVM_BLOCK_SER_POWERPACKCONFIG.GetErrorStatus
      V_49_SetRamBlockStatus: start-on-event=SetRamBlockStatus, operation=PS_NVM_BLOCK_SER_POWERPACKCONFIG.SetRamBlockStatus
      V_49_ReadBlock: start-on-event=ReadBlock, operation=PS_NVM_BLOCK_SER_POWERPACKCONFIG.ReadBlock
      V_49_WriteBlock: start-on-event=WriteBlock, operation=PS_NVM_BLOCK_SER_POWERPACKCONFIG.WriteBlock
      V_49_RestoreBlockDefaults: start-on-event=RestoreBlockDefaults, operation=PS_NVM_BLOCK_SER_POWERPACKCONFIG.RestoreBlockDefaults
      V_49_InvalidateNvBlock: start-on-event=InvalidateNvBlock, operation=PS_NVM_BLOCK_SER_POWERPACKCONFIG.InvalidateNvBlock
      V_49_EraseBlock: start-on-event=EraseBlock, operation=PS_NVM_BLOCK_SER_POWERPACKCONFIG.EraseBlock
      V_49_SetBlockProtection: start-on-event=SetBlockProtection, operation=PAdmin_NVM_BLOCK_SER_POWERPACKCONFIG.SetBlockProtection
      V_51_GetErrorStatus: start-on-event=GetErrorStatus, operation=PS_Rte_NvmBlock_HwTqArbn_HwTqArbnEOLCh1OffsetTrimData.GetErrorStatus
      V_51_SetRamBlockStatus: start-on-event=SetRamBlockStatus, operation=PS_Rte_NvmBlock_HwTqArbn_HwTqArbnEOLCh1OffsetTrimData.SetRamBlockStatus
      V_51_ReadBlock: start-on-event=ReadBlock, operation=PS_Rte_NvmBlock_HwTqArbn_HwTqArbnEOLCh1OffsetTrimData.ReadBlock
      V_51_WriteBlock: start-on-event=WriteBlock, operation=PS_Rte_NvmBlock_HwTqArbn_HwTqArbnEOLCh1OffsetTrimData.WriteBlock
      V_51_InvalidateNvBlock: start-on-event=InvalidateNvBlock, operation=PS_Rte_NvmBlock_HwTqArbn_HwTqArbnEOLCh1OffsetTrimData.InvalidateNvBlock
      V_51_EraseBlock: start-on-event=EraseBlock, operation=PS_Rte_NvmBlock_HwTqArbn_HwTqArbnEOLCh1OffsetTrimData.EraseBlock
      V_51_SetBlockProtection: start-on-event=SetBlockProtection, operation=PAdmin_Rte_NvmBlock_HwTqArbn_HwTqArbnEOLCh1OffsetTrimData.SetBlockProtection
      V_52_GetErrorStatus: start-on-event=GetErrorStatus, operation=PS_Rte_NvmBlock_TrqCmdScl_TorqueCmdSF_Uls_f32.GetErrorStatus
      V_52_SetRamBlockStatus: start-on-event=SetRamBlockStatus, operation=PS_Rte_NvmBlock_TrqCmdScl_TorqueCmdSF_Uls_f32.SetRamBlockStatus
      V_52_ReadBlock: start-on-event=ReadBlock, operation=PS_Rte_NvmBlock_TrqCmdScl_TorqueCmdSF_Uls_f32.ReadBlock
      V_52_WriteBlock: start-on-event=WriteBlock, operation=PS_Rte_NvmBlock_TrqCmdScl_TorqueCmdSF_Uls_f32.WriteBlock
      V_52_InvalidateNvBlock: start-on-event=InvalidateNvBlock, operation=PS_Rte_NvmBlock_TrqCmdScl_TorqueCmdSF_Uls_f32.InvalidateNvBlock
      V_52_EraseBlock: start-on-event=EraseBlock, operation=PS_Rte_NvmBlock_TrqCmdScl_TorqueCmdSF_Uls_f32.EraseBlock
      V_52_SetBlockProtection: start-on-event=SetBlockProtection, operation=PAdmin_Rte_NvmBlock_TrqCmdScl_TorqueCmdSF_Uls_f32.SetBlockProtection
      V_53_GetErrorStatus: start-on-event=GetErrorStatus, operation=PS_Rte_NvmBlock_PsaAgArbn_PsaAgArbnLrndOffsData.GetErrorStatus
      V_53_SetRamBlockStatus: start-on-event=SetRamBlockStatus, operation=PS_Rte_NvmBlock_PsaAgArbn_PsaAgArbnLrndOffsData.SetRamBlockStatus
      V_53_ReadBlock: start-on-event=ReadBlock, operation=PS_Rte_NvmBlock_PsaAgArbn_PsaAgArbnLrndOffsData.ReadBlock
      V_53_WriteBlock: start-on-event=WriteBlock, operation=PS_Rte_NvmBlock_PsaAgArbn_PsaAgArbnLrndOffsData.WriteBlock
      V_53_InvalidateNvBlock: start-on-event=InvalidateNvBlock, operation=PS_Rte_NvmBlock_PsaAgArbn_PsaAgArbnLrndOffsData.InvalidateNvBlock
      V_53_EraseBlock: start-on-event=EraseBlock, operation=PS_Rte_NvmBlock_PsaAgArbn_PsaAgArbnLrndOffsData.EraseBlock
      V_53_SetBlockProtection: start-on-event=SetBlockProtection, operation=PAdmin_Rte_NvmBlock_PsaAgArbn_PsaAgArbnLrndOffsData.SetBlockProtection
      V_54_GetErrorStatus: start-on-event=GetErrorStatus, operation=PS_Rte_NvmBlock_ActivePull_PullCmpLTComp_HwNm_f32.GetErrorStatus
      V_54_SetRamBlockStatus: start-on-event=SetRamBlockStatus, operation=PS_Rte_NvmBlock_ActivePull_PullCmpLTComp_HwNm_f32.SetRamBlockStatus
      V_54_ReadBlock: start-on-event=ReadBlock, operation=PS_Rte_NvmBlock_ActivePull_PullCmpLTComp_HwNm_f32.ReadBlock
      V_54_WriteBlock: start-on-event=WriteBlock, operation=PS_Rte_NvmBlock_ActivePull_PullCmpLTComp_HwNm_f32.WriteBlock
      V_54_InvalidateNvBlock: start-on-event=InvalidateNvBlock, operation=PS_Rte_NvmBlock_ActivePull_PullCmpLTComp_HwNm_f32.InvalidateNvBlock
      V_54_EraseBlock: start-on-event=EraseBlock, operation=PS_Rte_NvmBlock_ActivePull_PullCmpLTComp_HwNm_f32.EraseBlock
      V_54_SetBlockProtection: start-on-event=SetBlockProtection, operation=PAdmin_Rte_NvmBlock_ActivePull_PullCmpLTComp_HwNm_f32.SetBlockProtection
    port-api-option port=PS_NVM_BLOCK_DIAGMGR_NTCSTRG:
      port-arg-values:
        integer literal NvM_ServiceBlockId_2: type=NvM_BlockIdType, value=2
    port-api-option port=PS_ConfigBlock:
      port-arg-values:
        integer literal NvM_ServiceBlockId_1: type=NvM_BlockIdType, value=1
    port-api-option port=PS_NVM_BLOCK_EPSDEFEATS:
      port-arg-values:
        integer literal NvM_ServiceBlockId_3: type=NvM_BlockIdType, value=3
    port-api-option port=PS_Rte_NvmBlock_StaMd_TypeHRamBuffer:
      port-arg-values:
        integer literal NvM_ServiceBlockId_5: type=NvM_BlockIdType, value=5
    port-api-option port=PS_Rte_NvmBlock_Polarity_Polarity_Cnt_Str:
      port-arg-values:
        integer literal NvM_ServiceBlockId_6: type=NvM_BlockIdType, value=6
    port-api-option port=PS_Rte_NvmBlock_CurrParamComp_EOLNomMtrParam:
      port-arg-values:
        integer literal NvM_ServiceBlockId_7: type=NvM_BlockIdType, value=7
    port-api-option port=PS_NVM_BLOCK_CMS_NXTRMEC:
      port-arg-values:
        integer literal NvM_ServiceBlockId_8: type=NvM_BlockIdType, value=8
    port-api-option port=PS_NVM_BLOCK_CMS_ECUSRLNUM:
      port-arg-values:
        integer literal NvM_ServiceBlockId_9: type=NvM_BlockIdType, value=9
    port-api-option port=PS_NVM_BLOCK_CMS_EPSSRLNUM:
      port-arg-values:
        integer literal NvM_ServiceBlockId_10: type=NvM_BlockIdType, value=10
    port-api-option port=PS_NVM_BLOCK_CMS_ECUHWPN:
      port-arg-values:
        integer literal NvM_ServiceBlockId_11: type=NvM_BlockIdType, value=11
    port-api-option port=PS_NVM_BLOCK_CMS_NXTRMANUFSCRATCHPAD:
      port-arg-values:
        integer literal NvM_ServiceBlockId_12: type=NvM_BlockIdType, value=12
    port-api-option port=PS_NVM_BLOCK_CMS_IGNCNTR:
      port-arg-values:
        integer literal NvM_ServiceBlockId_13: type=NvM_BlockIdType, value=13
    port-api-option port=PS_Rte_NvmBlock_StaMd_CloseCheckData:
      port-arg-values:
        integer literal NvM_ServiceBlockId_14: type=NvM_BlockIdType, value=14
    port-api-option port=PS_Rte_NvmBlock_Sa_DigMSB_DigMSBEOLData:
      port-arg-values:
        integer literal NvM_ServiceBlockId_15: type=NvM_BlockIdType, value=15
    port-api-option port=PS_NVM_BLOCK_DIAGMGR_BLACKBOX:
      port-arg-values:
        integer literal NvM_ServiceBlockId_16: type=NvM_BlockIdType, value=16
    port-api-option port=PS_Rte_NvmBlock_BatteryVoltage_OvervoltageData:
      port-arg-values:
        integer literal NvM_ServiceBlockId_17: type=NvM_BlockIdType, value=17
    port-api-option port=PS_Rte_NvmBlock_ThrmlDutyCycle_ThrmlDutyCycle_FltStVal:
      port-arg-values:
        integer literal NvM_ServiceBlockId_18: type=NvM_BlockIdType, value=18
    port-api-option port=PS_NVM_BLOCK_DIAGMGR_LATCHCNTRS:
      port-arg-values:
        integer literal NvM_ServiceBlockId_19: type=NvM_BlockIdType, value=19
    port-api-option port=PS_NVM_BLOCK_SER_FLASHLOGA:
      port-arg-values:
        integer literal NvM_ServiceBlockId_20: type=NvM_BlockIdType, value=20
    port-api-option port=PS_NVM_BLOCK_SER_FLASHLOGB:
      port-arg-values:
        integer literal NvM_ServiceBlockId_21: type=NvM_BlockIdType, value=21
    port-api-option port=PS_NVM_BLOCK_SER_SECURITYVIOLATION:
      port-arg-values:
        integer literal NvM_ServiceBlockId_22: type=NvM_BlockIdType, value=22
    port-api-option port=PS_Rte_NvmBlock_VehDyn_MotPosReset:
      port-arg-values:
        integer literal NvM_ServiceBlockId_23: type=NvM_BlockIdType, value=23
    port-api-option port=PS_NVM_BLOCK_SER_AUTHENTICATIONZONE:
      port-arg-values:
        integer literal NvM_ServiceBlockId_24: type=NvM_BlockIdType, value=24
    port-api-option port=PS_NVM_BLOCK_SER_ECUMANUFACTURINGDATE:
      port-arg-values:
        integer literal NvM_ServiceBlockId_25: type=NvM_BlockIdType, value=25
    port-api-option port=PS_NVM_BLOCK_SER_EMCSTANDARDIZATIONLABEL:
      port-arg-values:
        integer literal NvM_ServiceBlockId_26: type=NvM_BlockIdType, value=26
    port-api-option port=PS_NVM_BLOCK_SER_CUSTECUSRLNUM:
      port-arg-values:
        integer literal NvM_ServiceBlockId_27: type=NvM_BlockIdType, value=27
    port-api-option port=PS_NVM_BLOCK_SER_SECURITYKEY:
      port-arg-values:
        integer literal NvM_ServiceBlockId_28: type=NvM_BlockIdType, value=28
    port-api-option port=PS_Rte_NvmBlock_SrlComInput_VVHTYPEData:
      port-arg-values:
        integer literal NvM_ServiceBlockId_29: type=NvM_BlockIdType, value=29
    port-api-option port=PS_Rte_NvmBlock_SrlComInput_ElecIntData:
      port-arg-values:
        integer literal NvM_ServiceBlockId_30: type=NvM_BlockIdType, value=30
    port-api-option port=PS_NVM_BLOCK_SER_TUNINGSELECT:
      port-arg-values:
        integer literal NvM_ServiceBlockId_31: type=NvM_BlockIdType, value=31
    port-api-option port=PS_Rte_NvmBlock_CmMtrCurr_ShCurrCal:
      port-arg-values:
        integer literal NvM_ServiceBlockId_33: type=NvM_BlockIdType, value=33
    port-api-option port=PS_Rte_NvmBlock_TrqCanc_CogTrqCal:
      port-arg-values:
        integer literal NvM_ServiceBlockId_34: type=NvM_BlockIdType, value=34
    port-api-option port=PS_Rte_NvmBlock_TrqCanc_CogTrqRplComp:
      port-arg-values:
        integer literal NvM_ServiceBlockId_35: type=NvM_BlockIdType, value=35
    port-api-option port=PS_Rte_NvmBlock_LrnEOT_LearnedEOT:
      port-arg-values:
        integer literal NvM_ServiceBlockId_38: type=NvM_BlockIdType, value=38
    port-api-option port=PS_Rte_NvmBlock_AvgFricLrn_AvgFricLrnData:
      port-arg-values:
        integer literal NvM_ServiceBlockId_39: type=NvM_BlockIdType, value=39
    port-api-option port=PS_Rte_NvmBlock_CmMtrCurr_CurrTempOffset:
      port-arg-values:
        integer literal NvM_ServiceBlockId_40: type=NvM_BlockIdType, value=40
    port-api-option port=PS_Rte_NvmBlock_FaultLog_FaultLog:
      port-arg-values:
        integer literal NvM_ServiceBlockId_42: type=NvM_BlockIdType, value=42
    port-api-option port=PS_Rte_NvmBlock_SrlComInput_ShutdownTimeData:
      port-arg-values:
        integer literal NvM_ServiceBlockId_44: type=NvM_BlockIdType, value=44
    port-api-option port=PS_Rte_NvmBlock_AbsHwPos_EOLVehCntrOffset:
      port-arg-values:
        integer literal NvM_ServiceBlockId_46: type=NvM_BlockIdType, value=46
    port-api-option port=PS_Rte_NvmBlock_HwTqCorrln_HwTqCorrlnCh1CMCLPFSvData:
      port-arg-values:
        integer literal NvM_ServiceBlockId_47: type=NvM_BlockIdType, value=47
    port-api-option port=PS_NVM_BLOCK_SER_POWERPACKCONFIG:
      port-arg-values:
        integer literal NvM_ServiceBlockId_49: type=NvM_BlockIdType, value=49
    port-api-option port=PS_Rte_NvmBlock_HwTqArbn_HwTqArbnEOLCh1OffsetTrimData:
      port-arg-values:
        integer literal NvM_ServiceBlockId_51: type=NvM_BlockIdType, value=51
    port-api-option port=PS_Rte_NvmBlock_TrqCmdScl_TorqueCmdSF_Uls_f32:
      port-arg-values:
        integer literal NvM_ServiceBlockId_52: type=NvM_BlockIdType, value=52
    port-api-option port=PS_Rte_NvmBlock_PsaAgArbn_PsaAgArbnLrndOffsData:
      port-arg-values:
        integer literal NvM_ServiceBlockId_53: type=NvM_BlockIdType, value=53
    port-api-option port=PS_Rte_NvmBlock_ActivePull_PullCmpLTComp_HwNm_f32:
      port-arg-values:
        integer literal NvM_ServiceBlockId_54: type=NvM_BlockIdType, value=54
    port-api-option port=PAdmin_NVM_BLOCK_DIAGMGR_NTCSTRG:
      port-arg-values:
        integer literal NvM_AdminBlockId_2: type=NvM_BlockIdType, value=2
    port-api-option port=PAdmin_ConfigBlock:
      port-arg-values:
        integer literal NvM_AdminBlockId_1: type=NvM_BlockIdType, value=1
    port-api-option port=PAdmin_NVM_BLOCK_EPSDEFEATS:
      port-arg-values:
        integer literal NvM_AdminBlockId_3: type=NvM_BlockIdType, value=3
    port-api-option port=PAdmin_Rte_NvmBlock_StaMd_TypeHRamBuffer:
      port-arg-values:
        integer literal NvM_AdminBlockId_5: type=NvM_BlockIdType, value=5
    port-api-option port=PAdmin_Rte_NvmBlock_Polarity_Polarity_Cnt_Str:
      port-arg-values:
        integer literal NvM_AdminBlockId_6: type=NvM_BlockIdType, value=6
    port-api-option port=PAdmin_Rte_NvmBlock_CurrParamComp_EOLNomMtrParam:
      port-arg-values:
        integer literal NvM_AdminBlockId_7: type=NvM_BlockIdType, value=7
    port-api-option port=PAdmin_NVM_BLOCK_CMS_NXTRMEC:
      port-arg-values:
        integer literal NvM_AdminBlockId_8: type=NvM_BlockIdType, value=8
    port-api-option port=PAdmin_NVM_BLOCK_CMS_ECUSRLNUM:
      port-arg-values:
        integer literal NvM_AdminBlockId_9: type=NvM_BlockIdType, value=9
    port-api-option port=PAdmin_NVM_BLOCK_CMS_EPSSRLNUM:
      port-arg-values:
        integer literal NvM_AdminBlockId_10: type=NvM_BlockIdType, value=10
    port-api-option port=PAdmin_NVM_BLOCK_CMS_ECUHWPN:
      port-arg-values:
        integer literal NvM_AdminBlockId_11: type=NvM_BlockIdType, value=11
    port-api-option port=PAdmin_NVM_BLOCK_CMS_NXTRMANUFSCRATCHPAD:
      port-arg-values:
        integer literal NvM_AdminBlockId_12: type=NvM_BlockIdType, value=12
    port-api-option port=PAdmin_NVM_BLOCK_CMS_IGNCNTR:
      port-arg-values:
        integer literal NvM_AdminBlockId_13: type=NvM_BlockIdType, value=13
    port-api-option port=PAdmin_Rte_NvmBlock_StaMd_CloseCheckData:
      port-arg-values:
        integer literal NvM_AdminBlockId_14: type=NvM_BlockIdType, value=14
    port-api-option port=PAdmin_Rte_NvmBlock_Sa_DigMSB_DigMSBEOLData:
      port-arg-values:
        integer literal NvM_AdminBlockId_15: type=NvM_BlockIdType, value=15
    port-api-option port=PAdmin_NVM_BLOCK_DIAGMGR_BLACKBOX:
      port-arg-values:
        integer literal NvM_AdminBlockId_16: type=NvM_BlockIdType, value=16
    port-api-option port=PAdmin_Rte_NvmBlock_BatteryVoltage_OvervoltageData:
      port-arg-values:
        integer literal NvM_AdminBlockId_17: type=NvM_BlockIdType, value=17
    port-api-option port=PAdmin_Rte_NvmBlock_ThrmlDutyCycle_ThrmlDutyCycle_FltStVal:
      port-arg-values:
        integer literal NvM_AdminBlockId_18: type=NvM_BlockIdType, value=18
    port-api-option port=PAdmin_NVM_BLOCK_DIAGMGR_LATCHCNTRS:
      port-arg-values:
        integer literal NvM_AdminBlockId_19: type=NvM_BlockIdType, value=19
    port-api-option port=PAdmin_NVM_BLOCK_SER_FLASHLOGA:
      port-arg-values:
        integer literal NvM_AdminBlockId_20: type=NvM_BlockIdType, value=20
    port-api-option port=PAdmin_NVM_BLOCK_SER_FLASHLOGB:
      port-arg-values:
        integer literal NvM_AdminBlockId_21: type=NvM_BlockIdType, value=21
    port-api-option port=PAdmin_NVM_BLOCK_SER_SECURITYVIOLATION:
      port-arg-values:
        integer literal NvM_AdminBlockId_22: type=NvM_BlockIdType, value=22
    port-api-option port=PAdmin_Rte_NvmBlock_VehDyn_MotPosReset:
      port-arg-values:
        integer literal NvM_AdminBlockId_23: type=NvM_BlockIdType, value=23
    port-api-option port=PAdmin_NVM_BLOCK_SER_AUTHENTICATIONZONE:
      port-arg-values:
        integer literal NvM_AdminBlockId_24: type=NvM_BlockIdType, value=24
    port-api-option port=PAdmin_NVM_BLOCK_SER_ECUMANUFACTURINGDATE:
      port-arg-values:
        integer literal NvM_AdminBlockId_25: type=NvM_BlockIdType, value=25
    port-api-option port=PAdmin_NVM_BLOCK_SER_EMCSTANDARDIZATIONLABEL:
      port-arg-values:
        integer literal NvM_AdminBlockId_26: type=NvM_BlockIdType, value=26
    port-api-option port=PAdmin_NVM_BLOCK_SER_CUSTECUSRLNUM:
      port-arg-values:
        integer literal NvM_AdminBlockId_27: type=NvM_BlockIdType, value=27
    port-api-option port=PAdmin_NVM_BLOCK_SER_SECURITYKEY:
      port-arg-values:
        integer literal NvM_AdminBlockId_28: type=NvM_BlockIdType, value=28
    port-api-option port=PAdmin_Rte_NvmBlock_SrlComInput_VVHTYPEData:
      port-arg-values:
        integer literal NvM_AdminBlockId_29: type=NvM_BlockIdType, value=29
    port-api-option port=PAdmin_Rte_NvmBlock_SrlComInput_ElecIntData:
      port-arg-values:
        integer literal NvM_AdminBlockId_30: type=NvM_BlockIdType, value=30
    port-api-option port=PAdmin_NVM_BLOCK_SER_TUNINGSELECT:
      port-arg-values:
        integer literal NvM_AdminBlockId_31: type=NvM_BlockIdType, value=31
    port-api-option port=PAdmin_Rte_NvmBlock_CmMtrCurr_ShCurrCal:
      port-arg-values:
        integer literal NvM_AdminBlockId_33: type=NvM_BlockIdType, value=33
    port-api-option port=PAdmin_Rte_NvmBlock_TrqCanc_CogTrqCal:
      port-arg-values:
        integer literal NvM_AdminBlockId_34: type=NvM_BlockIdType, value=34
    port-api-option port=PAdmin_Rte_NvmBlock_TrqCanc_CogTrqRplComp:
      port-arg-values:
        integer literal NvM_AdminBlockId_35: type=NvM_BlockIdType, value=35
    port-api-option port=PAdmin_Rte_NvmBlock_LrnEOT_LearnedEOT:
      port-arg-values:
        integer literal NvM_AdminBlockId_38: type=NvM_BlockIdType, value=38
    port-api-option port=PAdmin_Rte_NvmBlock_AvgFricLrn_AvgFricLrnData:
      port-arg-values:
        integer literal NvM_AdminBlockId_39: type=NvM_BlockIdType, value=39
    port-api-option port=PAdmin_Rte_NvmBlock_CmMtrCurr_CurrTempOffset:
      port-arg-values:
        integer literal NvM_AdminBlockId_40: type=NvM_BlockIdType, value=40
    port-api-option port=PAdmin_Rte_NvmBlock_FaultLog_FaultLog:
      port-arg-values:
        integer literal NvM_AdminBlockId_42: type=NvM_BlockIdType, value=42
    port-api-option port=PAdmin_Rte_NvmBlock_SrlComInput_ShutdownTimeData:
      port-arg-values:
        integer literal NvM_AdminBlockId_44: type=NvM_BlockIdType, value=44
    port-api-option port=PAdmin_Rte_NvmBlock_AbsHwPos_EOLVehCntrOffset:
      port-arg-values:
        integer literal NvM_AdminBlockId_46: type=NvM_BlockIdType, value=46
    port-api-option port=PAdmin_Rte_NvmBlock_HwTqCorrln_HwTqCorrlnCh1CMCLPFSvData:
      port-arg-values:
        integer literal NvM_AdminBlockId_47: type=NvM_BlockIdType, value=47
    port-api-option port=PAdmin_NVM_BLOCK_SER_POWERPACKCONFIG:
      port-arg-values:
        integer literal NvM_AdminBlockId_49: type=NvM_BlockIdType, value=49
    port-api-option port=PAdmin_Rte_NvmBlock_HwTqArbn_HwTqArbnEOLCh1OffsetTrimData:
      port-arg-values:
        integer literal NvM_AdminBlockId_51: type=NvM_BlockIdType, value=51
    port-api-option port=PAdmin_Rte_NvmBlock_TrqCmdScl_TorqueCmdSF_Uls_f32:
      port-arg-values:
        integer literal NvM_AdminBlockId_52: type=NvM_BlockIdType, value=52
    port-api-option port=PAdmin_Rte_NvmBlock_PsaAgArbn_PsaAgArbnLrndOffsData:
      port-arg-values:
        integer literal NvM_AdminBlockId_53: type=NvM_BlockIdType, value=53
    port-api-option port=PAdmin_Rte_NvmBlock_ActivePull_PullCmpLTComp_HwNm_f32:
      port-arg-values:
        integer literal NvM_AdminBlockId_54: type=NvM_BlockIdType, value=54
    8 x runnable, all with can-be-invoked-concurrently=true:
      GetErrorStatus: symbol=NvM_GetErrorStatus
      SetRamBlockStatus: symbol=NvM_SetRamBlockStatus
      ReadBlock: symbol=NvM_ReadBlock
      WriteBlock: symbol=NvM_WriteBlock
      RestoreBlockDefaults: symbol=NvM_RestoreBlockDefaults
      InvalidateNvBlock: symbol=NvM_InvalidateNvBlock
      EraseBlock: symbol=NvM_EraseNvBlock
      SetBlockProtection: symbol=NvM_SetBlockProtection
package /PortInterface
  client server interface NvM_Administration: is-service=true
    operation SetBlockProtection
      arg ProtectionEnabled: type=Boolean, direction=IN
  client server interface NvM_AC3_SRBS_Srv: is-service=true  # NvmService_NvmApiConfigClass3 | Port Interface for NVRAM Blocks of Management Types "NATIVE" or "REDUNDANT" without default values.
    6 x operation:
      GetErrorStatus
        arg ErrorStatus: type=NvM_RequestResultType, direction=OUT
      SetRamBlockStatus
        arg RamBlockStatus: type=Boolean, direction=IN
      ReadBlock: possible-error=NvM_AC3_SRBS_Srv/E_NOT_OK
        arg DstPtr: type=NvM_DestPtr, direction=OUT
      WriteBlock: possible-error=NvM_AC3_SRBS_Srv/E_NOT_OK
        arg DstPtr: type=NvM_DestPtr, direction=IN
      EraseBlock: possible-error=NvM_AC3_SRBS_Srv/E_NOT_OK
      InvalidateNvBlock: possible-error=NvM_AC3_SRBS_Srv/E_NOT_OK
    error E_NOT_OK: error-code=1
  client server interface NvM_AC3_SRBS_Srv_Defs: is-service=true  # NvmService_NvmApiConfigClass3_HasRomDefaults | Port Interface for NVRAM Blocks of Management Types "NATIVE" or "REDUNDANT" with default values.
    7 x operation:
      GetErrorStatus
        arg ErrorStatus: type=NvM_RequestResultType, direction=OUT
      SetRamBlockStatus
        arg RamBlockStatus: type=Boolean, direction=IN
      ReadBlock: possible-error=NvM_AC3_SRBS_Srv_Defs/E_NOT_OK
        arg DstPtr: type=NvM_DestPtr, direction=OUT
      WriteBlock: possible-error=NvM_AC3_SRBS_Srv_Defs/E_NOT_OK
        arg DstPtr: type=NvM_DestPtr, direction=IN
      RestoreBlockDefaults: possible-error=NvM_AC3_SRBS_Srv_Defs/E_NOT_OK
        arg DstPtr: type=NvM_DestPtr, direction=OUT
      EraseBlock: possible-error=NvM_AC3_SRBS_Srv_Defs/E_NOT_OK
      InvalidateNvBlock: possible-error=NvM_AC3_SRBS_Srv_Defs/E_NOT_OK
    error E_NOT_OK: error-code=1
package /DataTypes
  integer type NvM_BlockIdType: lower-limit=1, upper-limit=32767  # It is the type to be used in the "Port Defined Arguments". According to the NVM API it must result in an uint16 data type; thus the upper limit does not correspond to the number of configured blocks. Therefore the this type is common to all NVM SWC Descriptions. The upper limit is the theoretical maximum number of NVRAM blocks, if NVM_DATASET_SELECTION_BITS equals to 1. (It cannot be 0 since block Id 1 is fixed to be a REDUNDANT NVRAM Block - it consists of two NV blocks)
  integer type NvM_RequestResultType: compu {0=NVM_REQ_OK, 1=NVM_REQ_NOT_OK, 2=NVM_REQ_PENDING, 3=NVM_REQ_INTEGRITY_FAILED, 4=NVM_REQ_BLOCK_SKIPPED, 5=NVM_REQ_NV_INVALIDATED}, lower-limit=0, upper-limit=5
  array type NvM_DestPtr  # DataPtr Type to be used by WriteBlock, ReadBlock and RestoreBlockDefaults operations. This type is used for all NVRAM blocks
    element NvM_DestPtr_BaseType: type=UInt8, max-number-of-elements=65535
