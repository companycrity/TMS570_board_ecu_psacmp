AUTOSAR XML (schema 3.0.1)
standard types defined: Boolean, UInt8, UInt16, UInt32
package /ComponentType
  internal behavior DemInternalBehavior: component=Dem
    timing event Timer_Dem_MainFunction: start-on-event=Dem_MainFunction, period=0.01
    334 x operation invoked event:
      OpEventDiagnosticMonito_52826b3e: start-on-event=SetEventStatus, operation=Event_CTC_0xD30808.SetEventStatus
      OpEventDiagnosticMonito_51c88e60: start-on-event=ResetEventStatus, operation=Event_CTC_0xD30808.ResetEventStatus
      OpEventDiagnosticMonito_2d9cd849: start-on-event=GetEventStatus, operation=Event_CTC_0xD30808.GetEventStatus
      OpEventDiagnosticMonito_c8171e22: start-on-event=GetEventFailed, operation=Event_CTC_0xD30808.GetEventFailed
      OpEventDiagnosticMonito_5e185e41: start-on-event=GetEventTested, operation=Event_CTC_0xD30808.GetEventTested
      OpEventDiagnosticMonito_4fdf47e0: start-on-event=GetDTCOfEvent, operation=Event_CTC_0xD30808.GetDTCOfEvent
      OpEventDiagnosticMonito_cbd6d252: start-on-event=GetFaultDetectionCounter, operation=Event_CTC_0xD30808.GetFaultDetectionCounter
      OpEventDiagnosticMonito_35e840e1: start-on-event=SetEventStatus, operation=Event_CTC_0xD31808.SetEventStatus
      OpEventDiagnosticMonito_b93876f7: start-on-event=ResetEventStatus, operation=Event_CTC_0xD31808.ResetEventStatus
      OpEventDiagnosticMonito_fbf6bacd: start-on-event=GetEventStatus, operation=Event_CTC_0xD31808.GetEventStatus
      OpEventDiagnosticMonito_217389db: start-on-event=GetEventFailed, operation=Event_CTC_0xD31808.GetEventFailed
      OpEventDiagnosticMonito_f55eb679: start-on-event=GetEventTested, operation=Event_CTC_0xD31808.GetEventTested
      OpEventDiagnosticMonito_549ee21e: start-on-event=GetDTCOfEvent, operation=Event_CTC_0xD31808.GetDTCOfEvent
      OpEventDiagnosticMonito_7175392b: start-on-event=GetFaultDetectionCounter, operation=Event_CTC_0xD31808.GetFaultDetectionCounter
      OpEventDiagnosticMonito_42ef7077: start-on-event=SetEventStatus, operation=Event_CTC_0xD31D08.SetEventStatus
      OpEventDiagnosticMonito_ce3f4661: start-on-event=ResetEventStatus, operation=Event_CTC_0xD31D08.ResetEventStatus
      OpEventDiagnosticMonito_8cf18a5b: start-on-event=GetEventStatus, operation=Event_CTC_0xD31D08.GetEventStatus
      OpEventDiagnosticMonito_5674b94d: start-on-event=GetEventFailed, operation=Event_CTC_0xD31D08.GetEventFailed
      OpEventDiagnosticMonito_825986ef: start-on-event=GetEventTested, operation=Event_CTC_0xD31D08.GetEventTested
      OpEventDiagnosticMonito_2399d288: start-on-event=GetDTCOfEvent, operation=Event_CTC_0xD31D08.GetDTCOfEvent
      OpEventDiagnosticMonito_067209bd: start-on-event=GetFaultDetectionCounter, operation=Event_CTC_0xD31D08.GetFaultDetectionCounter
      OpEventOperationCycleSe_d13956d3: start-on-event=SetOperationCycleState, operation=OpCycle_DEM_IGNITION.SetOperationCycleState
      OpEventOperationCycleSe_ebd06519: start-on-event=SetOperationCycleState, operation=OpCycle_DEM_OBD_DCY.SetOperationCycleState
      OpEventOperationCycleSe_9cd7558f: start-on-event=SetOperationCycleState, operation=OpCycle_DEM_POWER.SetOperationCycleState
      OpEventOperationCycleSe_05de0435: start-on-event=SetOperationCycleState, operation=OpCycle_DEM_WARMUP.SetOperationCycleState
      OpEventIndicatorStatusG_1495fc2f: start-on-event=GetIndicatorStatus, operation=IndStatus_ETATDA2.GetIndicatorStatus
      OpEventDiagnosticMonito_dbe621cd: start-on-event=SetEventStatus, operation=Event_CTC_0x563A8F.SetEventStatus
      OpEventDiagnosticMonito_573617db: start-on-event=ResetEventStatus, operation=Event_CTC_0x563A8F.ResetEventStatus
      OpEventDiagnosticMonito_15f8dbe1: start-on-event=GetEventStatus, operation=Event_CTC_0x563A8F.GetEventStatus
      OpEventDiagnosticMonito_cf7de8f7: start-on-event=GetEventFailed, operation=Event_CTC_0x563A8F.GetEventFailed
      OpEventDiagnosticMonito_1b50d755: start-on-event=GetEventTested, operation=Event_CTC_0x563A8F.GetEventTested
      OpEventDiagnosticMonito_ba908332: start-on-event=GetDTCOfEvent, operation=Event_CTC_0x563A8F.GetDTCOfEvent
      OpEventDiagnosticMonito_9f7b5807: start-on-event=GetFaultDetectionCounter, operation=Event_CTC_0x563A8F.GetFaultDetectionCounter
      OpEventDiagnosticMonito_ace1115b: start-on-event=SetEventStatus, operation=Event_CTC_0x540698.SetEventStatus
      OpEventDiagnosticMonito_2031274d: start-on-event=ResetEventStatus, operation=Event_CTC_0x540698.ResetEventStatus
      OpEventDiagnosticMonito_62ffeb77: start-on-event=GetEventStatus, operation=Event_CTC_0x540698.GetEventStatus
      OpEventDiagnosticMonito_b87ad861: start-on-event=GetEventFailed, operation=Event_CTC_0x540698.GetEventFailed
      OpEventDiagnosticMonito_6c57e7c3: start-on-event=GetEventTested, operation=Event_CTC_0x540698.GetEventTested
      OpEventDiagnosticMonito_cd97b3a4: start-on-event=GetDTCOfEvent, operation=Event_CTC_0x540698.GetDTCOfEvent
      OpEventDiagnosticMonito_e87c6891: start-on-event=GetFaultDetectionCounter, operation=Event_CTC_0x540698.GetFaultDetectionCounter
      OpEventDiagnosticMonito_328584f8: start-on-event=SetEventStatus, operation=Event_CTC_0x540B16.SetEventStatus
      OpEventDiagnosticMonito_be55b2ee: start-on-event=ResetEventStatus, operation=Event_CTC_0x540B16.ResetEventStatus
      OpEventDiagnosticMonito_fc9b7ed4: start-on-event=GetEventStatus, operation=Event_CTC_0x540B16.GetEventStatus
      OpEventDiagnosticMonito_261e4dc2: start-on-event=GetEventFailed, operation=Event_CTC_0x540B16.GetEventFailed
      OpEventDiagnosticMonito_f2337260: start-on-event=GetEventTested, operation=Event_CTC_0x540B16.GetEventTested
      OpEventDiagnosticMonito_53f32607: start-on-event=GetDTCOfEvent, operation=Event_CTC_0x540B16.GetDTCOfEvent
      OpEventDiagnosticMonito_7618fd32: start-on-event=GetFaultDetectionCounter, operation=Event_CTC_0x540B16.GetFaultDetectionCounter
      OpEventDiagnosticMonito_4582b46e: start-on-event=SetEventStatus, operation=Event_CTC_0x520901.SetEventStatus
      OpEventDiagnosticMonito_c9528278: start-on-event=ResetEventStatus, operation=Event_CTC_0x520901.ResetEventStatus
      OpEventDiagnosticMonito_8b9c4e42: start-on-event=GetEventStatus, operation=Event_CTC_0x520901.GetEventStatus
      OpEventDiagnosticMonito_51197d54: start-on-event=GetEventFailed, operation=Event_CTC_0x520901.GetEventFailed
      OpEventDiagnosticMonito_853442f6: start-on-event=GetEventTested, operation=Event_CTC_0x520901.GetEventTested
      OpEventDiagnosticMonito_24f41691: start-on-event=GetDTCOfEvent, operation=Event_CTC_0x520901.GetDTCOfEvent
      OpEventDiagnosticMonito_011fcda4: start-on-event=GetFaultDetectionCounter, operation=Event_CTC_0x520901.GetFaultDetectionCounter
      OpEventDiagnosticMonito_dc8be5d4: start-on-event=SetEventStatus, operation=Event_CTC_0xD00388.SetEventStatus
      OpEventDiagnosticMonito_505bd3c2: start-on-event=ResetEventStatus, operation=Event_CTC_0xD00388.ResetEventStatus
      OpEventDiagnosticMonito_12951ff8: start-on-event=GetEventStatus, operation=Event_CTC_0xD00388.GetEventStatus
      OpEventDiagnosticMonito_c8102cee: start-on-event=GetEventFailed, operation=Event_CTC_0xD00388.GetEventFailed
      OpEventDiagnosticMonito_1c3d134c: start-on-event=GetEventTested, operation=Event_CTC_0xD00388.GetEventTested
      OpEventDiagnosticMonito_bdfd472b: start-on-event=GetDTCOfEvent, operation=Event_CTC_0xD00388.GetDTCOfEvent
      OpEventDiagnosticMonito_98169c1e: start-on-event=GetFaultDetectionCounter, operation=Event_CTC_0xD00388.GetFaultDetectionCounter
      OpEventDiagnosticMonito_ab8cd542: start-on-event=SetEventStatus, operation=Event_CTC_0xD11887.SetEventStatus
      OpEventDiagnosticMonito_275ce354: start-on-event=ResetEventStatus, operation=Event_CTC_0xD11887.ResetEventStatus
      OpEventDiagnosticMonito_65922f6e: start-on-event=GetEventStatus, operation=Event_CTC_0xD11887.GetEventStatus
      OpEventDiagnosticMonito_bf171c78: start-on-event=GetEventFailed, operation=Event_CTC_0xD11887.GetEventFailed
      OpEventDiagnosticMonito_6b3a23da: start-on-event=GetEventTested, operation=Event_CTC_0xD11887.GetEventTested
      OpEventDiagnosticMonito_cafa77bd: start-on-event=GetDTCOfEvent, operation=Event_CTC_0xD11887.GetDTCOfEvent
      OpEventDiagnosticMonito_ef11ac88: start-on-event=GetFaultDetectionCounter, operation=Event_CTC_0xD11887.GetFaultDetectionCounter
      OpEventDiagnosticMonito_3b33c8d3: start-on-event=SetEventStatus, operation=Event_CTC_0xD21381.SetEventStatus
      OpEventDiagnosticMonito_b7e3fec5: start-on-event=ResetEventStatus, operation=Event_CTC_0xD21381.ResetEventStatus
      OpEventDiagnosticMonito_f52d32ff: start-on-event=GetEventStatus, operation=Event_CTC_0xD21381.GetEventStatus
      OpEventDiagnosticMonito_2fa801e9: start-on-event=GetEventFailed, operation=Event_CTC_0xD21381.GetEventFailed
      OpEventDiagnosticMonito_fb853e4b: start-on-event=GetEventTested, operation=Event_CTC_0xD21381.GetEventTested
      OpEventDiagnosticMonito_5a456a2c: start-on-event=GetDTCOfEvent, operation=Event_CTC_0xD21381.GetDTCOfEvent
      OpEventDiagnosticMonito_7faeb119: start-on-event=GetFaultDetectionCounter, operation=Event_CTC_0xD21381.GetFaultDetectionCounter
      OpEventDiagnosticMonito_4c34f845: start-on-event=SetEventStatus, operation=Event_CTC_0xD31382.SetEventStatus
      OpEventDiagnosticMonito_c0e4ce53: start-on-event=ResetEventStatus, operation=Event_CTC_0xD31382.ResetEventStatus
      OpEventDiagnosticMonito_822a0269: start-on-event=GetEventStatus, operation=Event_CTC_0xD31382.GetEventStatus
      OpEventDiagnosticMonito_58af317f: start-on-event=GetEventFailed, operation=Event_CTC_0xD31382.GetEventFailed
      OpEventDiagnosticMonito_8c820edd: start-on-event=GetEventTested, operation=Event_CTC_0xD31382.GetEventTested
      OpEventDiagnosticMonito_2d425aba: start-on-event=GetDTCOfEvent, operation=Event_CTC_0xD31382.GetDTCOfEvent
      OpEventDiagnosticMonito_08a9818f: start-on-event=GetFaultDetectionCounter, operation=Event_CTC_0xD31382.GetFaultDetectionCounter
      OpEventDiagnosticMonito_3af8d4ce: start-on-event=SetEventStatus, operation=Event_CTC_0xD31383.SetEventStatus
      OpEventDiagnosticMonito_cea0b1a9: start-on-event=ResetEventStatus, operation=Event_CTC_0xD31383.ResetEventStatus
      OpEventDiagnosticMonito_08eea6d7: start-on-event=GetEventStatus, operation=Event_CTC_0xD31383.GetEventStatus
      OpEventDiagnosticMonito_fce096b5: start-on-event=GetEventFailed, operation=Event_CTC_0xD31383.GetEventFailed
      OpEventDiagnosticMonito_c4ec794e: start-on-event=GetEventTested, operation=Event_CTC_0xD31383.GetEventTested
      OpEventDiagnosticMonito_179b4de1: start-on-event=GetDTCOfEvent, operation=Event_CTC_0xD31383.GetDTCOfEvent
      OpEventDiagnosticMonito_410d6219: start-on-event=GetFaultDetectionCounter, operation=Event_CTC_0xD31383.GetFaultDetectionCounter
      OpEventDiagnosticMonito_4dffe458: start-on-event=SetEventStatus, operation=Event_CTC_0xD00008.SetEventStatus
      OpEventDiagnosticMonito_b9a7813f: start-on-event=ResetEventStatus, operation=Event_CTC_0xD00008.ResetEventStatus
      OpEventDiagnosticMonito_7fe99641: start-on-event=GetEventStatus, operation=Event_CTC_0xD00008.GetEventStatus
      OpEventDiagnosticMonito_8be7a623: start-on-event=GetEventFailed, operation=Event_CTC_0xD00008.GetEventFailed
      OpEventDiagnosticMonito_b3eb49d8: start-on-event=GetEventTested, operation=Event_CTC_0xD00008.GetEventTested
      OpEventDiagnosticMonito_609c7d77: start-on-event=GetDTCOfEvent, operation=Event_CTC_0xD00008.GetDTCOfEvent
      OpEventDiagnosticMonito_360a528f: start-on-event=GetFaultDetectionCounter, operation=Event_CTC_0xD00008.GetFaultDetectionCounter
      OpEventDiagnosticMonito_d4f6b5e2: start-on-event=SetEventStatus, operation=Event_CTC_0xD10887.SetEventStatus
      OpEventDiagnosticMonito_20aed085: start-on-event=ResetEventStatus, operation=Event_CTC_0xD10887.ResetEventStatus
      OpEventDiagnosticMonito_e6e0c7fb: start-on-event=GetEventStatus, operation=Event_CTC_0xD10887.GetEventStatus
      OpEventDiagnosticMonito_12eef799: start-on-event=GetEventFailed, operation=Event_CTC_0xD10887.GetEventFailed
      OpEventDiagnosticMonito_2ae21862: start-on-event=GetEventTested, operation=Event_CTC_0xD10887.GetEventTested
      OpEventDiagnosticMonito_f9952ccd: start-on-event=GetDTCOfEvent, operation=Event_CTC_0xD10887.GetDTCOfEvent
      OpEventDiagnosticMonito_af030335: start-on-event=GetFaultDetectionCounter, operation=Event_CTC_0xD10887.GetFaultDetectionCounter
      OpEventDiagnosticMonito_a3f18574: start-on-event=SetEventStatus, operation=Event_CTC_0xD11387.SetEventStatus
      OpEventDiagnosticMonito_57a9e013: start-on-event=ResetEventStatus, operation=Event_CTC_0xD11387.ResetEventStatus
      OpEventDiagnosticMonito_91e7f76d: start-on-event=GetEventStatus, operation=Event_CTC_0xD11387.GetEventStatus
      OpEventDiagnosticMonito_65e9c70f: start-on-event=GetEventFailed, operation=Event_CTC_0xD11387.GetEventFailed
      OpEventDiagnosticMonito_5de528f4: start-on-event=GetEventTested, operation=Event_CTC_0xD11387.GetEventTested
      OpEventDiagnosticMonito_8e921c5b: start-on-event=GetDTCOfEvent, operation=Event_CTC_0xD11387.GetDTCOfEvent
      OpEventDiagnosticMonito_d80433a3: start-on-event=GetFaultDetectionCounter, operation=Event_CTC_0xD11387.GetFaultDetectionCounter
      OpEventDiagnosticMonito_3d9510d7: start-on-event=SetEventStatus, operation=Event_CTC_0xD20881.SetEventStatus
      OpEventDiagnosticMonito_c9cd75b0: start-on-event=ResetEventStatus, operation=Event_CTC_0xD20881.ResetEventStatus
      OpEventDiagnosticMonito_0f8362ce: start-on-event=GetEventStatus, operation=Event_CTC_0xD20881.GetEventStatus
      OpEventDiagnosticMonito_fb8d52ac: start-on-event=GetEventFailed, operation=Event_CTC_0xD20881.GetEventFailed
      OpEventDiagnosticMonito_c381bd57: start-on-event=GetEventTested, operation=Event_CTC_0xD20881.GetEventTested
      OpEventDiagnosticMonito_10f689f8: start-on-event=GetDTCOfEvent, operation=Event_CTC_0xD20881.GetDTCOfEvent
      OpEventDiagnosticMonito_4660a600: start-on-event=GetFaultDetectionCounter, operation=Event_CTC_0xD20881.GetFaultDetectionCounter
      OpEventDiagnosticMonito_4a922041: start-on-event=SetEventStatus, operation=Event_CTC_0xD10587.SetEventStatus
      OpEventDiagnosticMonito_beca4526: start-on-event=ResetEventStatus, operation=Event_CTC_0xD10587.ResetEventStatus
      OpEventDiagnosticMonito_78845258: start-on-event=GetEventStatus, operation=Event_CTC_0xD10587.GetEventStatus
      OpEventDiagnosticMonito_8c8a623a: start-on-event=GetEventFailed, operation=Event_CTC_0xD10587.GetEventFailed
      OpEventDiagnosticMonito_b4868dc1: start-on-event=GetEventTested, operation=Event_CTC_0xD10587.GetEventTested
      OpEventDiagnosticMonito_67f1b96e: start-on-event=GetDTCOfEvent, operation=Event_CTC_0xD10587.GetDTCOfEvent
      OpEventDiagnosticMonito_31679696: start-on-event=GetFaultDetectionCounter, operation=Event_CTC_0xD10587.GetFaultDetectionCounter
      OpEventDiagnosticMonito_d39b71fb: start-on-event=SetEventStatus, operation=Event_CTC_0xD20581.SetEventStatus
      OpEventDiagnosticMonito_27c3149c: start-on-event=ResetEventStatus, operation=Event_CTC_0xD20581.ResetEventStatus
      OpEventDiagnosticMonito_e18d03e2: start-on-event=GetEventStatus, operation=Event_CTC_0xD20581.GetEventStatus
      OpEventDiagnosticMonito_15833380: start-on-event=GetEventFailed, operation=Event_CTC_0xD20581.GetEventFailed
      OpEventDiagnosticMonito_2d8fdc7b: start-on-event=GetEventTested, operation=Event_CTC_0xD20581.GetEventTested
      OpEventDiagnosticMonito_fef8e8d4: start-on-event=GetDTCOfEvent, operation=Event_CTC_0xD20581.GetDTCOfEvent
      OpEventDiagnosticMonito_a86ec72c: start-on-event=GetFaultDetectionCounter, operation=Event_CTC_0xD20581.GetFaultDetectionCounter
      OpEventDiagnosticMonito_a49c416d: start-on-event=SetEventStatus, operation=Event_CTC_0xD30582.SetEventStatus
      OpEventDiagnosticMonito_50c4240a: start-on-event=ResetEventStatus, operation=Event_CTC_0xD30582.ResetEventStatus
      OpEventDiagnosticMonito_968a3374: start-on-event=GetEventStatus, operation=Event_CTC_0xD30582.GetEventStatus
      OpEventDiagnosticMonito_62840316: start-on-event=GetEventFailed, operation=Event_CTC_0xD30582.GetEventFailed
      OpEventDiagnosticMonito_5a88eced: start-on-event=GetEventTested, operation=Event_CTC_0xD30582.GetEventTested
      OpEventDiagnosticMonito_89ffd842: start-on-event=GetDTCOfEvent, operation=Event_CTC_0xD30582.GetDTCOfEvent
      OpEventDiagnosticMonito_df69f7ba: start-on-event=GetFaultDetectionCounter, operation=Event_CTC_0xD30582.GetFaultDetectionCounter
      OpEventDiagnosticMonito_34235cfc: start-on-event=SetEventStatus, operation=Event_CTC_0xD30583.SetEventStatus
      OpEventDiagnosticMonito_c07b399b: start-on-event=ResetEventStatus, operation=Event_CTC_0xD30583.ResetEventStatus
      OpEventDiagnosticMonito_06352ee5: start-on-event=GetEventStatus, operation=Event_CTC_0xD30583.GetEventStatus
      OpEventDiagnosticMonito_f23b1e87: start-on-event=GetEventFailed, operation=Event_CTC_0xD30583.GetEventFailed
      OpEventDiagnosticMonito_ca37f17c: start-on-event=GetEventTested, operation=Event_CTC_0xD30583.GetEventTested
      OpEventDiagnosticMonito_1940c5d3: start-on-event=GetDTCOfEvent, operation=Event_CTC_0xD30583.GetDTCOfEvent
      OpEventDiagnosticMonito_4fd6ea2b: start-on-event=GetFaultDetectionCounter, operation=Event_CTC_0xD30583.GetFaultDetectionCounter
      OpEventDiagnosticMonito_43246c6a: start-on-event=SetEventStatus, operation=Event_CTC_0xD21881.SetEventStatus
      OpEventDiagnosticMonito_b77c090d: start-on-event=ResetEventStatus, operation=Event_CTC_0xD21881.ResetEventStatus
      OpEventDiagnosticMonito_71321e73: start-on-event=GetEventStatus, operation=Event_CTC_0xD21881.GetEventStatus
      OpEventDiagnosticMonito_853c2e11: start-on-event=GetEventFailed, operation=Event_CTC_0xD21881.GetEventFailed
      OpEventDiagnosticMonito_bd30c1ea: start-on-event=GetEventTested, operation=Event_CTC_0xD21881.GetEventTested
      OpEventDiagnosticMonito_6e47f545: start-on-event=GetDTCOfEvent, operation=Event_CTC_0xD21881.GetDTCOfEvent
      OpEventDiagnosticMonito_38d1dabd: start-on-event=GetFaultDetectionCounter, operation=Event_CTC_0xD21881.GetFaultDetectionCounter
      OpEventDiagnosticMonito_11d5870d: start-on-event=SetEventStatus, operation=Event_CTC_0xD11D87.SetEventStatus
      OpEventDiagnosticMonito_e58de26a: start-on-event=ResetEventStatus, operation=Event_CTC_0xD11D87.ResetEventStatus
      OpEventDiagnosticMonito_23c3f514: start-on-event=GetEventStatus, operation=Event_CTC_0xD11D87.GetEventStatus
      OpEventDiagnosticMonito_d7cdc576: start-on-event=GetEventFailed, operation=Event_CTC_0xD11D87.GetEventFailed
      OpEventDiagnosticMonito_efc12a8d: start-on-event=GetEventTested, operation=Event_CTC_0xD11D87.GetEventTested
      OpEventDiagnosticMonito_3cb61e22: start-on-event=GetDTCOfEvent, operation=Event_CTC_0xD11D87.GetDTCOfEvent
      OpEventDiagnosticMonito_6a2031da: start-on-event=GetFaultDetectionCounter, operation=Event_CTC_0xD11D87.GetFaultDetectionCounter
      OpEventDiagnosticMonito_66d2b79b: start-on-event=SetEventStatus, operation=Event_CTC_0xD21D81.SetEventStatus
      OpEventDiagnosticMonito_928ad2fc: start-on-event=ResetEventStatus, operation=Event_CTC_0xD21D81.ResetEventStatus
      OpEventDiagnosticMonito_54c4c582: start-on-event=GetEventStatus, operation=Event_CTC_0xD21D81.GetEventStatus
      OpEventDiagnosticMonito_a0caf5e0: start-on-event=GetEventFailed, operation=Event_CTC_0xD21D81.GetEventFailed
      OpEventDiagnosticMonito_98c61a1b: start-on-event=GetEventTested, operation=Event_CTC_0xD21D81.GetEventTested
      OpEventDiagnosticMonito_4bb12eb4: start-on-event=GetDTCOfEvent, operation=Event_CTC_0xD21D81.GetDTCOfEvent
      OpEventDiagnosticMonito_1d27014c: start-on-event=GetFaultDetectionCounter, operation=Event_CTC_0xD21D81.GetFaultDetectionCounter
      OpEventDiagnosticMonito_ffdbe621: start-on-event=SetEventStatus, operation=Event_CTC_0xD31D82.SetEventStatus
      OpEventDiagnosticMonito_0b838346: start-on-event=ResetEventStatus, operation=Event_CTC_0xD31D82.ResetEventStatus
      OpEventDiagnosticMonito_cdcd9438: start-on-event=GetEventStatus, operation=Event_CTC_0xD31D82.GetEventStatus
      OpEventDiagnosticMonito_39c3a45a: start-on-event=GetEventFailed, operation=Event_CTC_0xD31D82.GetEventFailed
      OpEventDiagnosticMonito_01cf4ba1: start-on-event=GetEventTested, operation=Event_CTC_0xD31D82.GetEventTested
      OpEventDiagnosticMonito_d2b87f0e: start-on-event=GetDTCOfEvent, operation=Event_CTC_0xD31D82.GetDTCOfEvent
      OpEventDiagnosticMonito_842e50f6: start-on-event=GetFaultDetectionCounter, operation=Event_CTC_0xD31D82.GetFaultDetectionCounter
      OpEventDiagnosticMonito_88dcd6b7: start-on-event=SetEventStatus, operation=Event_CTC_0xD31D83.SetEventStatus
      OpEventDiagnosticMonito_7c84b3d0: start-on-event=ResetEventStatus, operation=Event_CTC_0xD31D83.ResetEventStatus
      OpEventDiagnosticMonito_bacaa4ae: start-on-event=GetEventStatus, operation=Event_CTC_0xD31D83.GetEventStatus
      OpEventDiagnosticMonito_4ec494cc: start-on-event=GetEventFailed, operation=Event_CTC_0xD31D83.GetEventFailed
      OpEventDiagnosticMonito_76c87b37: start-on-event=GetEventTested, operation=Event_CTC_0xD31D83.GetEventTested
      OpEventDiagnosticMonito_a5bf4f98: start-on-event=GetDTCOfEvent, operation=Event_CTC_0xD31D83.GetDTCOfEvent
      OpEventDiagnosticMonito_f3296060: start-on-event=GetFaultDetectionCounter, operation=Event_CTC_0xD31D83.GetFaultDetectionCounter
      OpEventDiagnosticMonito_16b84314: start-on-event=SetEventStatus, operation=Event_CTC_0x050192.SetEventStatus
      OpEventDiagnosticMonito_e2e02673: start-on-event=ResetEventStatus, operation=Event_CTC_0x050192.ResetEventStatus
      OpEventDiagnosticMonito_24ae310d: start-on-event=GetEventStatus, operation=Event_CTC_0x050192.GetEventStatus
      OpEventDiagnosticMonito_d0a0016f: start-on-event=GetEventFailed, operation=Event_CTC_0x050192.GetEventFailed
      OpEventDiagnosticMonito_e8acee94: start-on-event=GetEventTested, operation=Event_CTC_0x050192.GetEventTested
      OpEventDiagnosticMonito_3bdbda3b: start-on-event=GetDTCOfEvent, operation=Event_CTC_0x050192.GetDTCOfEvent
      OpEventDiagnosticMonito_6d4df5c3: start-on-event=GetFaultDetectionCounter, operation=Event_CTC_0x050192.GetFaultDetectionCounter
      OpEventDiagnosticMonito_61bf7382: start-on-event=SetEventStatus, operation=Event_CTC_0x510A51.SetEventStatus
      OpEventDiagnosticMonito_95e716e5: start-on-event=ResetEventStatus, operation=Event_CTC_0x510A51.ResetEventStatus
      OpEventDiagnosticMonito_53a9019b: start-on-event=GetEventStatus, operation=Event_CTC_0x510A51.GetEventStatus
      OpEventDiagnosticMonito_a7a731f9: start-on-event=GetEventFailed, operation=Event_CTC_0x510A51.GetEventFailed
      OpEventDiagnosticMonito_9fabde02: start-on-event=GetEventTested, operation=Event_CTC_0x510A51.GetEventTested
      OpEventDiagnosticMonito_4cdceaad: start-on-event=GetDTCOfEvent, operation=Event_CTC_0x510A51.GetDTCOfEvent
      OpEventDiagnosticMonito_1a4ac555: start-on-event=GetFaultDetectionCounter, operation=Event_CTC_0x510A51.GetFaultDetectionCounter
      OpEventDiagnosticMonito_f8b62238: start-on-event=SetEventStatus, operation=Event_CTC_0x510BA1.SetEventStatus
      OpEventDiagnosticMonito_0cee475f: start-on-event=ResetEventStatus, operation=Event_CTC_0x510BA1.ResetEventStatus
      OpEventDiagnosticMonito_caa05021: start-on-event=GetEventStatus, operation=Event_CTC_0x510BA1.GetEventStatus
      OpEventDiagnosticMonito_3eae6043: start-on-event=GetEventFailed, operation=Event_CTC_0x510BA1.GetEventFailed
      OpEventDiagnosticMonito_06a28fb8: start-on-event=GetEventTested, operation=Event_CTC_0x510BA1.GetEventTested
      OpEventDiagnosticMonito_d5d5bb17: start-on-event=GetDTCOfEvent, operation=Event_CTC_0x510BA1.GetDTCOfEvent
      OpEventDiagnosticMonito_834394ef: start-on-event=GetFaultDetectionCounter, operation=Event_CTC_0x510BA1.GetFaultDetectionCounter
      OpEventDiagnosticMonito_8fb112ae: start-on-event=SetEventStatus, operation=Event_CTC_0x510BA2.SetEventStatus
      OpEventDiagnosticMonito_7be977c9: start-on-event=ResetEventStatus, operation=Event_CTC_0x510BA2.ResetEventStatus
      OpEventDiagnosticMonito_bda760b7: start-on-event=GetEventStatus, operation=Event_CTC_0x510BA2.GetEventStatus
      OpEventDiagnosticMonito_49a950d5: start-on-event=GetEventFailed, operation=Event_CTC_0x510BA2.GetEventFailed
      OpEventDiagnosticMonito_71a5bf2e: start-on-event=GetEventTested, operation=Event_CTC_0x510BA2.GetEventTested
      OpEventDiagnosticMonito_a2d28b81: start-on-event=GetDTCOfEvent, operation=Event_CTC_0x510BA2.GetDTCOfEvent
      OpEventDiagnosticMonito_f444a479: start-on-event=GetFaultDetectionCounter, operation=Event_CTC_0x510BA2.GetFaultDetectionCounter
      OpEventDiagnosticMonito_1f0e0f3f: start-on-event=SetEventStatus, operation=Event_CTC_0x510BA3.SetEventStatus
      OpEventDiagnosticMonito_eb566a58: start-on-event=ResetEventStatus, operation=Event_CTC_0x510BA3.ResetEventStatus
      OpEventDiagnosticMonito_2d187d26: start-on-event=GetEventStatus, operation=Event_CTC_0x510BA3.GetEventStatus
      OpEventDiagnosticMonito_d9164d44: start-on-event=GetEventFailed, operation=Event_CTC_0x510BA3.GetEventFailed
      OpEventDiagnosticMonito_e11aa2bf: start-on-event=GetEventTested, operation=Event_CTC_0x510BA3.GetEventTested
      OpEventDiagnosticMonito_326d9610: start-on-event=GetDTCOfEvent, operation=Event_CTC_0x510BA3.GetDTCOfEvent
      OpEventDiagnosticMonito_64fbb9e8: start-on-event=GetFaultDetectionCounter, operation=Event_CTC_0x510BA3.GetFaultDetectionCounter
      OpEventDiagnosticMonito_68093fa9: start-on-event=SetEventStatus, operation=Event_CTC_0x510C01.SetEventStatus
      OpEventDiagnosticMonito_9c515ace: start-on-event=ResetEventStatus, operation=Event_CTC_0x510C01.ResetEventStatus
      OpEventDiagnosticMonito_5a1f4db0: start-on-event=GetEventStatus, operation=Event_CTC_0x510C01.GetEventStatus
      OpEventDiagnosticMonito_ae117dd2: start-on-event=GetEventFailed, operation=Event_CTC_0x510C01.GetEventFailed
      OpEventDiagnosticMonito_961d9229: start-on-event=GetEventTested, operation=Event_CTC_0x510C01.GetEventTested
      OpEventDiagnosticMonito_456aa686: start-on-event=GetDTCOfEvent, operation=Event_CTC_0x510C01.GetDTCOfEvent
      OpEventDiagnosticMonito_13fc897e: start-on-event=GetFaultDetectionCounter, operation=Event_CTC_0x510C01.GetFaultDetectionCounter
      OpEventDiagnosticMonito_08ceb64c: start-on-event=SetEventStatus, operation=Event_CTC_0x510C04.SetEventStatus
      OpEventDiagnosticMonito_fc96d32b: start-on-event=ResetEventStatus, operation=Event_CTC_0x510C04.ResetEventStatus
      OpEventDiagnosticMonito_3ad8c455: start-on-event=GetEventStatus, operation=Event_CTC_0x510C04.GetEventStatus
      OpEventDiagnosticMonito_ced6f437: start-on-event=GetEventFailed, operation=Event_CTC_0x510C04.GetEventFailed
      OpEventDiagnosticMonito_f6da1bcc: start-on-event=GetEventTested, operation=Event_CTC_0x510C04.GetEventTested
      OpEventDiagnosticMonito_25ad2f63: start-on-event=GetDTCOfEvent, operation=Event_CTC_0x510C04.GetDTCOfEvent
      OpEventDiagnosticMonito_733b009b: start-on-event=GetFaultDetectionCounter, operation=Event_CTC_0x510C04.GetFaultDetectionCounter
      OpEventDiagnosticMonito_7fc986da: start-on-event=SetEventStatus, operation=Event_CTC_0x510C1C.SetEventStatus
      OpEventDiagnosticMonito_8b91e3bd: start-on-event=ResetEventStatus, operation=Event_CTC_0x510C1C.ResetEventStatus
      OpEventDiagnosticMonito_4ddff4c3: start-on-event=GetEventStatus, operation=Event_CTC_0x510C1C.GetEventStatus
      OpEventDiagnosticMonito_b9d1c4a1: start-on-event=GetEventFailed, operation=Event_CTC_0x510C1C.GetEventFailed
      OpEventDiagnosticMonito_81dd2b5a: start-on-event=GetEventTested, operation=Event_CTC_0x510C1C.GetEventTested
      OpEventDiagnosticMonito_52aa1ff5: start-on-event=GetDTCOfEvent, operation=Event_CTC_0x510C1C.GetDTCOfEvent
      OpEventDiagnosticMonito_043c300d: start-on-event=GetFaultDetectionCounter, operation=Event_CTC_0x510C1C.GetFaultDetectionCounter
      OpEventDiagnosticMonito_e6c0d760: start-on-event=SetEventStatus, operation=Event_CTC_0x510C43.SetEventStatus
      OpEventDiagnosticMonito_1298b207: start-on-event=ResetEventStatus, operation=Event_CTC_0x510C43.ResetEventStatus
      OpEventDiagnosticMonito_d4d6a579: start-on-event=GetEventStatus, operation=Event_CTC_0x510C43.GetEventStatus
      OpEventDiagnosticMonito_20d8951b: start-on-event=GetEventFailed, operation=Event_CTC_0x510C43.GetEventFailed
      OpEventDiagnosticMonito_18d47ae0: start-on-event=GetEventTested, operation=Event_CTC_0x510C43.GetEventTested
      OpEventDiagnosticMonito_cba34e4f: start-on-event=GetDTCOfEvent, operation=Event_CTC_0x510C43.GetDTCOfEvent
      OpEventDiagnosticMonito_9d3561b7: start-on-event=GetFaultDetectionCounter, operation=Event_CTC_0x510C43.GetFaultDetectionCounter
      OpEventDiagnosticMonito_91c7e7f6: start-on-event=SetEventStatus, operation=Event_CTC_0x510C62.SetEventStatus
      OpEventDiagnosticMonito_659f8291: start-on-event=ResetEventStatus, operation=Event_CTC_0x510C62.ResetEventStatus
      OpEventDiagnosticMonito_a3d195ef: start-on-event=GetEventStatus, operation=Event_CTC_0x510C62.GetEventStatus
      OpEventDiagnosticMonito_57dfa58d: start-on-event=GetEventFailed, operation=Event_CTC_0x510C62.GetEventFailed
      OpEventDiagnosticMonito_6fd34a76: start-on-event=GetEventTested, operation=Event_CTC_0x510C62.GetEventTested
      OpEventDiagnosticMonito_bca47ed9: start-on-event=GetDTCOfEvent, operation=Event_CTC_0x510C62.GetDTCOfEvent
      OpEventDiagnosticMonito_ea325121: start-on-event=GetFaultDetectionCounter, operation=Event_CTC_0x510C62.GetFaultDetectionCounter
      OpEventDiagnosticMonito_0fa37255: start-on-event=SetEventStatus, operation=Event_CTC_0x510C96.SetEventStatus
      OpEventDiagnosticMonito_fbfb1732: start-on-event=ResetEventStatus, operation=Event_CTC_0x510C96.ResetEventStatus
      OpEventDiagnosticMonito_3db5004c: start-on-event=GetEventStatus, operation=Event_CTC_0x510C96.GetEventStatus
      OpEventDiagnosticMonito_c9bb302e: start-on-event=GetEventFailed, operation=Event_CTC_0x510C96.GetEventFailed
      OpEventDiagnosticMonito_f1b7dfd5: start-on-event=GetEventTested, operation=Event_CTC_0x510C96.GetEventTested
      OpEventDiagnosticMonito_22c0eb7a: start-on-event=GetDTCOfEvent, operation=Event_CTC_0x510C96.GetDTCOfEvent
      OpEventDiagnosticMonito_7456c482: start-on-event=GetFaultDetectionCounter, operation=Event_CTC_0x510C96.GetFaultDetectionCounter
      OpEventDiagnosticMonito_78a442c3: start-on-event=SetEventStatus, operation=Event_CTC_0x510C98.SetEventStatus
      OpEventDiagnosticMonito_8cfc27a4: start-on-event=ResetEventStatus, operation=Event_CTC_0x510C98.ResetEventStatus
      OpEventDiagnosticMonito_4ab230da: start-on-event=GetEventStatus, operation=Event_CTC_0x510C98.GetEventStatus
      OpEventDiagnosticMonito_bebc00b8: start-on-event=GetEventFailed, operation=Event_CTC_0x510C98.GetEventFailed
      OpEventDiagnosticMonito_86b0ef43: start-on-event=GetEventTested, operation=Event_CTC_0x510C98.GetEventTested
      OpEventDiagnosticMonito_55c7dbec: start-on-event=GetDTCOfEvent, operation=Event_CTC_0x510C98.GetDTCOfEvent
      OpEventDiagnosticMonito_0351f414: start-on-event=GetFaultDetectionCounter, operation=Event_CTC_0x510C98.GetFaultDetectionCounter
      OpEventDiagnosticMonito_e1ad1379: start-on-event=SetEventStatus, operation=Event_CTC_0x539855.SetEventStatus
      OpEventDiagnosticMonito_15f5761e: start-on-event=ResetEventStatus, operation=Event_CTC_0x539855.ResetEventStatus
      OpEventDiagnosticMonito_d3bb6160: start-on-event=GetEventStatus, operation=Event_CTC_0x539855.GetEventStatus
      OpEventDiagnosticMonito_27b55102: start-on-event=GetEventFailed, operation=Event_CTC_0x539855.GetEventFailed
      OpEventDiagnosticMonito_1fb9bef9: start-on-event=GetEventTested, operation=Event_CTC_0x539855.GetEventTested
      OpEventDiagnosticMonito_ccce8a56: start-on-event=GetDTCOfEvent, operation=Event_CTC_0x539855.GetDTCOfEvent
      OpEventDiagnosticMonito_9a58a5ae: start-on-event=GetFaultDetectionCounter, operation=Event_CTC_0x539855.GetFaultDetectionCounter
      OpEventDiagnosticMonito_96aa23ef: start-on-event=SetEventStatus, operation=Event_CTC_0x540C00.SetEventStatus
      OpEventDiagnosticMonito_62f24688: start-on-event=ResetEventStatus, operation=Event_CTC_0x540C00.ResetEventStatus
      OpEventDiagnosticMonito_a4bc51f6: start-on-event=GetEventStatus, operation=Event_CTC_0x540C00.GetEventStatus
      OpEventDiagnosticMonito_50b26194: start-on-event=GetEventFailed, operation=Event_CTC_0x540C00.GetEventFailed
      OpEventDiagnosticMonito_68be8e6f: start-on-event=GetEventTested, operation=Event_CTC_0x540C00.GetEventTested
      OpEventDiagnosticMonito_bbc9bac0: start-on-event=GetDTCOfEvent, operation=Event_CTC_0x540C00.GetDTCOfEvent
      OpEventDiagnosticMonito_ed5f9538: start-on-event=GetFaultDetectionCounter, operation=Event_CTC_0x540C00.GetFaultDetectionCounter
      OpEventDiagnosticMonito_06153e7e: start-on-event=SetEventStatus, operation=Event_CTC_0x55668F.SetEventStatus
      OpEventDiagnosticMonito_f24d5b19: start-on-event=ResetEventStatus, operation=Event_CTC_0x55668F.ResetEventStatus
      OpEventDiagnosticMonito_34034c67: start-on-event=GetEventStatus, operation=Event_CTC_0x55668F.GetEventStatus
      OpEventDiagnosticMonito_c00d7c05: start-on-event=GetEventFailed, operation=Event_CTC_0x55668F.GetEventFailed
      OpEventDiagnosticMonito_f80193fe: start-on-event=GetEventTested, operation=Event_CTC_0x55668F.GetEventTested
      OpEventDiagnosticMonito_2b76a751: start-on-event=GetDTCOfEvent, operation=Event_CTC_0x55668F.GetDTCOfEvent
      OpEventDiagnosticMonito_7de088a9: start-on-event=GetFaultDetectionCounter, operation=Event_CTC_0x55668F.GetFaultDetectionCounter
      OpEventDiagnosticMonito_71120ee8: start-on-event=SetEventStatus, operation=Event_CTC_0x540D00.SetEventStatus
      OpEventDiagnosticMonito_854a6b8f: start-on-event=ResetEventStatus, operation=Event_CTC_0x540D00.ResetEventStatus
      OpEventDiagnosticMonito_43047cf1: start-on-event=GetEventStatus, operation=Event_CTC_0x540D00.GetEventStatus
      OpEventDiagnosticMonito_b70a4c93: start-on-event=GetEventFailed, operation=Event_CTC_0x540D00.GetEventFailed
      OpEventDiagnosticMonito_8f06a368: start-on-event=GetEventTested, operation=Event_CTC_0x540D00.GetEventTested
      OpEventDiagnosticMonito_5c7197c7: start-on-event=GetDTCOfEvent, operation=Event_CTC_0x540D00.GetDTCOfEvent
      OpEventDiagnosticMonito_0ae7b83f: start-on-event=GetFaultDetectionCounter, operation=Event_CTC_0x540D00.GetFaultDetectionCounter
      OpEventDiagnosticMonito_478f208b: start-on-event=SetEventStatus, operation=Event_CTC_0x564404.SetEventStatus
      OpEventDiagnosticMonito_b3d745ec: start-on-event=ResetEventStatus, operation=Event_CTC_0x564404.ResetEventStatus
      OpEventDiagnosticMonito_75995292: start-on-event=GetEventStatus, operation=Event_CTC_0x564404.GetEventStatus
      OpEventDiagnosticMonito_819762f0: start-on-event=GetEventFailed, operation=Event_CTC_0x564404.GetEventFailed
      OpEventDiagnosticMonito_b99b8d0b: start-on-event=GetEventTested, operation=Event_CTC_0x564404.GetEventTested
      OpEventDiagnosticMonito_6aecb9a4: start-on-event=GetDTCOfEvent, operation=Event_CTC_0x564404.GetDTCOfEvent
      OpEventDiagnosticMonito_3c7a965c: start-on-event=GetFaultDetectionCounter, operation=Event_CTC_0x564404.GetFaultDetectionCounter
      OpEventDiagnosticMonito_3088101d: start-on-event=SetEventStatus, operation=Event_CTC_0x513662.SetEventStatus
      OpEventDiagnosticMonito_c4d0757a: start-on-event=ResetEventStatus, operation=Event_CTC_0x513662.ResetEventStatus
      OpEventDiagnosticMonito_029e6204: start-on-event=GetEventStatus, operation=Event_CTC_0x513662.GetEventStatus
      OpEventDiagnosticMonito_f6905266: start-on-event=GetEventFailed, operation=Event_CTC_0x513662.GetEventFailed
      OpEventDiagnosticMonito_ce9cbd9d: start-on-event=GetEventTested, operation=Event_CTC_0x513662.GetEventTested
      OpEventDiagnosticMonito_1deb8932: start-on-event=GetDTCOfEvent, operation=Event_CTC_0x513662.GetDTCOfEvent
      OpEventDiagnosticMonito_4b7da6ca: start-on-event=GetFaultDetectionCounter, operation=Event_CTC_0x513662.GetFaultDetectionCounter
      OpEventDiagnosticMonito_a98141a7: start-on-event=SetEventStatus, operation=Event_CTC_0x520DA2.SetEventStatus
      OpEventDiagnosticMonito_5dd924c0: start-on-event=ResetEventStatus, operation=Event_CTC_0x520DA2.ResetEventStatus
      OpEventDiagnosticMonito_9b9733be: start-on-event=GetEventStatus, operation=Event_CTC_0x520DA2.GetEventStatus
      OpEventDiagnosticMonito_6f9903dc: start-on-event=GetEventFailed, operation=Event_CTC_0x520DA2.GetEventFailed
      OpEventDiagnosticMonito_5795ec27: start-on-event=GetEventTested, operation=Event_CTC_0x520DA2.GetEventTested
      OpEventDiagnosticMonito_84e2d888: start-on-event=GetDTCOfEvent, operation=Event_CTC_0x520DA2.GetDTCOfEvent
      OpEventDiagnosticMonito_d274f770: start-on-event=GetFaultDetectionCounter, operation=Event_CTC_0x520DA2.GetFaultDetectionCounter
      OpEventDiagnosticMonito_de867131: start-on-event=SetEventStatus, operation=Event_CTC_0x520E00.SetEventStatus
      OpEventDiagnosticMonito_2ade1456: start-on-event=ResetEventStatus, operation=Event_CTC_0x520E00.ResetEventStatus
      OpEventDiagnosticMonito_ec900328: start-on-event=GetEventStatus, operation=Event_CTC_0x520E00.GetEventStatus
      OpEventDiagnosticMonito_189e334a: start-on-event=GetEventFailed, operation=Event_CTC_0x520E00.GetEventFailed
      OpEventDiagnosticMonito_2092dcb1: start-on-event=GetEventTested, operation=Event_CTC_0x520E00.GetEventTested
      OpEventDiagnosticMonito_f3e5e81e: start-on-event=GetDTCOfEvent, operation=Event_CTC_0x520E00.GetDTCOfEvent
      OpEventDiagnosticMonito_a573c7e6: start-on-event=GetFaultDetectionCounter, operation=Event_CTC_0x520E00.GetFaultDetectionCounter
      OpEventDiagnosticMonito_40e2e492: start-on-event=SetEventStatus, operation=Event_CTC_0xD31308.SetEventStatus
      OpEventDiagnosticMonito_b4ba81f5: start-on-event=ResetEventStatus, operation=Event_CTC_0xD31308.ResetEventStatus
      OpEventDiagnosticMonito_72f4968b: start-on-event=GetEventStatus, operation=Event_CTC_0xD31308.GetEventStatus
      OpEventDiagnosticMonito_86faa6e9: start-on-event=GetEventFailed, operation=Event_CTC_0xD31308.GetEventFailed
      OpEventDiagnosticMonito_bef64912: start-on-event=GetEventTested, operation=Event_CTC_0xD31308.GetEventTested
      OpEventDiagnosticMonito_6d817dbd: start-on-event=GetDTCOfEvent, operation=Event_CTC_0xD31308.GetDTCOfEvent
      OpEventDiagnosticMonito_3b175245: start-on-event=GetFaultDetectionCounter, operation=Event_CTC_0xD31308.GetFaultDetectionCounter
      OpEventDiagnosticMonito_37e5d404: start-on-event=SetEventStatus, operation=Event_CTC_0xD30508.SetEventStatus
      OpEventDiagnosticMonito_c3bdb163: start-on-event=ResetEventStatus, operation=Event_CTC_0xD30508.ResetEventStatus
      OpEventDiagnosticMonito_05f3a61d: start-on-event=GetEventStatus, operation=Event_CTC_0xD30508.GetEventStatus
      OpEventDiagnosticMonito_f1fd967f: start-on-event=GetEventFailed, operation=Event_CTC_0xD30508.GetEventFailed
      OpEventDiagnosticMonito_c9f17984: start-on-event=GetEventTested, operation=Event_CTC_0xD30508.GetEventTested
      OpEventDiagnosticMonito_1a864d2b: start-on-event=GetDTCOfEvent, operation=Event_CTC_0xD30508.GetDTCOfEvent
      OpEventDiagnosticMonito_4c1062d3: start-on-event=GetFaultDetectionCounter, operation=Event_CTC_0xD30508.GetFaultDetectionCounter
    port-api-options port-api-option={enable-take-address=true, indirect-api=false, port=CBDTCStatusChange_DemIf}, port-api-option={enable-take-address=true, indirect-api=false, port=CBDTCStatusChange_FaultLog}, port-api-option={enable-take-address=true, indirect-api=false, port=CBValByDID_0xd401}, port-api-option={enable-take-address=true, indirect-api=false, port=CBValByDID_0xd403}, port-api-option={enable-take-address=true, indirect-api=false, port=CBValByDID_0xd404}, port-api-option={enable-take-address=true, indirect-api=false, port=CBValByDID_0xd405}, port-api-option={enable-take-address=true, indirect-api=false, port=CBValByDID_0xd407}, port-api-option={enable-take-address=true, indirect-api=false, port=CBValByDID_0xd408}, port-api-option={enable-take-address=true, indirect-api=false, port=CBValByDID_0xd409}, port-api-option={enable-take-address=true, indirect-api=false, port=CBValByDID_0xd40b}, port-api-option={enable-take-address=true, indirect-api=false, port=CBValByDID_0xd40c}, port-api-option={enable-take-address=true, indirect-api=false, port=CBValByDID_0xd40d}, port-api-option={enable-take-address=true, indirect-api=false, port=CBValByDID_0xd40f}, port-api-option={enable-take-address=true, indirect-api=false, port=CBValByDID_0xd410}, port-api-option={enable-take-address=true, indirect-api=false, port=CBValByDID_0xd412}, port-api-option={enable-take-address=true, indirect-api=false, port=CBValByDID_0xd414}, port-api-option={enable-take-address=true, indirect-api=false, port=CBValByDID_0xd415}, port-api-option={enable-take-address=true, indirect-api=false, port=CBValByDID_0xd418}, port-api-option={enable-take-address=true, indirect-api=false, port=CBValByDID_0xd41b}:
      port-api-option enable-take-address=true, indirect-api=false, port=Event_CTC_0x563A8F:
        port-arg-values:
          integer literal Event_CTC_0x563A8F: type=Dem_EventIdType, value=25
      port-api-option enable-take-address=true, indirect-api=false, port=Event_CTC_0x540698:
        port-arg-values:
          integer literal Event_CTC_0x540698: type=Dem_EventIdType, value=30
      port-api-option enable-take-address=true, indirect-api=false, port=Event_CTC_0x540B16:
        port-arg-values:
          integer literal Event_CTC_0x540B16: type=Dem_EventIdType, value=29
      port-api-option enable-take-address=true, indirect-api=false, port=Event_CTC_0x520901:
        port-arg-values:
          integer literal Event_CTC_0x520901: type=Dem_EventIdType, value=34
      port-api-option enable-take-address=true, indirect-api=false, port=Event_CTC_0xD00388:
        port-arg-values:
          integer literal Event_CTC_0xD00388: type=Dem_EventIdType, value=22
      port-api-option enable-take-address=true, indirect-api=false, port=Event_CTC_0xD11887:
        port-arg-values:
          integer literal Event_CTC_0xD11887: type=Dem_EventIdType, value=18
      port-api-option enable-take-address=true, indirect-api=false, port=Event_CTC_0xD21381:
        port-arg-values:
          integer literal Event_CTC_0xD21381: type=Dem_EventIdType, value=14
      port-api-option enable-take-address=true, indirect-api=false, port=Event_CTC_0xD31382:
        port-arg-values:
          integer literal Event_CTC_0xD31382: type=Dem_EventIdType, value=6
      port-api-option enable-take-address=true, indirect-api=false, port=Event_CTC_0xD31383:
        port-arg-values:
          integer literal Event_CTC_0xD31383: type=Dem_EventIdType, value=5
      port-api-option enable-take-address=true, indirect-api=false, port=Event_CTC_0xD00008:
        port-arg-values:
          integer literal Event_CTC_0xD00008: type=Dem_EventIdType, value=23
      port-api-option enable-take-address=true, indirect-api=false, port=Event_CTC_0xD10887:
        port-arg-values:
          integer literal Event_CTC_0xD10887: type=Dem_EventIdType, value=20
      port-api-option enable-take-address=true, indirect-api=false, port=Event_CTC_0xD11387:
        port-arg-values:
          integer literal Event_CTC_0xD11387: type=Dem_EventIdType, value=19
      port-api-option enable-take-address=true, indirect-api=false, port=Event_CTC_0xD20881:
        port-arg-values:
          integer literal Event_CTC_0xD20881: type=Dem_EventIdType, value=15
      port-api-option enable-take-address=true, indirect-api=false, port=Event_CTC_0xD10587:
        port-arg-values:
          integer literal Event_CTC_0xD10587: type=Dem_EventIdType, value=21
      port-api-option enable-take-address=true, indirect-api=false, port=Event_CTC_0xD20581:
        port-arg-values:
          integer literal Event_CTC_0xD20581: type=Dem_EventIdType, value=16
      port-api-option enable-take-address=true, indirect-api=false, port=Event_CTC_0xD30582:
        port-arg-values:
          integer literal Event_CTC_0xD30582: type=Dem_EventIdType, value=10
      port-api-option enable-take-address=true, indirect-api=false, port=Event_CTC_0xD30583:
        port-arg-values:
          integer literal Event_CTC_0xD30583: type=Dem_EventIdType, value=9
      port-api-option enable-take-address=true, indirect-api=false, port=Event_CTC_0xD21881:
        port-arg-values:
          integer literal Event_CTC_0xD21881: type=Dem_EventIdType, value=13
      port-api-option enable-take-address=true, indirect-api=false, port=Event_CTC_0xD11D87:
        port-arg-values:
          integer literal Event_CTC_0xD11D87: type=Dem_EventIdType, value=17
      port-api-option enable-take-address=true, indirect-api=false, port=Event_CTC_0xD21D81:
        port-arg-values:
          integer literal Event_CTC_0xD21D81: type=Dem_EventIdType, value=12
      port-api-option enable-take-address=true, indirect-api=false, port=Event_CTC_0xD31D82:
        port-arg-values:
          integer literal Event_CTC_0xD31D82: type=Dem_EventIdType, value=2
      port-api-option enable-take-address=true, indirect-api=false, port=Event_CTC_0xD31D83:
        port-arg-values:
          integer literal Event_CTC_0xD31D83: type=Dem_EventIdType, value=1
      port-api-option enable-take-address=true, indirect-api=false, port=Event_CTC_0x050192:
        port-arg-values:
          integer literal Event_CTC_0x050192: type=Dem_EventIdType, value=47
      port-api-option enable-take-address=true, indirect-api=false, port=Event_CTC_0x510A51:
        port-arg-values:
          integer literal Event_CTC_0x510A51: type=Dem_EventIdType, value=46
      port-api-option enable-take-address=true, indirect-api=false, port=Event_CTC_0x510BA1:
        port-arg-values:
          integer literal Event_CTC_0x510BA1: type=Dem_EventIdType, value=45
      port-api-option enable-take-address=true, indirect-api=false, port=Event_CTC_0x510BA2:
        port-arg-values:
          integer literal Event_CTC_0x510BA2: type=Dem_EventIdType, value=44
      port-api-option enable-take-address=true, indirect-api=false, port=Event_CTC_0x510BA3:
        port-arg-values:
          integer literal Event_CTC_0x510BA3: type=Dem_EventIdType, value=43
      port-api-option enable-take-address=true, indirect-api=false, port=Event_CTC_0x510C01:
        port-arg-values:
          integer literal Event_CTC_0x510C01: type=Dem_EventIdType, value=42
      port-api-option enable-take-address=true, indirect-api=false, port=Event_CTC_0x510C04:
        port-arg-values:
          integer literal Event_CTC_0x510C04: type=Dem_EventIdType, value=41
      port-api-option enable-take-address=true, indirect-api=false, port=Event_CTC_0x510C1C:
        port-arg-values:
          integer literal Event_CTC_0x510C1C: type=Dem_EventIdType, value=40
      port-api-option enable-take-address=true, indirect-api=false, port=Event_CTC_0x510C43:
        port-arg-values:
          integer literal Event_CTC_0x510C43: type=Dem_EventIdType, value=39
      port-api-option enable-take-address=true, indirect-api=false, port=Event_CTC_0x510C62:
        port-arg-values:
          integer literal Event_CTC_0x510C62: type=Dem_EventIdType, value=38
      port-api-option enable-take-address=true, indirect-api=false, port=Event_CTC_0x510C96:
        port-arg-values:
          integer literal Event_CTC_0x510C96: type=Dem_EventIdType, value=37
      port-api-option enable-take-address=true, indirect-api=false, port=Event_CTC_0x510C98:
        port-arg-values:
          integer literal Event_CTC_0x510C98: type=Dem_EventIdType, value=36
      port-api-option enable-take-address=true, indirect-api=false, port=Event_CTC_0x539855:
        port-arg-values:
          integer literal Event_CTC_0x539855: type=Dem_EventIdType, value=31
      port-api-option enable-take-address=true, indirect-api=false, port=Event_CTC_0x540C00:
        port-arg-values:
          integer literal Event_CTC_0x540C00: type=Dem_EventIdType, value=28
      port-api-option enable-take-address=true, indirect-api=false, port=Event_CTC_0x55668F:
        port-arg-values:
          integer literal Event_CTC_0x55668F: type=Dem_EventIdType, value=26
      port-api-option enable-take-address=true, indirect-api=false, port=Event_CTC_0x540D00:
        port-arg-values:
          integer literal Event_CTC_0x540D00: type=Dem_EventIdType, value=27
      port-api-option enable-take-address=true, indirect-api=false, port=Event_CTC_0x564404:
        port-arg-values:
          integer literal Event_CTC_0x564404: type=Dem_EventIdType, value=24
      port-api-option enable-take-address=true, indirect-api=false, port=Event_CTC_0x513662:
        port-arg-values:
          integer literal Event_CTC_0x513662: type=Dem_EventIdType, value=35
      port-api-option enable-take-address=true, indirect-api=false, port=Event_CTC_0x520DA2:
        port-arg-values:
          integer literal Event_CTC_0x520DA2: type=Dem_EventIdType, value=33
      port-api-option enable-take-address=true, indirect-api=false, port=Event_CTC_0x520E00:
        port-arg-values:
          integer literal Event_CTC_0x520E00: type=Dem_EventIdType, value=32
      port-api-option enable-take-address=true, indirect-api=false, port=Event_CTC_0xD31308:
        port-arg-values:
          integer literal Event_CTC_0xD31308: type=Dem_EventIdType, value=7
      port-api-option enable-take-address=true, indirect-api=false, port=Event_CTC_0xD30508:
        port-arg-values:
          integer literal Event_CTC_0xD30508: type=Dem_EventIdType, value=11
      port-api-option enable-take-address=true, indirect-api=false, port=Event_CTC_0xD30808:
        port-arg-values:
          integer literal Event_CTC_0xD30808: type=Dem_EventIdType, value=8
      port-api-option enable-take-address=true, indirect-api=false, port=Event_CTC_0xD31808:
        port-arg-values:
          integer literal Event_CTC_0xD31808: type=Dem_EventIdType, value=4
      port-api-option enable-take-address=true, indirect-api=false, port=Event_CTC_0xD31D08:
        port-arg-values:
          integer literal Event_CTC_0xD31D08: type=Dem_EventIdType, value=3
      port-api-option enable-take-address=true, indirect-api=false, port=OpCycle_DEM_IGNITION:
        port-arg-values:
          integer literal OpCycle_DEM_IGNITION: type=Dem_OperationCycleIdType, value=0
      port-api-option enable-take-address=true, indirect-api=false, port=OpCycle_DEM_OBD_DCY:
        port-arg-values:
          integer literal OpCycle_DEM_OBD_DCY: type=Dem_OperationCycleIdType, value=1
      port-api-option enable-take-address=true, indirect-api=false, port=OpCycle_DEM_POWER:
        port-arg-values:
          integer literal OpCycle_DEM_POWER: type=Dem_OperationCycleIdType, value=3
      port-api-option enable-take-address=true, indirect-api=false, port=OpCycle_DEM_WARMUP:
        port-arg-values:
          integer literal OpCycle_DEM_WARMUP: type=Dem_OperationCycleIdType, value=2
      port-api-option enable-take-address=true, indirect-api=false, port=IndStatus_ETATDA2:
        port-arg-values:
          integer literal IndStatus_ETATDA2: type=UInt8, value=0
    10 x runnable:
      Dem_MainFunction
        19 x sync call, all with timeout=0:
          OpCallCBDTCStatusChange_1cca4577: operation=CBDTCStatusChange_DemIf.DTCStatusChanged
          OpCallCBDTCStatusChange_5499af98: operation=CBDTCStatusChange_FaultLog.DTCStatusChanged
          OpCallCBValByDID_0xd401_c8141217: operation=CBValByDID_0xd401.GetDataValueByDataIdentifier
          OpCallCBValByDID_0xd403_0e1ba05f: operation=CBValByDID_0xd403.GetDataValueByDataIdentifier
          OpCallCBValByDID_0xd404_fc7da9e2: operation=CBValByDID_0xd404.GetDataValueByDataIdentifier
          OpCallCBValByDID_0xd405_9f7a70c6: operation=CBValByDID_0xd405.GetDataValueByDataIdentifier
          OpCallCBValByDID_0xd407_5975c28e: operation=CBValByDID_0xd407.GetDataValueByDataIdentifier
          OpCallCBValByDID_0xd408_05cf0e91: operation=CBValByDID_0xd408.GetDataValueByDataIdentifier
          OpCallCBValByDID_0xd409_66c8d7b5: operation=CBValByDID_0xd409.GetDataValueByDataIdentifier
          OpCallCBValByDID_0xd40b_9d65caa9: operation=CBValByDID_0xd40b.GetDataValueByDataIdentifier
          OpCallCBValByDID_0xd40c_fe62138d: operation=CBValByDID_0xd40c.GetDataValueByDataIdentifier
          OpCallCBValByDID_0xd40d_0c041a30: operation=CBValByDID_0xd40d.GetDataValueByDataIdentifier
          OpCallCBValByDID_0xd40f_ca0ba878: operation=CBValByDID_0xd40f.GetDataValueByDataIdentifier
          OpCallCBValByDID_0xd410_9773283b: operation=CBValByDID_0xd410.GetDataValueByDataIdentifier
          OpCallCBValByDID_0xd412_517c9a73: operation=CBValByDID_0xd412.GetDataValueByDataIdentifier
          OpCallCBValByDID_0xd414_c01d4aea: operation=CBValByDID_0xd414.GetDataValueByDataIdentifier
          OpCallCBValByDID_0xd415_a31a93ce: operation=CBValByDID_0xd415.GetDataValueByDataIdentifier
          OpCallCBValByDID_0xd418_39afed99: operation=CBValByDID_0xd418.GetDataValueByDataIdentifier
          OpCallCBValByDID_0xd41b_a10529a1: operation=CBValByDID_0xd41b.GetDataValueByDataIdentifier
      SetEventStatus: can-be-invoked-concurrently=true, symbol=Dem_SetEventStatus
      ResetEventStatus: can-be-invoked-concurrently=true, symbol=Dem_ResetEventStatus
      GetEventStatus: can-be-invoked-concurrently=true, symbol=Dem_GetEventStatus
      GetEventFailed: can-be-invoked-concurrently=true, symbol=Dem_GetEventFailed
      GetEventTested: can-be-invoked-concurrently=true, symbol=Dem_GetEventTested
      GetDTCOfEvent: can-be-invoked-concurrently=true, symbol=Dem_GetDTCOfEvent
      GetFaultDetectionCounter: can-be-invoked-concurrently=true, symbol=Dem_GetFaultDetectionCounter
      SetOperationCycleState: can-be-invoked-concurrently=true, symbol=Dem_SetOperationCycleState
      GetIndicatorStatus: can-be-invoked-concurrently=true, symbol=Dem_GetIndicatorStatus
  swc implementation DemImplementation: behavior=DemInternalBehavior
  service component type Dem: category=ServiceComponent
    52 x provide port:
      Event_CTC_0x563A8F: provided-interface=DiagnosticMonitor
      Event_CTC_0x540698: provided-interface=DiagnosticMonitor
      Event_CTC_0x540B16: provided-interface=DiagnosticMonitor
      Event_CTC_0x520901: provided-interface=DiagnosticMonitor
      Event_CTC_0xD00388: provided-interface=DiagnosticMonitor
      Event_CTC_0xD11887: provided-interface=DiagnosticMonitor
      Event_CTC_0xD21381: provided-interface=DiagnosticMonitor
      Event_CTC_0xD31382: provided-interface=DiagnosticMonitor
      Event_CTC_0xD31383: provided-interface=DiagnosticMonitor
      Event_CTC_0xD00008: provided-interface=DiagnosticMonitor
      Event_CTC_0xD10887: provided-interface=DiagnosticMonitor
      Event_CTC_0xD11387: provided-interface=DiagnosticMonitor
      Event_CTC_0xD20881: provided-interface=DiagnosticMonitor
      Event_CTC_0xD10587: provided-interface=DiagnosticMonitor
      Event_CTC_0xD20581: provided-interface=DiagnosticMonitor
      Event_CTC_0xD30582: provided-interface=DiagnosticMonitor
      Event_CTC_0xD30583: provided-interface=DiagnosticMonitor
      Event_CTC_0xD21881: provided-interface=DiagnosticMonitor
      Event_CTC_0xD11D87: provided-interface=DiagnosticMonitor
      Event_CTC_0xD21D81: provided-interface=DiagnosticMonitor
      Event_CTC_0xD31D82: provided-interface=DiagnosticMonitor
      Event_CTC_0xD31D83: provided-interface=DiagnosticMonitor
      Event_CTC_0x050192: provided-interface=DiagnosticMonitor
      Event_CTC_0x510A51: provided-interface=DiagnosticMonitor
      Event_CTC_0x510BA{1..3}: provided-interface=DiagnosticMonitor
      Event_CTC_0x510C01: provided-interface=DiagnosticMonitor
      Event_CTC_0x510C04: provided-interface=DiagnosticMonitor
      Event_CTC_0x510C1C: provided-interface=DiagnosticMonitor
      Event_CTC_0x510C43: provided-interface=DiagnosticMonitor
      Event_CTC_0x510C62: provided-interface=DiagnosticMonitor
      Event_CTC_0x510C96: provided-interface=DiagnosticMonitor
      Event_CTC_0x510C98: provided-interface=DiagnosticMonitor
      Event_CTC_0x539855: provided-interface=DiagnosticMonitor
      Event_CTC_0x540C00: provided-interface=DiagnosticMonitor
      Event_CTC_0x55668F: provided-interface=DiagnosticMonitor
      Event_CTC_0x540D00: provided-interface=DiagnosticMonitor
      Event_CTC_0x564404: provided-interface=DiagnosticMonitor
      Event_CTC_0x513662: provided-interface=DiagnosticMonitor
      Event_CTC_0x520DA2: provided-interface=DiagnosticMonitor
      Event_CTC_0x520E00: provided-interface=DiagnosticMonitor
      Event_CTC_0xD31308: provided-interface=DiagnosticMonitor
      Event_CTC_0xD30508: provided-interface=DiagnosticMonitor
      Event_CTC_0xD30808: provided-interface=DiagnosticMonitor
      Event_CTC_0xD31808: provided-interface=DiagnosticMonitor
      Event_CTC_0xD31D08: provided-interface=DiagnosticMonitor
      OpCycle_DEM_IGNITION: provided-interface=OperationCycle
      OpCycle_DEM_OBD_DCY: provided-interface=OperationCycle
      OpCycle_DEM_POWER: provided-interface=OperationCycle
      OpCycle_DEM_WARMUP: provided-interface=OperationCycle
      IndStatus_ETATDA2: provided-interface=IndicatorStatus
    19 x require port:
      CBDTCStatusChange_DemIf: required-interface=CallbackDTCStatusChange
      CBDTCStatusChange_FaultLog: required-interface=CallbackDTCStatusChange
      CBValByDID_0xd401: required-interface=CallbackGetDataValueByDataId
      CBValByDID_0xd{403..405}: required-interface=CallbackGetDataValueByDataId
      CBValByDID_0xd{407..409}: required-interface=CallbackGetDataValueByDataId
      CBValByDID_0xd40b: required-interface=CallbackGetDataValueByDataId
      CBValByDID_0xd40c: required-interface=CallbackGetDataValueByDataId
      CBValByDID_0xd40d: required-interface=CallbackGetDataValueByDataId
      CBValByDID_0xd40f: required-interface=CallbackGetDataValueByDataId
      CBValByDID_0xd410: required-interface=CallbackGetDataValueByDataId
      CBValByDID_0xd412: required-interface=CallbackGetDataValueByDataId
      CBValByDID_0xd414: required-interface=CallbackGetDataValueByDataId
      CBValByDID_0xd415: required-interface=CallbackGetDataValueByDataId
      CBValByDID_0xd418: required-interface=CallbackGetDataValueByDataId
      CBValByDID_0xd41b: required-interface=CallbackGetDataValueByDataId
package /PortInterface
  5 x client server interface, all with is-service=true:
    DiagnosticMonitor
      7 x operation:
        SetEventStatus: possible-error=[DiagnosticMonitor/E_NOT_OK, DiagnosticMonitor/DEM_E_QUEUE_OVERFLOW]
          arg EventStatus: type=Dem_EventStatusType, direction=IN
        ResetEventStatus: possible-error=[DiagnosticMonitor/E_NOT_OK, DiagnosticMonitor/DEM_E_QUEUE_OVERFLOW]
        GetEventStatus: possible-error=DiagnosticMonitor/E_NOT_OK
          arg EventStatus: type=Dem_EventStatusExtendedType, direction=OUT
        GetEventFailed: possible-error=DiagnosticMonitor/E_NOT_OK
          arg Failed: type=Boolean, direction=OUT
        GetEventTested: possible-error=DiagnosticMonitor/E_NOT_OK
          arg Failed: type=Boolean, direction=OUT
        GetDTCOfEvent: possible-error=[DiagnosticMonitor/E_NOT_OK, DEM_GET_DTCOFEVENT_WRONG_DTCKIND, DEM_GET_DTCOFEVENT_WRONG_EVENTID]
          arg DTCKind: type=Dem_DTCKindType, direction=IN
          arg DTC: type=Dem_DTCType, direction=OUT
        GetFaultDetectionCounter: possible-error=DiagnosticMonitor/E_NOT_OK
          arg EventIdFaultDetectionCounter: type=Dem_FaultDetectionCounterType, direction=OUT
      4 x error:
        E_NOT_OK: error-code=1
        DEM_GET_DTCOFEVENT_WRONG_DTCKIND: error-code=4
        DEM_GET_DTCOFEVENT_WRONG_EVENTID: error-code=5
        DEM_E_QUEUE_OVERFLOW: error-code=15
    OperationCycle
      operation SetOperationCycleState: possible-error=[OperationCycle/E_NOT_OK, OperationCycle/DEM_E_QUEUE_OVERFLOW]
        arg CycleState: type=Dem_OperationCycleStateType, direction=IN
      error E_NOT_OK: error-code=1
      error DEM_E_QUEUE_OVERFLOW: error-code=15
    IndicatorStatus
      operation GetIndicatorStatus: possible-error=IndicatorStatus/E_NOT_OK
        arg IndicatorStatus: type=Dem_IndicatorStatusType, direction=OUT
      error E_NOT_OK: error-code=1
    CallbackDTCStatusChange
      operation DTCStatusChanged: possible-error=CallbackDTCStatusChange/E_NOT_OK
        4 x arg, all with direction=IN:
          DTC: type=Dem_DTCType
          DTCKind: type=Dem_DTCKindType
          DTCStatusOld: type=Dem_DTCStatusMaskType
          DTCStatusNew: type=Dem_DTCStatusMaskType
      error E_NOT_OK: error-code=1
    CallbackGetDataValueByDataId
      operation GetDataValueByDataIdentifier: possible-error=CallbackGetDataValueByDataId/E_NOT_OK
        arg Data: type=Dem_MaxDataValueType, direction=INOUT
      error E_NOT_OK: error-code=1
package /DataType
  integer type Dem_EventIdType: lower-limit=0, upper-limit=255
  integer type Dem_EventStatusType: compu {0=DEM_EVENT_STATUS_PASSED, 1=DEM_EVENT_STATUS_FAILED, 2=DEM_EVENT_STATUS_PREPASSED, 3=DEM_EVENT_STATUS_PREFAILED}, lower-limit=0, upper-limit=255
  integer type Dem_EventStatusExtendedType: lower-limit=0, upper-limit=255
  integer type Dem_DTCKindType: compu {1=DEM_DTC_KIND_ALL_DTCS, 2=DEM_DTC_KIND_EMISSION_REL_DTCS}, lower-limit=1, upper-limit=2
  integer type Dem_DTCType: lower-limit=0, upper-limit=4294967295
  integer type Dem_InitMonitorKindType: compu {1=DEM_INIT_MONITOR_CLEAR, 2=DEM_INIT_MONITOR_RESTART}, lower-limit=0, upper-limit=2
  integer type Dem_DTCStatusMaskType: lower-limit=0, upper-limit=255
  integer type Dem_OperationCycleIdType: lower-limit=0, upper-limit=255
  integer type Dem_OperationCycleStateType: compu {1=DEM_CYCLE_STATE_START, 2=DEM_CYCLE_STATE_END}, lower-limit=1, upper-limit=2
  integer type Dem_IndicatorStatusType: compu {0=DEM_INDICATOR_OFF, 1=DEM_INDICATOR_CONTINUOUS, 2=DEM_INDICATOR_BLINKING, 3=DEM_INDICATOR_BLINK_CONT}, lower-limit=0, upper-limit=3
  integer type Dem_FaultDetectionCounterType: lower-limit=-128, upper-limit=127
  array type Dem_MaxDataValueType
    element Dem_MaxDataValueType: type=UInt8, max-number-of-elements=3
  array type Dem_MaxExtendedDataRecordType
    element Dem_MaxExtendedDataRecordType: type=UInt8, max-number-of-elements=1
  integer type Dem_SuppressDTCStatusType: compu {0=DEM_SUPPRESS_DTC_OFF, 1=DEM_SUPPRESS_DTC_ON}, lower-limit=0, upper-limit=1
