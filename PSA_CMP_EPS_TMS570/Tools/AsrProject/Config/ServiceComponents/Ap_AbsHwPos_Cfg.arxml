AUTOSAR XML (schema 321)
package /ComponentType
  application software component type Ap_AbsHwPos
  internal behavior Ap_AbsHwPos_InternalBehavior: component=Ap_AbsHwPos
  swc implementation Ap_AbsHwPos_Implementation: behavior=Ap_AbsHwPos_InternalBehavior
    code-descriptors:
      code Code: type=SRC
package /PortInterface
  client server interface WdgM_CheckpointReached: is-service=true
    operation CheckpointReached: possible-error=E_NOT_OK  # Indicates to the Watchdog Manager that a Checkpoint within a Supervised Entity has been reached.
    error E_NOT_OK: error-code=1
