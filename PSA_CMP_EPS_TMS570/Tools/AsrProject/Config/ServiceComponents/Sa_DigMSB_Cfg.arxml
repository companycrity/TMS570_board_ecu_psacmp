AUTOSAR XML (schema 321)
package /ComponentType
  sensor actuator software component type Sa_DigMSB
  internal behavior Sa_DigMSB_InternalBehavior: component=Sa_DigMSB
  swc implementation Sa_DigMSB_Implementation: behavior=Sa_DigMSB_InternalBehavior
    code-descriptors:
      code Code: type=SRC
package /PortInterface
  client server interface WdgM_CheckpointReached: is-service=true
    operation CheckpointReached: possible-error=E_NOT_OK  # Indicates to the Watchdog Manager that a Checkpoint within a Supervised Entity has been reached.
    error E_NOT_OK: error-code=1
