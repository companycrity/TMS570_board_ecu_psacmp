AUTOSAR XML (schema 3.0.1)
standard types defined: UInt8
package /ComponentType
  service component type EcuM: category=ServiceComponent
    provide port EcuMUsrCfg_EPS: provided-interface=StateRequest  # P-Port Prototype of EcuM for requesting and releasing RUN state for EcuM user 1.
  swc implementation EcuMImpl: behavior=EcuMBehave
  internal behavior EcuMBehave: component=EcuM
    5 x operation invoked event:
      V_ECUM_SR1002_REQUEST_RUN: start-on-event=RequestRUN, operation=EcuMUsrCfg_EPS.RequestRUN
      V_ECUM_SR1002_RELEASE_RUN: start-on-event=ReleaseRUN, operation=EcuMUsrCfg_EPS.ReleaseRUN
      V_ECUM_SR1002_REQUEST_POST_RUN: start-on-event=RequestPOSTRUN, operation=EcuMUsrCfg_EPS.RequestPOSTRUN
      V_ECUM_SR1002_RELEASE_POST_RUN: start-on-event=ReleasePOSTRUN, operation=EcuMUsrCfg_EPS.ReleasePOSTRUN
      V_ECUM_SR1002_GET_STATE: start-on-event=GetState, operation=EcuMUsrCfg_EPS.GetState
    port-api-option port=EcuMUsrCfg_EPS:
      port-arg-values:
        integer literal EcuMUsrCfg_EPS: type=EcuM_UserType, value=1
    5 x runnable, all with can-be-invoked-concurrently=true:
      RequestRUN: symbol=EcuM_RequestRUN
      ReleaseRUN: symbol=EcuM_ReleaseRUN
      RequestPOSTRUN: symbol=EcuM_RequestPOST_RUN
      ReleasePOSTRUN: symbol=EcuM_ReleasePOST_RUN
      GetState: symbol=EcuM_GetStateWrapper
package /PortInterface
  client server interface StateRequest: is-service=true
    5 x operation, all with possible-error=E_NOT_OK:
      RequestRUN
      ReleaseRUN
      RequestPOSTRUN
      ReleasePOSTRUN
      GetState
        arg state: type=EcuM_StateType, direction=OUT
    error E_NOT_OK: error-code=1
package /DataType
  integer type EcuM_UserType: lower-limit=0, upper-limit=255
  integer type EcuM_StateType:
    compu {16=ECUM_STATE_STARTUP, 17=ECUM_STATE_STARTUP_ONE, 18=ECUM_STATE_STARTUP_TWO, 32=ECUM_STATE_WAKEUP, 33=ECUM_STATE_WAKEUP_ONE, 34=ECUM_STATE_WAKEUP_VALIDATION, 35=ECUM_STATE_WAKEUP_REACTION, 36=ECUM_STATE_WAKEUP_TWO, 37=ECUM_STATE_WAKEUP_WAKESLEEP, 38=ECUM_STATE_WAKEUP_TTII, 48=ECUM_STATE_RUN, 50=ECUM_STATE_APP_RUN, 51=ECUM_STATE_APP_POST_RUN, 64=ECUM_STATE_SHUTDOWN, 68=ECUM_STATE_PREP_SHUTDOWN, 73=ECUM_STATE_GO_SLEEP, 77=ECUM_STATE_GO_OFF_ONE, 78=ECUM_STATE_GO_OFF_TWO, 80=ECUM_STATE_SLEEP, 128=ECUM_STATE_OFF, 144=ECUM_STATE_RESET, 255=ECUM_STATE_ERROR}
    lower-limit=16
    upper-limit=255
