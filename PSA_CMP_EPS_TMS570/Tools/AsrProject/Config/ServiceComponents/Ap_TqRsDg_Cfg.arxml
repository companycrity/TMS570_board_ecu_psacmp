AUTOSAR XML (schema 321)
package /ComponentType
  application software component type Ap_TqRsDg
  internal behavior Ap_TqRsDg_InternalBehavior: component=Ap_TqRsDg
  swc implementation Ap_TqRsDg_Implementation: behavior=Ap_TqRsDg_InternalBehavior
    code-descriptors:
      code Code: type=SRC
package /PortInterface
  client server interface WdgM_CheckpointReached: is-service=true
    operation CheckpointReached: possible-error=E_NOT_OK  # Indicates to the Watchdog Manager that a Checkpoint within a Supervised Entity has been reached.
    error E_NOT_OK: error-code=1
