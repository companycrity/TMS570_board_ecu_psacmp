AUTOSAR XML (schema 321)
package /ComponentType
  application software component type Ap_EOTActuatorMng
  internal behavior Ap_EOTActuatorMng_InternalBehavior: component=Ap_EOTActuatorMng
  swc implementation Ap_EOTActuatorMng_Implementation: behavior=Ap_EOTActuatorMng_InternalBehavior
    code-descriptors:
      code Code: type=SRC
package /PortInterface
  client server interface WdgM_CheckpointReached: is-service=true
    operation CheckpointReached: possible-error=E_NOT_OK  # Indicates to the Watchdog Manager that a Checkpoint within a Supervised Entity has been reached.
    error E_NOT_OK: error-code=1
