AUTOSAR XML (schema 321)
package /ComponentType
  sensor actuator software component type Sa_DigHwTrqSENT
  internal behavior Sa_DigHwTrqSENT_InternalBehavior: component=Sa_DigHwTrqSENT
  swc implementation Sa_DigHwTrqSENT_Implementation: behavior=Sa_DigHwTrqSENT_InternalBehavior
    code-descriptors:
      code Code: type=SRC
package /PortInterface
  client server interface WdgM_CheckpointReached: is-service=true
    operation CheckpointReached: possible-error=E_NOT_OK  # Indicates to the Watchdog Manager that a Checkpoint within a Supervised Entity has been reached.
    error E_NOT_OK: error-code=1
