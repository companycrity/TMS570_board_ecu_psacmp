AUTOSAR XML (schema 314)
package /DaVinci
  ecu configuration EPS: ecu-extract=EPS, ecu-sw-composition=EcuSwComposition
package /DaVinci/PKG_ECU
  ecu instance EPS: com-processing-period=0.001, diagnostic-address=0, sleep-mode-supported=false, wake-up-over-bus-supported=false
package /ECUComposition
  ecu sw composition EcuSwComposition: ecu-extract=EPS
    5 x service component prototype:
      CDD: service-component=CDD
      Dem: service-component=Dem
      NexteerLibs: service-component=NexteerLibs
      NvMProxy: service-component=NvMProxy
      WdgM: service-component=WdgM
    service connector prototype NvMProxy_PS_NvMP_NvmBlock_EOLVehCntrOffset_AbsHwPos_EOLVehCntrOffset: application-port=ECU_Composition.AbsHwPos.EOLVehCntrOffset, service-port=NvMProxy.PS_NvMP_NvmBlock_EOLVehCntrOffset
    service connector prototype NvMProxy_PS_NvMP_NvmBlock_PullCmpLTComp_ActivePull_PullCmpLTComp: application-port=ECU_Composition.ActivePull.PullCmpLTComp, service-port=NvMProxy.PS_NvMP_NvmBlock_PullCmpLTComp
    service connector prototype NexteerLibs_SystemTime_ActivePull_SystemTime: application-port=ECU_Composition.ActivePull.SystemTime, service-port=NexteerLibs.SystemTime
    service connector prototype NvMProxy_PS_NvMP_NvmBlock_Polarity_Ap_CtrlPolarityBrshlss_Polarity: application-port=ECU_Composition.Ap_CtrlPolarityBrshlss.Polarity, service-port=NvMProxy.PS_NvMP_NvmBlock_Polarity
    service connector prototype NvMProxy_PS_NvMP_NvmBlock_AvgFricLrnData_AvgFricLrn_AvgFricLrnData: application-port=ECU_Composition.AvgFricLrn.AvgFricLrnData, service-port=NvMProxy.PS_NvMP_NvmBlock_AvgFricLrnData
    service connector prototype NexteerLibs_SystemTime_AvgFricLrn_SystemTime: application-port=ECU_Composition.AvgFricLrn.SystemTime, service-port=NexteerLibs.SystemTime
    service connector prototype NvMProxy_PS_NvMP_NvmBlock_OvervoltageData_BatteryVoltage_OvervoltageData: application-port=ECU_Composition.BatteryVoltage.OvervoltageData, service-port=NvMProxy.PS_NvMP_NvmBlock_OvervoltageData
    service connector prototype NexteerLibs_SystemTime_BatteryVoltage_SystemTime: application-port=ECU_Composition.BatteryVoltage.SystemTime, service-port=NexteerLibs.SystemTime
    service connector prototype NexteerLibs_SystemTime_BkCpPc_SystemTime: application-port=ECU_Composition.BkCpPc.SystemTime, service-port=NexteerLibs.SystemTime
    service connector prototype NexteerLibs_SystemTime_BVDiag_SystemTime: application-port=ECU_Composition.BVDiag.SystemTime, service-port=NexteerLibs.SystemTime
    service connector prototype CDD_CDDPorts_CDDInterface6_CDDPorts: application-port=ECU_Composition.CDDInterface6.CDDPorts, service-port=CDD.CDDPorts
    service connector prototype CDD_CDDPorts_CDDInterface9_CDDPorts: application-port=ECU_Composition.CDDInterface9.CDDPorts, service-port=CDD.CDDPorts
    service connector prototype WdgM_SE012_SE_100ms_10_CP001_ChkPtAp10_100msEnd_CP_ChkPtAp10_ChkPtAp10_100msEnd_CP: application-port=ECU_Composition.ChkPtAp10.ChkPtAp10_100msEnd_CP, service-port=WdgM.SE012_SE_100ms_10_CP001_ChkPtAp10_100msEnd_CP
    service connector prototype WdgM_SE012_SE_100ms_10_CP000_ChkPtAp10_100msStart_CP_ChkPtAp10_ChkPtAp10_100msStart_CP: application-port=ECU_Composition.ChkPtAp10.ChkPtAp10_100msStart_CP, service-port=WdgM.SE012_SE_100ms_10_CP000_ChkPtAp10_100msStart_CP
    service connector prototype WdgM_SE007_SE_10ms_10a_CP001_ChkPtAp10_10msaEnd_CP_ChkPtAp10_ChkPtAp10_10msaEnd_CP: application-port=ECU_Composition.ChkPtAp10.ChkPtAp10_10msaEnd_CP, service-port=WdgM.SE007_SE_10ms_10a_CP001_ChkPtAp10_10msaEnd_CP
    service connector prototype WdgM_SE007_SE_10ms_10a_CP000_ChkPtAp10_10msaStart_CP_ChkPtAp10_ChkPtAp10_10msaStart_CP: application-port=ECU_Composition.ChkPtAp10.ChkPtAp10_10msaStart_CP, service-port=WdgM.SE007_SE_10ms_10a_CP000_ChkPtAp10_10msaStart_CP
    service connector prototype WdgM_SE009_SE_10ms_10b_CP001_ChkPtAp10_10msbEnd_CP_ChkPtAp10_ChkPtAp10_10msbEnd_CP: application-port=ECU_Composition.ChkPtAp10.ChkPtAp10_10msbEnd_CP, service-port=WdgM.SE009_SE_10ms_10b_CP001_ChkPtAp10_10msbEnd_CP
    service connector prototype WdgM_SE009_SE_10ms_10b_CP000_ChkPtAp10_10msbStart_CP_ChkPtAp10_ChkPtAp10_10msbStart_CP: application-port=ECU_Composition.ChkPtAp10.ChkPtAp10_10msbStart_CP, service-port=WdgM.SE009_SE_10ms_10b_CP000_ChkPtAp10_10msbStart_CP
    service connector prototype WdgM_SE001_SE_2ms_10_CP001_ChkPtAp10_2msEnd_CP_ChkPtAp10_ChkPtAp10_2msEnd_CP: application-port=ECU_Composition.ChkPtAp10.ChkPtAp10_2msEnd_CP, service-port=WdgM.SE001_SE_2ms_10_CP001_ChkPtAp10_2msEnd_CP
    service connector prototype WdgM_SE001_SE_2ms_10_CP000_ChkPtAp10_2msStart_CP_ChkPtAp10_ChkPtAp10_2msStart_CP: application-port=ECU_Composition.ChkPtAp10.ChkPtAp10_2msStart_CP, service-port=WdgM.SE001_SE_2ms_10_CP000_ChkPtAp10_2msStart_CP
    service connector prototype WdgM_SE005_SE_4ms_10_CP001_ChkPtAp10_4msEnd_CP_ChkPtAp10_ChkPtAp10_4msEnd_CP: application-port=ECU_Composition.ChkPtAp10.ChkPtAp10_4msEnd_CP, service-port=WdgM.SE005_SE_4ms_10_CP001_ChkPtAp10_4msEnd_CP
    service connector prototype WdgM_SE005_SE_4ms_10_CP000_ChkPtAp10_4msStart_CP_ChkPtAp10_ChkPtAp10_4msStart_CP: application-port=ECU_Composition.ChkPtAp10.ChkPtAp10_4msStart_CP, service-port=WdgM.SE005_SE_4ms_10_CP000_ChkPtAp10_4msStart_CP
    service connector prototype WdgM_SE013_SE_100ms_11_CP001_ChkPtAp11_100msEnd_CP_ChkPtAp11_ChkPtAp11_100msEnd_CP: application-port=ECU_Composition.ChkPtAp11.ChkPtAp11_100msEnd_CP, service-port=WdgM.SE013_SE_100ms_11_CP001_ChkPtAp11_100msEnd_CP
    service connector prototype WdgM_SE013_SE_100ms_11_CP000_ChkPtAp11_100msStart_CP_ChkPtAp11_ChkPtAp11_100msStart_CP: application-port=ECU_Composition.ChkPtAp11.ChkPtAp11_100msStart_CP, service-port=WdgM.SE013_SE_100ms_11_CP000_ChkPtAp11_100msStart_CP
    service connector prototype WdgM_SE010_SE_10ms_11_CP001_ChkPtAp11_10msEnd_CP_ChkPtAp11_ChkPtAp11_10msEnd_CP: application-port=ECU_Composition.ChkPtAp11.ChkPtAp11_10msEnd_CP, service-port=WdgM.SE010_SE_10ms_11_CP001_ChkPtAp11_10msEnd_CP
    service connector prototype WdgM_SE010_SE_10ms_11_CP000_ChkPtAp11_10msStart_CP_ChkPtAp11_ChkPtAp11_10msStart_CP: application-port=ECU_Composition.ChkPtAp11.ChkPtAp11_10msStart_CP, service-port=WdgM.SE010_SE_10ms_11_CP000_ChkPtAp11_10msStart_CP
    service connector prototype WdgM_SE002_SE_2ms_11_CP001_ChkPtAp11_2msEnd_CP_ChkPtAp11_ChkPtAp11_2msEnd_CP: application-port=ECU_Composition.ChkPtAp11.ChkPtAp11_2msEnd_CP, service-port=WdgM.SE002_SE_2ms_11_CP001_ChkPtAp11_2msEnd_CP
    service connector prototype WdgM_SE002_SE_2ms_11_CP000_ChkPtAp11_2msStart_CP_ChkPtAp11_ChkPtAp11_2msStart_CP: application-port=ECU_Composition.ChkPtAp11.ChkPtAp11_2msStart_CP, service-port=WdgM.SE002_SE_2ms_11_CP000_ChkPtAp11_2msStart_CP
    service connector prototype WdgM_SE014_SE_100ms_6_CP001_ChkPtAp6_100msEnd_CP_ChkPtAp6_ChkPtAp6_100msEnd_CP: application-port=ECU_Composition.ChkPtAp6.ChkPtAp6_100msEnd_CP, service-port=WdgM.SE014_SE_100ms_6_CP001_ChkPtAp6_100msEnd_CP
    service connector prototype WdgM_SE014_SE_100ms_6_CP000_ChkPtAp6_100msStart_CP_ChkPtAp6_ChkPtAp6_100msStart_CP: application-port=ECU_Composition.ChkPtAp6.ChkPtAp6_100msStart_CP, service-port=WdgM.SE014_SE_100ms_6_CP000_ChkPtAp6_100msStart_CP
    service connector prototype WdgM_SE008_SE_10ms_6_CP001_ChkPtAp6_10msEnd_CP_ChkPtAp6_ChkPtAp6_10msEnd_CP: application-port=ECU_Composition.ChkPtAp6.ChkPtAp6_10msEnd_CP, service-port=WdgM.SE008_SE_10ms_6_CP001_ChkPtAp6_10msEnd_CP
    service connector prototype WdgM_SE008_SE_10ms_6_CP000_ChkPtAp6_10msStart_CP_ChkPtAp6_ChkPtAp6_10msStart_CP: application-port=ECU_Composition.ChkPtAp6.ChkPtAp6_10msStart_CP, service-port=WdgM.SE008_SE_10ms_6_CP000_ChkPtAp6_10msStart_CP
    service connector prototype WdgM_SE003_SE_2ms_6_CP001_ChkPtAp6_2msEnd_CP_ChkPtAp6_ChkPtAp6_2msEnd_CP: application-port=ECU_Composition.ChkPtAp6.ChkPtAp6_2msEnd_CP, service-port=WdgM.SE003_SE_2ms_6_CP001_ChkPtAp6_2msEnd_CP
    service connector prototype WdgM_SE003_SE_2ms_6_CP000_ChkPtAp6_2msStart_CP_ChkPtAp6_ChkPtAp6_2msStart_CP: application-port=ECU_Composition.ChkPtAp6.ChkPtAp6_2msStart_CP, service-port=WdgM.SE003_SE_2ms_6_CP000_ChkPtAp6_2msStart_CP
    service connector prototype WdgM_SE011_SE_100ms_9_CP001_ChkPtAp9_100msEnd_CP_ChkPtAp9_ChkPtAp9_100msEnd_CP: application-port=ECU_Composition.ChkPtAp9.ChkPtAp9_100msEnd_CP, service-port=WdgM.SE011_SE_100ms_9_CP001_ChkPtAp9_100msEnd_CP
    service connector prototype WdgM_SE011_SE_100ms_9_CP000_ChkPtAp9_100msStart_CP_ChkPtAp9_ChkPtAp9_100msStart_CP: application-port=ECU_Composition.ChkPtAp9.ChkPtAp9_100msStart_CP, service-port=WdgM.SE011_SE_100ms_9_CP000_ChkPtAp9_100msStart_CP
    service connector prototype WdgM_SE006_SE_10ms_9_CP001_ChkPtAp9_10msEnd_CP_ChkPtAp9_ChkPtAp9_10msEnd_CP: application-port=ECU_Composition.ChkPtAp9.ChkPtAp9_10msEnd_CP, service-port=WdgM.SE006_SE_10ms_9_CP001_ChkPtAp9_10msEnd_CP
    service connector prototype WdgM_SE006_SE_10ms_9_CP000_ChkPtAp9_10msStart_CP_ChkPtAp9_ChkPtAp9_10msStart_CP: application-port=ECU_Composition.ChkPtAp9.ChkPtAp9_10msStart_CP, service-port=WdgM.SE006_SE_10ms_9_CP000_ChkPtAp9_10msStart_CP
    service connector prototype WdgM_SE000_SE_2ms_9_CP001_ChkPtAp9_2msEnd_CP_ChkPtAp9_ChkPtAp9_2msEnd_CP: application-port=ECU_Composition.ChkPtAp9.ChkPtAp9_2msEnd_CP, service-port=WdgM.SE000_SE_2ms_9_CP001_ChkPtAp9_2msEnd_CP
    service connector prototype WdgM_SE000_SE_2ms_9_CP000_ChkPtAp9_2msStart_CP_ChkPtAp9_ChkPtAp9_2msStart_CP: application-port=ECU_Composition.ChkPtAp9.ChkPtAp9_2msStart_CP, service-port=WdgM.SE000_SE_2ms_9_CP000_ChkPtAp9_2msStart_CP
    service connector prototype WdgM_SE004_SE_4ms_9_CP001_ChkPtAp9_4msEnd_CP_ChkPtAp9_ChkPtAp9_4msEnd_CP: application-port=ECU_Composition.ChkPtAp9.ChkPtAp9_4msEnd_CP, service-port=WdgM.SE004_SE_4ms_9_CP001_ChkPtAp9_4msEnd_CP
    service connector prototype WdgM_SE004_SE_4ms_9_CP000_ChkPtAp9_4msStart_CP_ChkPtAp9_ChkPtAp9_4msStart_CP: application-port=ECU_Composition.ChkPtAp9.ChkPtAp9_4msStart_CP, service-port=WdgM.SE004_SE_4ms_9_CP000_ChkPtAp9_4msStart_CP
    service connector prototype NvMProxy_PS_NvMP_NvmBlock_CurrTempOffset_CmMtrCurr_EOLCurrTempOffset: application-port=ECU_Composition.CmMtrCurr.EOLCurrTempOffset, service-port=NvMProxy.PS_NvMP_NvmBlock_CurrTempOffset
    service connector prototype NvMProxy_PS_NvMP_NvmBlock_ShCurrCal_CmMtrCurr_EOLShCurrCal: application-port=ECU_Composition.CmMtrCurr.EOLShCurrCal, service-port=NvMProxy.PS_NvMP_NvmBlock_ShCurrCal
    service connector prototype NexteerLibs_SystemTime_ComplErr_SystemTime: application-port=ECU_Composition.ComplErr.SystemTime, service-port=NexteerLibs.SystemTime
    service connector prototype NvMProxy_PS_NvMP_NvmBlock_EOLNomMtrParam_CurrParamComp_EOLNomMtrParamBlk: application-port=ECU_Composition.CurrParamComp.EOLNomMtrParamBlk, service-port=NvMProxy.PS_NvMP_NvmBlock_EOLNomMtrParam
    service connector prototype NexteerLibs_SystemTime_CustBattDiag_SystemTime: application-port=ECU_Composition.CustBattDiag.SystemTime, service-port=NexteerLibs.SystemTime
    service connector prototype Dem_CBDTCStatusChange_DemIf_DemIf_DTCStatusChange: application-port=ECU_Composition.DemIf.DTCStatusChange, service-port=Dem.CBDTCStatusChange_DemIf
    service connector prototype NexteerLibs_SystemTime_DemIf_SystemTime: application-port=ECU_Composition.DemIf.SystemTime, service-port=NexteerLibs.SystemTime
    service connector prototype Dem_CBValByDID_0xd401_DiagSvc_CBValByDID_0xd401: application-port=ECU_Composition.DiagSvc.CBValByDID_0xd401, service-port=Dem.CBValByDID_0xd401
    service connector prototype Dem_CBValByDID_0xd{403..405}_DiagSvc_CBValByDID_0xd{403..405}: application-port=ECU_Composition.DiagSvc.CBValByDID_0xd{403..405}, service-port=Dem.CBValByDID_0xd{403..405}
    service connector prototype Dem_CBValByDID_0xd{407..409}_DiagSvc_CBValByDID_0xd{407..409}: application-port=ECU_Composition.DiagSvc.CBValByDID_0xd{407..409}, service-port=Dem.CBValByDID_0xd{407..409}
    service connector prototype Dem_CBValByDID_0xd40b_DiagSvc_CBValByDID_0xd40b: application-port=ECU_Composition.DiagSvc.CBValByDID_0xd40b, service-port=Dem.CBValByDID_0xd40b
    service connector prototype Dem_CBValByDID_0xd40c_DiagSvc_CBValByDID_0xd40c: application-port=ECU_Composition.DiagSvc.CBValByDID_0xd40c, service-port=Dem.CBValByDID_0xd40c
    service connector prototype Dem_CBValByDID_0xd40d_DiagSvc_CBValByDID_0xd40d: application-port=ECU_Composition.DiagSvc.CBValByDID_0xd40d, service-port=Dem.CBValByDID_0xd40d
    service connector prototype Dem_CBValByDID_0xd40f_DiagSvc_CBValByDID_0xd40f: application-port=ECU_Composition.DiagSvc.CBValByDID_0xd40f, service-port=Dem.CBValByDID_0xd40f
    service connector prototype Dem_CBValByDID_0xd410_DiagSvc_CBValByDID_0xd410: application-port=ECU_Composition.DiagSvc.CBValByDID_0xd410, service-port=Dem.CBValByDID_0xd410
    service connector prototype Dem_CBValByDID_0xd412_DiagSvc_CBValByDID_0xd412: application-port=ECU_Composition.DiagSvc.CBValByDID_0xd412, service-port=Dem.CBValByDID_0xd412
    service connector prototype Dem_CBValByDID_0xd414_DiagSvc_CBValByDID_0xd414: application-port=ECU_Composition.DiagSvc.CBValByDID_0xd414, service-port=Dem.CBValByDID_0xd414
    service connector prototype Dem_CBValByDID_0xd415_DiagSvc_CBValByDID_0xd415: application-port=ECU_Composition.DiagSvc.CBValByDID_0xd415, service-port=Dem.CBValByDID_0xd415
    service connector prototype Dem_CBValByDID_0xd418_DiagSvc_CBValByDID_0xd418: application-port=ECU_Composition.DiagSvc.CBValByDID_0xd418, service-port=Dem.CBValByDID_0xd418
    service connector prototype Dem_CBValByDID_0xd41b_DiagSvc_CBValByDID_0xd41b: application-port=ECU_Composition.DiagSvc.CBValByDID_0xd41b, service-port=Dem.CBValByDID_0xd41b
    service connector prototype Dem_IndStatus_ETATDA2_DiagSvc_LampStatus: application-port=ECU_Composition.DiagSvc.LampStatus, service-port=Dem.IndStatus_ETATDA2
    service connector prototype Dem_CBDTCStatusChange_FaultLog_FaultLog_CallbackDTCStatusChange: application-port=ECU_Composition.FaultLog.CallbackDTCStatusChange, service-port=Dem.CBDTCStatusChange_FaultLog
    service connector prototype NexteerLibs_SystemTime_FaultLog_SystemTime: application-port=ECU_Composition.FaultLog.SystemTime, service-port=NexteerLibs.SystemTime
    service connector prototype NexteerLibs_SystemTime_FltInjection_SystemTime: application-port=ECU_Composition.FltInjection.SystemTime, service-port=NexteerLibs.SystemTime
    service connector prototype NvMProxy_PS_NvMP_NvmBlock_HwTqArbnEOLCh1OffsetTrimData_HwTqArbn_HwTqArbnEOLCh1OffsetTrim: application-port=ECU_Composition.HwTqArbn.HwTqArbnEOLCh1OffsetTrim, service-port=NvMProxy.PS_NvMP_NvmBlock_HwTqArbnEOLCh1OffsetTrimData
    service connector prototype NvMProxy_PS_NvMP_NvmBlock_HwTqCorrlnCh1CMCLPFSvData_HwTqCorrln_HwTqCorrlnCh1CMCLPFSvBlk: application-port=ECU_Composition.HwTqCorrln.HwTqCorrlnCh1CMCLPFSvBlk, service-port=NvMProxy.PS_NvMP_NvmBlock_HwTqCorrlnCh1CMCLPFSvData
    service connector prototype NvMProxy_PS_NvMP_NvmBlock_LearnedEOT_LrnEOT_LearnedEOTData: application-port=ECU_Composition.LrnEOT.LearnedEOTData, service-port=NvMProxy.PS_NvMP_NvmBlock_LearnedEOT
    service connector prototype NexteerLibs_SystemTime_LrnEOT_SystemTime: application-port=ECU_Composition.LrnEOT.SystemTime, service-port=NexteerLibs.SystemTime
    service connector prototype NexteerLibs_SystemTime_MtrDrvDiag_SystemTime: application-port=ECU_Composition.MtrDrvDiag.SystemTime, service-port=NexteerLibs.SystemTime
    service connector prototype NvMProxy_PS_NvMP_NvmBlock_PsaAgArbnPsaAgArbnLrndOffsData_PsaAgArbn_PsaAgArbnLrndOffsBlk: application-port=ECU_Composition.PsaAgArbn.PsaAgArbnLrndOffsBlk, service-port=NvMProxy.PS_NvMP_NvmBlock_PsaAgArbnPsaAgArbnLrndOffsData
    service connector prototype NexteerLibs_SystemTime_PsaAgArbn_SystemTime: application-port=ECU_Composition.PsaAgArbn.SystemTime, service-port=NexteerLibs.SystemTime
    service connector prototype NexteerLibs_SystemTime_PSASH_SystemTime: application-port=ECU_Composition.PSASH.SystemTime, service-port=NexteerLibs.SystemTime
    service connector prototype NexteerLibs_SystemTime_PwrLmtFuncCr_SystemTime: application-port=ECU_Composition.PwrLmtFuncCr.SystemTime, service-port=NexteerLibs.SystemTime
    service connector prototype NvMProxy_PS_NvMP_NvmBlock_AvgFricLrnData_SrlComDriver_AvgFricLrnData: application-port=ECU_Composition.SrlComDriver.AvgFricLrnData, service-port=NvMProxy.PS_NvMP_NvmBlock_AvgFricLrnData
    service connector prototype NvMProxy_PS_NvMP_NvmBlock_LearnedEOT_SrlComDriver_LearnedEOT: application-port=ECU_Composition.SrlComDriver.LearnedEOT, service-port=NvMProxy.PS_NvMP_NvmBlock_LearnedEOT
    service connector prototype NvMProxy_PS_NvMP_NvmBlock_MotPosReset_SrlComDriver_MotPosReset: application-port=ECU_Composition.SrlComDriver.MotPosReset, service-port=NvMProxy.PS_NvMP_NvmBlock_MotPosReset
    service connector prototype NvMProxy_PS_NvMP_NvmBlock_PsaAgArbnPsaAgArbnLrndOffsData_SrlComDriver_PsaAgArbnLrndOffsBlk: application-port=ECU_Composition.SrlComDriver.PsaAgArbnLrndOffsBlk, service-port=NvMProxy.PS_NvMP_NvmBlock_PsaAgArbnPsaAgArbnLrndOffsData
    service connector prototype NexteerLibs_SystemTime_SrlComDriver_SystemTime: application-port=ECU_Composition.SrlComDriver.SystemTime, service-port=NexteerLibs.SystemTime
    service connector prototype NvMProxy_PS_NvMP_NvmBlock_ElecIntData_SrlComInput_ElecInt: application-port=ECU_Composition.SrlComInput.ElecInt, service-port=NvMProxy.PS_NvMP_NvmBlock_ElecIntData
    service connector prototype NvMProxy_PS_NvMP_NvmBlock_ShutdownTimeData_SrlComInput_ShutdownTime: application-port=ECU_Composition.SrlComInput.ShutdownTime, service-port=NvMProxy.PS_NvMP_NvmBlock_ShutdownTimeData
    service connector prototype NexteerLibs_SystemTime_SrlComInput_SystemTime: application-port=ECU_Composition.SrlComInput.SystemTime, service-port=NexteerLibs.SystemTime
    service connector prototype NvMProxy_PS_NvMP_NvmBlock_VVHTYPEData_SrlComInput_VHHTYPE: application-port=ECU_Composition.SrlComInput.VHHTYPE, service-port=NvMProxy.PS_NvMP_NvmBlock_VVHTYPEData
    service connector prototype Dem_IndStatus_ETATDA2_SrlComOutput_IndStatusETATDA2: application-port=ECU_Composition.SrlComOutput.IndStatusETATDA2, service-port=Dem.IndStatus_ETATDA2
    service connector prototype NexteerLibs_SystemTime_SrlComOutput_SystemTime: application-port=ECU_Composition.SrlComOutput.SystemTime, service-port=NexteerLibs.SystemTime
    service connector prototype NvMProxy_PS_NvMP_NvmBlock_CloseCheckData_StaMd_CloseCheckData: application-port=ECU_Composition.StaMd.CloseCheckData, service-port=NvMProxy.PS_NvMP_NvmBlock_CloseCheckData
    service connector prototype NvMProxy_PS_NvMP_NvmBlock_TypeHRamBuffer_StaMd_TypeHData: application-port=ECU_Composition.StaMd.TypeHData, service-port=NvMProxy.PS_NvMP_NvmBlock_TypeHRamBuffer
    service connector prototype NexteerLibs_SystemTime_StOpCtrl_SystemTime: application-port=ECU_Composition.StOpCtrl.SystemTime, service-port=NexteerLibs.SystemTime
    service connector prototype NexteerLibs_SystemTime_Sweep_SystemTime: application-port=ECU_Composition.Sweep.SystemTime, service-port=NexteerLibs.SystemTime
    service connector prototype NvMProxy_PS_NvMP_NvmBlock_FltStVal_ThrmlDutyCycle_ThrmlDutyCycle_FltStVar: application-port=ECU_Composition.ThrmlDutyCycle.ThrmlDutyCycle_FltStVar, service-port=NvMProxy.PS_NvMP_NvmBlock_FltStVal
    service connector prototype NexteerLibs_SystemTime_TmprlMon_SystemTime: application-port=ECU_Composition.TmprlMon.SystemTime, service-port=NexteerLibs.SystemTime
    service connector prototype NexteerLibs_SystemTime_TmprlMon2_SystemTime: application-port=ECU_Composition.TmprlMon2.SystemTime, service-port=NexteerLibs.SystemTime
    service connector prototype NexteerLibs_SystemTime_TranlDampg_SystemTime: application-port=ECU_Composition.TranlDampg.SystemTime, service-port=NexteerLibs.SystemTime
    service connector prototype NvMProxy_PS_NvMP_NvmBlock_CogTrqCal_TrqCanc_EOLCogTrqCanc: application-port=ECU_Composition.TrqCanc.EOLCogTrqCanc, service-port=NvMProxy.PS_NvMP_NvmBlock_CogTrqCal
    service connector prototype NvMProxy_PS_NvMP_NvmBlock_CogTrqRplComp_TrqCanc_EOLCogTrqRplComp: application-port=ECU_Composition.TrqCanc.EOLCogTrqRplComp, service-port=NvMProxy.PS_NvMP_NvmBlock_CogTrqRplComp
    service connector prototype NvMProxy_PS_NvMP_NvmBlock_TorqueCmdSF_TrqCmdScl_TrqCmdScl: application-port=ECU_Composition.TrqCmdScl.TrqCmdScl, service-port=NvMProxy.PS_NvMP_NvmBlock_TorqueCmdSF
    service connector prototype NvMProxy_PS_NvMP_NvmBlock_MotPosReset_VehDyn_NVM_VehDynReset_Srv: application-port=ECU_Composition.VehDyn.NVM_VehDynReset_Srv, service-port=NvMProxy.PS_NvMP_NvmBlock_MotPosReset
    service connector prototype NexteerLibs_SystemTime_VehDyn_SystemTime: application-port=ECU_Composition.VehDyn.SystemTime, service-port=NexteerLibs.SystemTime
    service connector prototype NexteerLibs_SystemTime_VehPwrMd_SystemTime: application-port=ECU_Composition.VehPwrMd.SystemTime, service-port=NexteerLibs.SystemTime
package /ECUCompositionType
  composition type ECU_Composition
    107 x component:
      AbsHwPos: type=Ap_AbsHwPos
      ActivePull: type=Ap_ActivePull
      Ap_CtrlPolarityBrshlss: type=Ap_CtrlPolarityBrshlss
      ApXcp: type=Ap_ApXcp
      Assist: type=Ap_Assist
      AssistFirewall: type=Ap_AssistFirewall
      AstLmt: type=Ap_AstLmt
      AvgFricLrn: type=Ap_AvgFricLrn
      BatteryVoltage: type=Ap_BatteryVoltage
      BkCpPc: type=Sa_BkCpPc
      BVDiag: type=Ap_BVDiag
      CDDInterface10: type=Sa_CDDInterface10
      CDDInterface11: type=Sa_CDDInterface11
      CDDInterface6: type=Sa_CDDInterface6
      CDDInterface9: type=Sa_CDDInterface9
      ChkPtAp10: type=Ap_ChkPtAp10
      ChkPtAp11: type=Ap_ChkPtAp11
      ChkPtAp6: type=Ap_ChkPtAp6
      ChkPtAp9: type=Ap_ChkPtAp9
      CmMtrCurr: type=Sa_CmMtrCurr
      ComplErr: type=Ap_ComplErr
      CtrlTemp: type=Sa_CtrlTemp
      CurrCmd: type=Ap_CurrCmd
      CurrParamComp: type=Ap_CurrParamComp
      CustBattDiag: type=Ap_CustBattDiag
      Damping: type=Ap_Damping
      DampingFirewall: type=Ap_DampingFirewall
      DemIf: type=Ap_DemIf
      DiagMgr10: type=Ap_DiagMgr10
      DiagMgr11: type=Ap_DiagMgr11
      DiagMgr6: type=Ap_DiagMgr6
      DiagMgr9: type=Ap_DiagMgr9
      DiagSvc: type=Ap_DiagSvc
      DigMSB: type=Sa_DigMSB
      DigPhsReasDiag: type=Ap_DigPhsReasDiag
      ElePwr: type=Ap_ElePwr
      EOTActuatorMng: type=Ap_EOTActuatorMng
      ePWM2: type=Ap_ePWM2
      EtDmpFw: type=Ap_EtDmpFw
      FaultLog: type=Ap_FaultLog
      FltInjection: type=Ap_FltInjection
      FrqDepDmpnInrtCmp: type=Ap_FrqDepDmpnInrtCmp
      HighFreqAssist: type=Ap_HighFreqAssist
      HiLoadStall: type=Ap_HiLoadStall
      HOWDetect: type=Ap_HOWDetect
      HwPwUp: type=Ap_HwPwUp
      HwTqArbn: type=Sa_HwTqArbn
      HwTqCorrln: type=Sa_HwTqCorrln
      HystComp: type=Ap_HystComp
      IoHwAb10: type=IoHwAb10
      IoHwAb9: type=IoHwAb9
      IoHwAbsDigSig: type=IoHwAbstraction
      LmtCod: type=Ap_LmtCod
      LoaMgr: type=Ap_LoaMgr
      LrnEOT: type=Ap_LrnEOT
      MtrDrvDiag: type=Sa_MtrDrvDiag
      MtrTempEst: type=Ap_MtrTempEst
      MtrVel: type=Sa_MtrVel
      MtrVel2: type=Sa_MtrVel2
      MtrVel3: type=Sa_MtrVel3
      Nhet1CfgAndUse: type=Cd_Nhet1CfgAndUse
      NtWrap: type=NtWrap
      OvrVoltMon: type=Sa_OvrVoltMon
      PeakCurrEst: type=Ap_PeakCurrEst
      PhaseAbcFdbkMeas: type=Cd_PhaseAbcFdbkMeas
      PICurrCntrl: type=Ap_PICurrCntrl
      PosServo: type=Ap_PosServo
      PsaAgArbn: type=Ap_PsaAgArbn
      PSADMQ: type=Ap_PSADMQ
      PSADSG: type=Ap_PSADSG
      PSASH: type=Ap_PSASH
      PSATA: type=Ap_PSATA
      PwrLmtFuncCr: type=Ap_PwrLmtFuncCr
      QuadDet: type=Ap_QuadDet
      Return: type=Ap_Return
      ReturnFirewall: type=Ap_ReturnFirewall
      RteErrata10: type=RteErrata10
      RteErrata11: type=RteErrata11
      RteErrata6: type=RteErrata6
      RteErrata9: type=RteErrata9
      ShtdnMech: type=Sa_ShtdnMech
      SignlCondn: type=Ap_SignlCondn
      SrlComDriver: type=Cd_SrlComDriver
      SrlComInput: type=Ap_SrlComInput
      SrlComOutput: type=Ap_SrlComOutput
      StabilityComp: type=Ap_StabilityComp
      StabilityComp2: type=Ap_StabilityComp2
      StaMd: type=Ap_StaMd
      StaMd11: type=Ap_StaMd11
      StaMd6: type=Ap_StaMd6
      StaMd9: type=Ap_StaMd9
      StOpCtrl: type=Ap_StOpCtrl
      Sweep: type=Ap_Sweep
      Sweep2: type=Ap_Sweep2
      ThrmlDutyCycle: type=Ap_ThrmlDutyCycle
      TmprlMon: type=Sa_TmprlMon
      TmprlMon2: type=Sa_TmprlMon2
      TqRsDg: type=Ap_TqRsDg
      TranlDampg: type=Ap_TranlDampg
      TrqCanc: type=Ap_TrqCanc
      TrqCmdScl: type=Ap_TrqCmdScl
      TrqLOA: type=Ap_TrqLOA
      TuningSelAuth: type=Ap_TuningSelAuth
      uDiag: type=Cd_uDiag
      VehDyn: type=Ap_VehDyn
      VehPwrMd: type=Ap_VehPwrMd
      VehSpdLmt: type=Ap_VehSpdLmt
    connect AbsHwPos.AbsHwPos_SCom -> NtWrap.C_AbsHwPos_SCom
    connect AbsHwPos.AlignedRelHwPos -> PsaAgArbn.AlignedRelHwPos
    connect AbsHwPos.RelHwPos -> PsaAgArbn.RelHwPos
    connect AbsHwPos.RelHwPos -> VehDyn.RelHwPos
    connect ActivePull.ActivePull_SCom -> NtWrap.C_ActivePull_SCom
    connect ActivePull.PullCompCmd -> AstLmt.PullCompCmd
    connect Ap_CtrlPolarityBrshlss.AssiMechPolarity -> DigMSB.AssistAssemblyPolarity
    connect Ap_CtrlPolarityBrshlss.AssiMechPolarity -> MtrVel.AsstAssemblyPolarity
    connect Ap_CtrlPolarityBrshlss.AssiMechPolarity -> MtrVel2.AsstAssemblyPolarity
    connect Ap_CtrlPolarityBrshlss.AssiMechPolarity -> TranlDampg.AssistAssyPolarity
    connect Ap_CtrlPolarityBrshlss.HwTq1Polarity -> Nhet1CfgAndUse.HwTq1Polarity
    connect Ap_CtrlPolarityBrshlss.HwTq2Polarity -> Nhet1CfgAndUse.HwTq2Polarity
    connect Ap_CtrlPolarityBrshlss.MotElecMeclPolarity -> CDDInterface6.MtrElecMechPolarity
    connect Ap_CtrlPolarityBrshlss.MotElecMeclPolarity -> DigPhsReasDiag.MtrElecMechPolarity
    connect Ap_CtrlPolarityBrshlss.MotMeclPosn1Polarity -> CDDInterface10.MtrPosPolarity
    connect Ap_CtrlPolarityBrshlss.MotMeclPosn1Polarity -> DigMSB.MtrPosPolarity
    connect Ap_CtrlPolarityBrshlss.Polarity_SCom -> NtWrap.C_Polarity_SCom
    connect ApXcp.ActiveTunOvrPtrAddr -> TuningSelAuth.ActiveTunOvrPtrAddr
    connect ApXcp.TuningSessionActPtr -> TuningSelAuth.TuningSessionActPtr
    connect Assist.BaseAssistCmd -> AssistFirewall.BaseAssistCmd
    connect Assist.BaseAssistCmd -> DampingFirewall.BaseAssistCmd
    connect Assist.BaseAssistCmd -> FrqDepDmpnInrtCmp.BaseAssistCmd
    connect Assist.BaseAssistCmd -> HystComp.BaseAssistCmd
    connect AssistFirewall.AsstFirewallActive -> DampingFirewall.AsstFirewallActive
    connect AssistFirewall.AsstFirewallActive -> StabilityComp.AsstFWActive
    connect AssistFirewall.AsstFirewallActive -> StabilityComp2.AsstFWActive
    connect AssistFirewall.CombinedAssist -> StabilityComp.CombinedAssist
    connect AssistFirewall.CombinedAssist -> StabilityComp2.CombinedAssist
    connect AstLmt.AstLmt_Scom -> NtWrap.C_AstLmt_Scom
    connect AstLmt.PreLimitForStall -> HiLoadStall.PreLimitForStall
    connect AstLmt.PreLimitTorque -> EOTActuatorMng.PreLimitTorque
    connect AstLmt.SumLimTrqCmd -> Sweep2.InputMtrTrq
    connect AstLmt.TrqLimitMin -> TqRsDg.TrqLimitMin
    connect AvgFricLrn.AvgFricLrn_SCom -> NtWrap.C_AvgFricLrn_SCom
    connect AvgFricLrn.FricOffset -> HystComp.FricOffset
    connect BatteryVoltage.BatteryVoltage_SCom -> NtWrap.C_BatteryVoltage_SCom
    connect BatteryVoltage.Vecu -> CDDInterface10.Vecu
    connect BatteryVoltage.Vecu -> CmMtrCurr.Vecu
    connect BatteryVoltage.Vecu -> CurrCmd.Vecu
    connect BatteryVoltage.Vecu -> ElePwr.Vecu
    connect BatteryVoltage.Vecu -> PwrLmtFuncCr.Vecu
    connect BkCpPc.CapPcDcStub -> BkCpPc.PhyCapDischarge
    connect BkCpPc.CapPcDcStub -> BkCpPc.PhyCapPrecharge
    connect BkCpPc.PwrDiscATestComplete -> HwPwUp.PwrDiscATestComplete
    connect BkCpPc.PwrDiscBTestComplete -> HwPwUp.PwrDiscBTestComplete
    connect CDDInterface10.ESCOffsCfgSeld -> PsaAgArbn.EscOffsEna
    connect CDDInterface10.ESCOffsCfgSeld -> SrlComDriver.ESCOffsCfgSeld
    connect CDDInterface10.ESCOffsCfgSeld -> SrlComInput.ESCOffsCfgSeld
    connect CDDInterface10.ESCOffsCfgSeld -> SrlComOutput.ESCOffsCfgSeld
    connect CDDInterface10.TurnsCounterSelected -> DigMSB.TurnsCounterSelected
    connect CDDInterface11.DesiredTunSet -> ApXcp.DesiredTunSet
    connect CDDInterface11.DesiredTunSet -> TuningSelAuth.DesiredTunSet
    connect CDDInterface6.AVASelected -> SrlComOutput.AVASelected
    connect CDDInterface6.CAVHCSelected -> SrlComDriver.CAVHCSelected
    connect CDDInterface6.CAVHCSelected -> SrlComInput.CAVHCSelected
    connect CDDInterface6.CAVHCSelected -> SrlComOutput.CAVHCSelected
    connect CDDInterface6.CityParkSelected -> PSASH.ApaEna
    connect CDDInterface6.CityParkSelected -> SrlComDriver.CityParkSelected
    connect CDDInterface6.CityParkSelected -> SrlComInput.CityParkSelected
    connect CDDInterface6.CityParkSelected -> SrlComOutput.CityParkSelected
    connect CDDInterface6.DampingSrlComSvcDft -> Damping.DefeatDampingSvc
    connect CDDInterface6.DampingSrlComSvcDft -> DampingFirewall.Defeat_Damping_Svc
    connect CDDInterface6.DftAsstTbl -> Assist.DftAsstTbl
    connect CDDInterface6.DftAsstTbl -> AssistFirewall.Defeat_AsstTbl_Service
    connect CDDInterface6.DwnldAsstGain -> Assist.DwnldAsstGain
    connect CDDInterface6.EngONSrlComSvcDft -> VehPwrMd.EngONSrlComSvcDft
    connect CDDInterface6.EOTImpactSrlComSvcDft -> EOTActuatorMng.EOTDisable
    connect CDDInterface6.EOTImpactSrlComSvcDft -> EtDmpFw.EOTDisable
    connect CDDInterface6.EOTThermalSrlComSvcDft -> HiLoadStall.DftStallLimit
    connect CDDInterface6.FreqDepDmpSrlComSvcDft -> DampingFirewall.FreqDepDmpSrlComSvcDft
    connect CDDInterface6.FreqDepDmpSrlComSvcDft -> FrqDepDmpnInrtCmp.FreqDepDmpSrlComSvcDft
    connect CDDInterface6.FricLrnSrlComSvcDft -> AvgFricLrn.DefeatFricLearning
    connect CDDInterface6.HystCompSrlComSvcDft -> HystComp.DefeatHystService
    connect CDDInterface6.LimitSrlComSvcDft -> AstLmt.DefeatLimitService
    connect CDDInterface6.LoaMgrDft -> LoaMgr.LoaScaDi
    connect CDDInterface6.LXASelected -> PSASH.LxaSelected
    connect CDDInterface6.LXASelected -> SrlComDriver.LXASelected
    connect CDDInterface6.LXASelected -> SrlComInput.LXASelected
    connect CDDInterface6.LXASelected -> SrlComOutput.LXASelected
    connect CDDInterface6.MfgDiagInhibit -> DiagMgr10.MfgDiagInhibit
    connect CDDInterface6.MfgDiagInhibit -> DiagMgr11.MfgDiagInhibit
    connect CDDInterface6.MfgDiagInhibit -> DiagMgr6.MfgDiagInhibit
    connect CDDInterface6.MfgDiagInhibit -> DiagMgr9.MfgDiagInhibit
    connect CDDInterface6.MultiModeSelected -> PSADMQ.MultiModeSelected
    connect CDDInterface6.MultiModeSelected -> SrlComDriver.MultimodeSelected
    connect CDDInterface6.MultiModeSelected -> SrlComInput.MultimodeSelected
    connect CDDInterface6.PullCompSrlComSvcDft -> ActivePull.DisableLearning
    connect CDDInterface6.PullCompSrlComSvcDft -> ActivePull.DisableOutput
    connect CDDInterface6.PullCompSrlComSvcDft -> ActivePull.PullCmpCustLrngDi
    connect CDDInterface6.ReturnSrlComSvcDft -> Return.DefeatReturnSvc
    connect CDDInterface6.ReturnSrlComSvcDft -> ReturnFirewall.Defeat_Return_Svc
    connect CDDInterface6.RxMsgsSrlComSvcDft -> SrlComInput.RxMsgsSrlComSvcDft
    connect CDDInterface6.SrlComSvcDft -> CmMtrCurr.SrlComSvcDft
    connect CDDInterface6.STTdSelected -> CustBattDiag.SttdSelected
    connect CDDInterface6.STTdSelected -> SrlComDriver.STTdSelected
    connect CDDInterface6.STTdSelected -> SrlComInput.STTdSelected
    connect CDDInterface6.STTdSelected -> SrlComOutput.STTdSelected
    connect CDDInterface6.STTdSelected -> VehPwrMd.STTdSelected
    connect CDDInterface6.ThermalDCSrlComSvcDft -> ThrmlDutyCycle.DefeatDutySvc
    connect CDDInterface6.TrqRmpSrlComSvcDft -> StOpCtrl.RampSrlComSvcDft
    connect CDDInterface9.ADCMtrCurr1 -> CmMtrCurr.ADCMtrCurr1
    connect CDDInterface9.ADCMtrCurr2 -> CmMtrCurr.ADCMtrCurr2
    connect CDDInterface9.CorrectedElecMtrPos -> DigMSB.CorrectedElecMtrPos
    connect CDDInterface9.CorrMtrCurrPosition -> CmMtrCurr.CorrMtrCurrPosition
    connect CDDInterface9.CorrMtrPosElec -> DigPhsReasDiag.LRPRCorrectedMtrPosCaptured
    connect CDDInterface9.CumMechMtrPos -> DigMSB.CumMechMtrPos
    connect CDDInterface9.Die1RxError -> DigMSB.Die1RxError
    connect CDDInterface9.Die1RxMtrPos -> DigMSB.Die1RxMtrPos
    connect CDDInterface9.Die1RxRevCtr -> DigMSB.Die1RxRevCtr
    connect CDDInterface9.Die1UnderVoltgFltAccum -> DigMSB.Die1UnderVoltgFltAccum
    connect CDDInterface9.Die2RxError -> DigMSB.Die2RxError
    connect CDDInterface9.Die2RxMtrPos -> DigMSB.Die2RxMtrPos
    connect CDDInterface9.Die2RxRevCtr -> DigMSB.Die2RxRevCtr
    connect CDDInterface9.ExpectedOnTimeA -> DigPhsReasDiag.ExpectedOnTimeA
    connect CDDInterface9.ExpectedOnTimeB -> DigPhsReasDiag.ExpectedOnTimeB
    connect CDDInterface9.ExpectedOnTimeC -> DigPhsReasDiag.ExpectedOnTimeC
    connect CDDInterface9.IgnCnt -> DiagMgr10.IgnCnt
    connect CDDInterface9.IgnCnt -> DiagMgr11.IgnCnt
    connect CDDInterface9.IgnCnt -> DiagMgr6.IgnCnt
    connect CDDInterface9.IgnCnt -> DiagMgr9.IgnCnt
    connect CDDInterface9.LRPRPhaseadvanceCaptured -> DigPhsReasDiag.LRPRPhaseadvanceCaptured
    connect CDDInterface9.MEC -> AbsHwPos.ManufMode
    connect CDDInterface9.MEC -> AssistFirewall.MEC_Counter
    connect CDDInterface9.MEC -> CmMtrCurr.MEC
    connect CDDInterface9.MEC -> DampingFirewall.MEC_Counter
    connect CDDInterface9.MEC -> DiagMgr10.MEC
    connect CDDInterface9.MEC -> DiagMgr11.MEC
    connect CDDInterface9.MEC -> DiagMgr6.MEC
    connect CDDInterface9.MEC -> DiagMgr9.MEC
    connect CDDInterface9.MEC -> EtDmpFw.MEC_Counter
    connect CDDInterface9.MEC -> ReturnFirewall.MEC_Counter
    connect CDDInterface9.MEC -> VehPwrMd.MEC
    connect CDDInterface9.MechMtrPos1Timestamp -> MtrVel2.MechMtrPos1Timestamp
    connect CDDInterface9.MechMtrPos2Timestamp -> MtrVel.MechMtrPos2Timestamp
    connect CDDInterface9.MECTemp -> HwTqArbn.MEC_Counter
    connect CDDInterface9.ModIdxFinal -> DigPhsReasDiag.LRPRModulationIndexCaptured
    connect CDDInterface9.MtrCurrDax -> ElePwr.MtrCurrDax
    connect CDDInterface9.MtrCurrDax -> PeakCurrEst.MtrCurrDax
    connect CDDInterface9.MtrCurrK1 -> CmMtrCurr.MtrCurrK1
    connect CDDInterface9.MtrCurrK2 -> CmMtrCurr.MtrCurrK2
    connect CDDInterface9.MtrCurrQax -> ElePwr.MtrCurrQax
    connect CDDInterface9.MtrCurrQax -> PeakCurrEst.MtrCurrQax
    connect CDDInterface9.MtrCurrQaxFinalRef -> TqRsDg.MtrCurrQaxFinalRef
    connect CDDInterface9.MtrVoltDax -> ElePwr.MtrVoltDax
    connect CDDInterface9.MtrVoltDax -> TqRsDg.MtrVoltDax
    connect CDDInterface9.MtrVoltQax -> ElePwr.MtrVoltQax
    connect CDDInterface9.MtrVoltQax -> TqRsDg.MtrVoltQax
    connect CDDInterface9.RxMtrPosParityAccum -> DigMSB.RxMtrPosParityAccum
    connect CDDInterface9.SysCCorrMtrPosElec -> TqRsDg.CorrMtrPosElec
    connect CDDInterface9.SysCVSwitchADC -> IoHwAb10.SysCVSwitchADC
    connect CDDInterface9.UncorrMechMtrPos1 -> DigMSB.UncorrMechMtrPos1
    connect CmMtrCurr.CmMtrCurr_SCom -> NtWrap.C_CmMtrCurr_SCom
    connect CmMtrCurr.ComOffset -> CDDInterface10.CommOffset
    connect CmMtrCurr.CurrentGainSvc -> CurrCmd.CurrentGainSvc
    connect CmMtrCurr.MtrCurr1TempOffset -> CDDInterface10.MtrCurr1TempOffset
    connect CmMtrCurr.MtrCurr2TempOffset -> CDDInterface10.MtrCurr2TempOffset
    connect ComplErr.ComplErr -> AbsHwPos.ComplError
    connect CtrlTemp.FiltMeasTemp -> CmMtrCurr.FiltCntrlTemp
    connect CtrlTemp.FiltMeasTemp -> DiagSvc.ECUTemperature
    connect CtrlTemp.FiltMeasTemp -> FaultLog.CtrlTemp
    connect CtrlTemp.FiltMeasTemp -> MtrTempEst.CtrlTempFinal
    connect CtrlTemp.FiltMeasTemp -> ThrmlDutyCycle.FiltMeasTemp
    connect CurrCmd.MtrCurrAngle -> CmMtrCurr.MtrCurrAngle
    connect CurrCmd.MtrCurrDaxRef -> CurrParamComp.MtrCurrDaxRef
    connect CurrCmd.MtrCurrDaxRef -> PeakCurrEst.MtrCurrDaxRef
    connect CurrCmd.MtrCurrDaxRef -> TqRsDg.MtrCurrDaxRef
    connect CurrCmd.MtrCurrDaxRef -> TrqCanc.MtrCurrDaxRef
    connect CurrCmd.MtrCurrQaxRef -> CurrParamComp.MtrCurrQaxRef
    connect CurrCmd.MtrCurrQaxRef -> PeakCurrEst.MtrCurrQaxRef
    connect CurrCmd.MtrCurrQaxRef -> TrqCanc.MtrCurrQaxRef
    connect CurrParamComp.EstKe -> CurrCmd.EstKe
    connect CurrParamComp.EstKe -> PwrLmtFuncCr.EstKe
    connect CurrParamComp.EstKe -> TqRsDg.EstKe
    connect CurrParamComp.EstKe -> TrqCanc.EstKe
    connect CurrParamComp.EstLd -> CurrCmd.EstLd
    connect CurrParamComp.EstLd -> TrqCanc.EstLd
    connect CurrParamComp.EstLq -> CurrCmd.EstLq
    connect CurrParamComp.EstLq -> TrqCanc.EstLq
    connect CurrParamComp.EstR -> CurrCmd.EstR
    connect CurrParamComp.EstR -> TqRsDg.EstR
    connect CurrParamComp.SCom_EOLNomMtrParam -> NtWrap.C_SCom_EOLNomMtrParam
    connect Damping.DampingCmd -> PSADSG.DampingCmd
    connect DampingFirewall.CombinedDamping -> AstLmt.CombinedDamping
    connect DemIf.CTCFailed -> SrlComOutput.CTCFailed
    connect DemIf.DemIf -> DiagMgr6.DemIf
    connect DemIf.DemIf -> SrlComDriver.DemIf
    connect DiagMgr10.DiagRampRate -> StOpCtrl.DiagRampRate
    connect DiagMgr10.DiagRampValue -> StOpCtrl.DiagRampValue
    connect DiagMgr10.DiagRmpToZeroActive -> PSASH.FTermActv
    connect DiagMgr10.DiagRmpToZeroActive -> StaMd.FTerm
    connect DiagMgr10.DiagRmpToZeroActive -> StaMd11.FTerm
    connect DiagMgr10.DiagRmpToZeroActive -> StOpCtrl.DiagStsDiagRmpActive
    connect DiagMgr10.DiagStsCtrldDisRmpPres -> ePWM2.DiagStsCtrldDisRmpPres
    connect DiagMgr10.DiagStsCtrldDisRmpPres -> TranlDampg.DiagStsF2Active
    connect DiagMgr10.DiagStsDefTemp -> CtrlTemp.DiagStsTempRdPrf
    connect DiagMgr10.DiagStsDefVehSpd -> SrlComInput.DefaultVehSpd
    connect DiagMgr10.DiagStsHWASbSystmFltPres -> AbsHwPos.DiagStatusHwPosReducedPerf
    connect DiagMgr10.DiagStsHWASbSystmFltPres -> LrnEOT.DiagStsHwPosDis
    connect DiagMgr10.DiagStsHWASbSystmFltPres -> Return.DiagStsHwPosDis
    connect DiagMgr10.DiagStsInverter1Inactive -> LoaMgr.DiagcStsIvtr1Inactv
    connect DiagMgr10.DiagStsInverter2Inactive -> LoaMgr.DiagcStsIvtr2Inactv
    connect DiagMgr10.DiagStsNonRecRmpToZeroFltPres -> ePWM2.DiagStsNonRecRmpToZeroFltPres
    connect DiagMgr10.DiagStsScomHWANotValid -> SrlComOutput.DefaultHwaSCommExportValue
    connect DiagMgr10.NxtrDiagMgr10 -> AbsHwPos.NxtrDiagMgr
    connect DiagMgr10.NxtrDiagMgr10 -> Ap_CtrlPolarityBrshlss.NxtrDiagMgr
    connect DiagMgr10.NxtrDiagMgr10 -> AssistFirewall.NxtrDiagMgr
    connect DiagMgr10.NxtrDiagMgr10 -> AstLmt.NxtrDiagMgr
    connect DiagMgr10.NxtrDiagMgr10 -> DampingFirewall.NxtrDiagMgr
    connect DiagMgr10.NxtrDiagMgr10 -> DigMSB.NxtrDiagMgr
    connect DiagMgr10.NxtrDiagMgr10 -> DigPhsReasDiag.NxtrDiagMgr
    connect DiagMgr10.NxtrDiagMgr10 -> HwTqArbn.NxtrDiagMgr
    connect DiagMgr10.NxtrDiagMgr10 -> HwTqCorrln.NxtrDiagMgr
    connect DiagMgr10.NxtrDiagMgr10 -> IoHwAb10.NxtrDiagMgr
    connect DiagMgr10.NxtrDiagMgr10 -> LoaMgr.NxtrDiagMgr
    connect DiagMgr10.NxtrDiagMgr10 -> MtrDrvDiag.NxtrDiagMgr
    connect DiagMgr10.NxtrDiagMgr10 -> MtrVel.NxtrDiagMgr
    connect DiagMgr10.NxtrDiagMgr10 -> OvrVoltMon.NxtrDiagMgr
    connect DiagMgr10.NxtrDiagMgr10 -> PsaAgArbn.NxtrDiagMgr
    connect DiagMgr10.NxtrDiagMgr10 -> PSATA.NxtrDiagMgr
    connect DiagMgr10.NxtrDiagMgr10 -> PwrLmtFuncCr.NxtrDiagMgr
    connect DiagMgr10.NxtrDiagMgr10 -> ReturnFirewall.NxtrDiagMgr
    connect DiagMgr10.NxtrDiagMgr10 -> SrlComInput.NxtrDiagMgr
    connect DiagMgr10.NxtrDiagMgr10 -> SrlComOutput.NxtrDiagMgr
    connect DiagMgr10.NxtrDiagMgr10 -> StabilityComp.NxtrDiagMgr
    connect DiagMgr10.NxtrDiagMgr10 -> StaMd.NxtrDiagMgr
    connect DiagMgr10.NxtrDiagMgr10 -> TqRsDg.NxtrDiagMgr
    connect DiagMgr10.NxtrDiagMgr10 -> uDiag.NxtrDiagMgr
    connect DiagMgr11.NxtrDiagMgr11 -> CmMtrCurr.NxtrDiagMgr
    connect DiagMgr11.NxtrDiagMgr11 -> CtrlTemp.NxtrDiagMgr
    connect DiagMgr11.NxtrDiagMgr11 -> MtrVel2.NxtrDiagMgr
    connect DiagMgr11.NxtrDiagMgr11 -> StaMd11.NxtrDiagMgr
    connect DiagMgr6.DiagMgr_StaCtrl -> StaMd6.DiagMgr_StaCtrl
    connect DiagMgr6.NxtrDiagMgr6 -> DiagSvc.NxtrDiagMgr
    connect DiagMgr6.NxtrDiagMgr6 -> FaultLog.NxtrDiagMgr
    connect DiagMgr6.NxtrDiagMgr6 -> SrlComDriver.NxtrDiagMgr
    connect DiagMgr9.NxtrDiagMgr9 -> AvgFricLrn.NxtrDiagMgr
    connect DiagMgr9.NxtrDiagMgr9 -> BatteryVoltage.NxtrDiagMgr
    connect DiagMgr9.NxtrDiagMgr9 -> BkCpPc.NxtrDiagMgr
    connect DiagMgr9.NxtrDiagMgr9 -> BVDiag.NxtrDiagMgr
    connect DiagMgr9.NxtrDiagMgr9 -> CustBattDiag.NxtrDiagMgr
    connect DiagMgr9.NxtrDiagMgr9 -> LrnEOT.NxtrDiagMgr
    connect DiagMgr9.NxtrDiagMgr9 -> Nhet1CfgAndUse.NxtrDiagMgr
    connect DiagMgr9.NxtrDiagMgr9 -> PSASH.NxtrDiagMgr
    connect DiagMgr9.NxtrDiagMgr9 -> ThrmlDutyCycle.NxtrDiagMgr
    connect DiagMgr9.NxtrDiagMgr9 -> TmprlMon.NxtrDiagMgr
    connect DiagMgr9.NxtrDiagMgr9 -> VehDyn.NxtrDiagMgr
    connect DiagMgr9.NxtrDiagMgr9 -> VehPwrMd.NxtrDiagMgr
    connect DigMSB.AlignedCumMechMtrPosCRF -> AbsHwPos.AlignedCumMechMtrPosCRF
    connect DigMSB.AlignedCumMechMtrPosStatus -> AbsHwPos.TurnsCntrValidity
    connect DigMSB.AlignedCumMechMtrPosStatus -> PsaAgArbn.AlignedCumMechMtrPosStatus
    connect DigMSB.CumMechMtrPosCRF -> AbsHwPos.CumMechMtrPosCRF
    connect DigMSB.CumMechMtrPosCRF -> MtrVel2.CumMechMtrPosMRF
    connect DigMSB.CumMechMtrPosMRF -> QuadDet.MRFCumMtrPos
    connect DigMSB.CumMechMtrPosStatus -> PsaAgArbn.CumMechMtrPosStatus
    connect DigMSB.MechMtrPos2 -> MtrVel.MechMtrPos2
    connect EOTActuatorMng.AssistEOTDamping -> EtDmpFw.AssistEOTDamping
    connect EOTActuatorMng.AssistEOTGain -> LmtCod.AssistEOTGain
    connect EOTActuatorMng.AssistEOTLimit -> LmtCod.AssistEOTLimit
    connect EtDmpFw.EOTDampingLtd -> AstLmt.AssistEOTDamping
    connect FltInjection.FltInjection_SCom -> ActivePull.FaultInjection_SCom
    connect FltInjection.FltInjection_SCom -> Assist.FltInjection_SCom
    connect FltInjection.FltInjection_SCom -> AvgFricLrn.FltInjection_SCom
    connect FltInjection.FltInjection_SCom -> BatteryVoltage.FltInjection_SCom
    connect FltInjection.FltInjection_SCom -> Damping.FltInjection_SCom
    connect FltInjection.FltInjection_SCom -> EtDmpFw.FaultInjection_SCom
    connect FltInjection.FltInjection_SCom -> FrqDepDmpnInrtCmp.FltInjection_SCom
    connect FltInjection.FltInjection_SCom -> HystComp.FltInjection_SCom
    connect FltInjection.FltInjection_SCom -> LmtCod.FltInjection_SCom
    connect FltInjection.FltInjection_SCom -> Return.FltInjection_SCom
    connect FltInjection.FltInjection_SCom -> SignlCondn.FaultInjection_SCom
    connect FltInjection.FltInjection_SCom -> StabilityComp.FaultInjection_SCom
    connect FrqDepDmpnInrtCmp.FrqDepDmpnInrtCmp -> DampingFirewall.InertiaComp
    connect HighFreqAssist.HighFreqAssist -> AssistFirewall.HighFreqAssist
    connect HiLoadStall.AssistStallLimit -> LmtCod.AssistStallLimit
    connect HiLoadStall.AssistStallLimit -> PSASH.AssistStallLimit
    connect HOWDetect.HOWState -> PSASH.HOWState
    connect HwPwUp.MtrDrvrInitStart -> MtrDrvDiag.MtrDrvrInitStart
    connect HwPwUp.PwrDiscATestStart -> BkCpPc.PwrDiscATestStart
    connect HwPwUp.PwrDiscBTestStart -> BkCpPc.PwrDiscBTestStart
    connect HwPwUp.PwrDiscBTestStart -> OvrVoltMon.PwrDiscBTestStart
    connect HwPwUp.TMFTestStart -> TmprlMon.TMFTestStart
    connect HwTqArbn.HwTqVal -> HwTqCorrln.HwTqVal
    connect HwTqArbn.HwTqVal -> Sweep.InputHwTrq
    connect HwTqArbn.HwTrqArbn_SCom -> NtWrap.C_HwTqArbn_SCom
    connect HwTqCorrln.HwTqCorrlnSts -> HwTqArbn.HwTqCorrlnSts
    connect HwTqCorrln.HwTqIdptSig -> LoaMgr.HwTqIdptSig
    connect HystComp.HysteresisComp -> AssistFirewall.HysteresisComp
    connect IoHwAb10.Batt -> BatteryVoltage.Batt
    connect IoHwAb10.Batt -> BkCpPc.Batt
    connect IoHwAb10.Batt -> BVDiag.Batt
    connect IoHwAb10.Batt -> CustBattDiag.Batt
    connect IoHwAb10.Batt -> DemIf.BatteryVoltage
    connect IoHwAb10.Batt -> DiagSvc.BatteryVoltage
    connect IoHwAb10.Batt -> FaultLog.BatteryVoltage
    connect IoHwAb10.Batt -> SrlComInput.Batt
    connect IoHwAb10.BattSwitched -> BatteryVoltage.BattSwitched
    connect IoHwAb10.BattSwitched -> BkCpPc.BattSwitched
    connect IoHwAb10.SysCVSwitch -> BatteryVoltage.SysCVSwitch
    connect IoHwAb10.TemperatureADC -> CtrlTemp.TemperatureADC
    connect IoHwAb9.IoHwAb_Adc -> NtWrap.C_IoHwAb_Adc
    connect IoHwAbsDigSig.EpsEn -> CustBattDiag.EpsEn
    connect IoHwAbsDigSig.EpsEn -> DemIf.Ignition
    connect IoHwAbsDigSig.EpsEn -> DiagSvc.EpsEn
    connect IoHwAbsDigSig.EpsEn -> FaultLog.EpsEn
    connect IoHwAbsDigSig.EpsEn -> SrlComInput.EpsEn
    connect IoHwAbsDigSig.EpsEn -> SrlComOutput.EpsEn
    connect IoHwAbsDigSig.EpsEn -> VehPwrMd.EpsEn
    connect IoHwAbsDigSig.FetDrvCntl -> TmprlMon.FetDrvCntl
    connect IoHwAbsDigSig.FetDrvReset -> MtrDrvDiag.FetDrvReset
    connect IoHwAbsDigSig.FetDrvReset -> ShtdnMech.FetDrvReset
    connect IoHwAbsDigSig.FetFlt1Data -> MtrDrvDiag.FetFlt1Data
    connect IoHwAbsDigSig.FetFlt2Clk -> MtrDrvDiag.FetFlt2Clk
    connect IoHwAbsDigSig.IoHwAbPortConfig -> MtrDrvDiag.IoHwAbPortConfig
    connect IoHwAbsDigSig.OvrVoltFdbk -> OvrVoltMon.phyOvrVoltFdbk
    connect IoHwAbsDigSig.PwrSwitchEn -> TmprlMon.PwrSwitchEn
    connect IoHwAbsDigSig.SysFault2 -> ShtdnMech.SysFault2
    connect IoHwAbsDigSig.SysFault2 -> TmprlMon.SysFault2
    connect IoHwAbsDigSig.SysFault3 -> ShtdnMech.SysFault3
    connect IoHwAbsDigSig.SysFault3 -> TmprlMon.SysFault3
    connect IoHwAbsDigSig.TODReset -> StaMd.TOD
    connect IoHwAbsDigSig.WdMonitor -> TmprlMon.WdMonitor
    connect IoHwAbsDigSig.WdMonitor -> TmprlMon2.WdMonitor
    connect IoHwAbsDigSig.WdReset -> TmprlMon.WdReset
    connect LmtCod.EOTGainLtd -> AstLmt.AssistEOTGain
    connect LmtCod.EOTLimitLtd -> AstLmt.AssistEOTLimit
    connect LmtCod.OutputRampMultLtd -> AstLmt.OutputRampMult
    connect LmtCod.StallLimitLtd -> AstLmt.AssistStallLimit
    connect LmtCod.ThermalLimitLtd -> AstLmt.ThermalLimit
    connect LmtCod.VehSpdLimitLtd -> AstLmt.AssistVehSpdLimit
    connect LoaMgr.HwTqLoaMtgtnEn -> AstLmt.HwTqLoaMtgtnEn
    connect LoaMgr.IvtrLoaMtgtnEn -> CDDInterface10.IvtrLoaMtgtnEn
    connect LoaMgr.IvtrLoaMtgtnEn -> CurrCmd.IvtrLoaMtgtnEn
    connect LoaMgr.IvtrLoaMtgtnEn -> PeakCurrEst.IvtrLoaMtgtnEn
    connect LoaMgr.LoaRateLimit -> StOpCtrl.LoaRateLimit
    connect LoaMgr.LoaScaleFctr -> StOpCtrl.LoaScaleFctr
    connect LoaMgr.LOASt -> TranlDampg.LoaSt
    connect LoaMgr.MotAgLoaMtgtnEn -> PeakCurrEst.MotCurrLoaMtgtnEn
    connect LoaMgr.MotCurrLoaMtgtnEn -> CDDInterface10.MotCurrLoaMtgtnEn
    connect LoaMgr.MotCurrLoaMtgtnEn -> CurrCmd.MotCurrLoaMtgtnEn
    connect LoaMgr.MotCurrLoaMtgtnEn -> TrqLOA.MotAgLoaMtgtnEn
    connect LrnEOT.CCWFound -> EOTActuatorMng.CcwFound
    connect LrnEOT.CCWPosition -> EOTActuatorMng.CcwEOT
    connect LrnEOT.CCWPosition -> VehDyn.CCWPosition
    connect LrnEOT.CCWPosition -> VehSpdLmt.CCWPosition
    connect LrnEOT.CWFound -> EOTActuatorMng.CwFound
    connect LrnEOT.CWPosition -> EOTActuatorMng.CwEOT
    connect LrnEOT.CWPosition -> VehDyn.CWPosition
    connect LrnEOT.CWPosition -> VehSpdLmt.CWPosition
    connect LrnEOT.LrnEOT_Scom -> NtWrap.C_LrnEOT_Scom
    connect MtrDrvDiag.GateDriveResetActive -> DigPhsReasDiag.GateDriveResetActive
    connect MtrDrvDiag.MtrDrvrInitComplete -> HwPwUp.MtrDrvrInitComplete
    connect MtrTempEst.AssistMechTempEst -> AvgFricLrn.Temperature
    connect MtrTempEst.AssistMechTempEst -> Damping.AssistMechTempEst
    connect MtrTempEst.AssistMechTempEst -> HystComp.AssistMechTempEst
    connect MtrTempEst.AssistMechTempEst -> Return.AssistMechTempEst
    connect MtrTempEst.CuTempEst -> CurrParamComp.CuTempEst
    connect MtrTempEst.CuTempEst -> ThrmlDutyCycle.CuTempEst
    connect MtrTempEst.MagTempEst -> CurrParamComp.MagTempEst
    connect MtrTempEst.MagTempEst -> ThrmlDutyCycle.MagTempEst
    connect MtrTempEst.SiTempEst -> CurrParamComp.SiTempEst
    connect MtrTempEst.SiTempEst -> ThrmlDutyCycle.SiTempEst
    connect MtrVel.HandwheelVel -> ActivePull.HandwheelVelocity
    connect MtrVel.HandwheelVel -> AvgFricLrn.HwVel
    connect MtrVel.HandwheelVel -> DiagSvc.HandwheelVelocity
    connect MtrVel.HandwheelVel -> MtrTempEst.HwVel
    connect MtrVel.HandwheelVel -> MtrVel2.HandwheelVel
    connect MtrVel.HandwheelVel -> PSASH.HandwheelVelocity
    connect MtrVel.HandwheelVel -> PSATA.HandwheelVelocity
    connect MtrVel.HandwheelVel -> Return.HandwheelVel
    connect MtrVel.HandwheelVel -> SrlComOutput.HandwheelVelocity
    connect MtrVel.HandwheelVel -> TuningSelAuth.HandwheelVelocity
    connect MtrVel.MotorVelCRF -> Damping.MotorVelCRF
    connect MtrVel.MotorVelCRF -> DampingFirewall.MtrVelCRF
    connect MtrVel.MotorVelCRF -> EOTActuatorMng.MotorVel
    connect MtrVel.MotorVelCRF -> EtDmpFw.CRFMtrVel
    connect MtrVel.MotorVelCRF -> FltInjection.MotorVelCRF
    connect MtrVel.MotorVelCRF -> FrqDepDmpnInrtCmp.CRFMotorVel
    connect MtrVel.MotorVelCRF -> HiLoadStall.MtrVelCRF
    connect MtrVel.MotorVelCRF -> LrnEOT.MtrVelCRF
    connect MtrVel.MotorVelCRF -> PosServo.MotorVelCRF
    connect MtrVel.MotorVelCRF -> PsaAgArbn.MtrVelCRF
    connect MtrVel.MotorVelCRF -> ThrmlDutyCycle.MotorVelCRF
    connect MtrVel.MotorVelCRF -> TranlDampg.CRFMtrVel
    connect MtrVel.MotorVelCRF -> TrqLOA.MtrVelCRF
    connect MtrVel.MotorVelCRF -> VehDyn.MtrVelCRF
    connect MtrVel.MotorVelMRF -> BkCpPc.MotorVelocityMRFUnfiltered
    connect MtrVel.MotorVelMRF -> CDDInterface10.MRFMtrVel
    connect MtrVel.MotorVelMRF -> CmMtrCurr.MtrVel
    connect MtrVel.MotorVelMRF -> CurrCmd.MRFMtrVel
    connect MtrVel.MotorVelMRF -> DigPhsReasDiag.MotorVelMRFUnfiltered
    connect MtrVel.MotorVelMRF -> MtrVel2.MotorVelMRF
    connect MtrVel.MotorVelMRF -> PwrLmtFuncCr.MotorVelMRF
    connect MtrVel.MotorVelMRF -> TqRsDg.MRFMtrVel
    connect MtrVel.MotorVelMRF -> TrqCanc.MRFMtrVel
    connect MtrVel2.SysCDiagHwVel -> MtrVel.SysCDiagHwVel
    connect MtrVel2.SysCDiagMtrVelMRF -> MtrVel.SysCDiagMtrVelMRF
    connect Nhet1CfgAndUse.HwTq1Qlfr -> HwTqArbn.HwTq1Qlfr
    connect Nhet1CfgAndUse.HwTq1Qlfr -> HwTqCorrln.HwTq1Qlfr
    connect Nhet1CfgAndUse.HwTq1RollgCntr -> HwTqArbn.HwTq1RollgCntr
    connect Nhet1CfgAndUse.HwTq1RollgCntr -> HwTqCorrln.HwTq1RollgCntr
    connect Nhet1CfgAndUse.HwTq1Val -> HwTqArbn.HwTq1Val
    connect Nhet1CfgAndUse.HwTq1Val -> HwTqCorrln.HwTq1Val
    connect Nhet1CfgAndUse.HwTq2Qlfr -> HwTqArbn.HwTq2Qlfr
    connect Nhet1CfgAndUse.HwTq2Qlfr -> HwTqCorrln.HwTq2Qlfr
    connect Nhet1CfgAndUse.HwTq2RollgCntr -> HwTqArbn.HwTq2RollgCntr
    connect Nhet1CfgAndUse.HwTq2RollgCntr -> HwTqCorrln.HwTq2RollgCntr
    connect Nhet1CfgAndUse.HwTq2Val -> HwTqArbn.HwTq2Val
    connect Nhet1CfgAndUse.HwTq2Val -> HwTqCorrln.HwTq2Val
    connect NtWrap.IoHwAb_Adc -> IoHwAb10.IoHwAb_Adc
    connect NtWrap.SrlComDriver_SCom -> SrlComInput.SrlComDriver_SCom
    connect NtWrap.SrlComDriver_SCom -> SrlComOutput.SrlComDriver_SCom
    connect PeakCurrEst.EstPkCurr -> MtrTempEst.EstPkCurr
    connect PeakCurrEst.EstPkCurr -> ThrmlDutyCycle.MtrPkCurr
    connect PeakCurrEst.FiltEstPkCurr -> ThrmlDutyCycle.FilteredPkCurr
    connect PhaseAbcFdbkMeas.Get_PhaseFdbk -> CDDInterface9.Get_PhaseFdbk
    connect PhaseAbcFdbkMeas.MeasuredOnTimeA -> DigPhsReasDiag.MeasuredOnTimeA
    connect PhaseAbcFdbkMeas.MeasuredOnTimeB -> DigPhsReasDiag.MeasuredOnTimeB
    connect PhaseAbcFdbkMeas.MeasuredOnTimeC -> DigPhsReasDiag.MeasuredOnTimeC
    connect PosServo.PosSrvoCmd -> PSATA.PosSrvoCmd
    connect PosServo.PosSrvoReturnSclFct -> Return.PAReturnSclFct
    connect PsaAgArbn.AbsltHwPosn -> SrlComOutput.AbsltHwPosn
    connect PsaAgArbn.AbsltHwPosnLvl1 -> SrlComOutput.AbsltHwPosnLvl1
    connect PsaAgArbn.AbsltHwPosnLvl2 -> SrlComOutput.AbsltHwPosnLvl2
    connect PsaAgArbn.AbsltHwPosnVld -> SrlComOutput.AbsltHwPosnVld
    connect PsaAgArbn.AgArbnStToSerlCom -> SrlComOutput.AgArbnStToSerlCom
    connect PsaAgArbn.HandwheelAuthority -> ActivePull.HandwheelAuthority
    connect PsaAgArbn.HandwheelAuthority -> AvgFricLrn.HwPosAuthority
    connect PsaAgArbn.HandwheelAuthority -> DiagSvc.HandwheelAuthority
    connect PsaAgArbn.HandwheelAuthority -> EOTActuatorMng.HandWheelAuth
    connect PsaAgArbn.HandwheelAuthority -> EtDmpFw.HandwheelAuthority
    connect PsaAgArbn.HandwheelAuthority -> LrnEOT.HandwheelAuthority
    connect PsaAgArbn.HandwheelAuthority -> PSASH.HandwheelAuthority
    connect PsaAgArbn.HandwheelAuthority -> Return.HandwheelAuthority
    connect PsaAgArbn.HandwheelAuthority -> SrlComOutput.HandwheelAuthority
    connect PsaAgArbn.HandwheelAuthority -> TrqLOA.HandwheelAuthority
    connect PsaAgArbn.HandwheelAuthority -> VehDyn.HwAuth
    connect PsaAgArbn.HandwheelAuthority -> VehSpdLmt.HwPosAuth
    connect PsaAgArbn.HandwheelPosition -> ActivePull.HandwheelPosition
    connect PsaAgArbn.HandwheelPosition -> AvgFricLrn.HwAng
    connect PsaAgArbn.HandwheelPosition -> DiagSvc.HandwheelAngle
    connect PsaAgArbn.HandwheelPosition -> EOTActuatorMng.HandWheelPos
    connect PsaAgArbn.HandwheelPosition -> EtDmpFw.HandwheelPosition
    connect PsaAgArbn.HandwheelPosition -> FaultLog.HandwheelPosition
    connect PsaAgArbn.HandwheelPosition -> LrnEOT.HandwheelPosition
    connect PsaAgArbn.HandwheelPosition -> PosServo.HandwheelPosition
    connect PsaAgArbn.HandwheelPosition -> PSASH.HandwheelPosition
    connect PsaAgArbn.HandwheelPosition -> Return.HandwheelPosition
    connect PsaAgArbn.HandwheelPosition -> ReturnFirewall.HandwheelPosition
    connect PsaAgArbn.HandwheelPosition -> SrlComOutput.HandwheelPosition
    connect PsaAgArbn.HandwheelPosition -> TranlDampg.HandwheelPosition
    connect PsaAgArbn.HandwheelPosition -> TrqLOA.HandwheelPosition
    connect PsaAgArbn.HandwheelPosition -> VehDyn.HandwheelPosition
    connect PsaAgArbn.HandwheelPosition -> VehSpdLmt.HwPos
    connect PsaAgArbn.PsaAgArbn_SCom -> NtWrap.C_PsaAgArbn_SCom
    connect PsaAgArbn.RelHwPosnToSerlCom -> SrlComOutput.RelHwPosnToSerlCom
    connect PsaAgArbn.RelHwPosnVldToSerlCom -> SrlComOutput.RelHwPosnVldToSerlCom
    connect PSADMQ.DesiredTunPers -> ApXcp.DesiredTunPers
    connect PSADMQ.DesiredTunPers -> TuningSelAuth.DesiredTunPers
    connect PSADMQ.TunModSt -> SrlComOutput.ETATDADYN
    connect PSADSG.PsaDampgCmd -> DampingFirewall.DampingCmd
    connect PSASH.ApaState -> PSATA.ApaState
    connect PSASH.ApaState -> SrlComOutput.APAState
    connect PSASH.ApaStateTransitionCause -> SrlComOutput.APAStateTransitionCause
    connect PSASH.DrvrIntvDetd -> SrlComOutput.DrvrIntvDetd
    connect PSASH.EPSStateForLxa -> PSATA.EPSStateForLxa
    connect PSASH.EPSStateForLxa -> SrlComOutput.EPSStateForLxa
    connect PSASH.HwTrqRate -> PSATA.HwTrqRate
    connect PSASH.LxaCorrnFacReqLimd -> PSATA.LxaCorrnFacReqLimd
    connect PSASH.LxaDrvrAbsntHwVelDetd -> PSATA.LxaDrvrAbsntHwVelDetd
    connect PSASH.LxaHwAgDetd -> PSATA.LxaHwAgDetd
    connect PSASH.PosSrvoEnable -> PosServo.PosSrvoEnable
    connect PSASH.PosSrvoEnable -> PSATA.PosSrvoEnable
    connect PSASH.PosSrvoHwAngle -> PosServo.PosSrvoHwAngle
    connect PSATA.ApaPosSrvoFlt -> PSASH.ApaPosSrvoFlt
    connect PSATA.LxaTqLimnActv -> SrlComOutput.LxaTqLimnActv
    connect PSATA.OpTrqOv -> AstLmt.OpTrqOvr
    connect PwrLmtFuncCr.FltTrqLmt -> AstLmt.PowerLimitPerc
    connect PwrLmtFuncCr.MRFMtrTrqCmd -> DiagSvc.FinalTorqueCommand
    connect PwrLmtFuncCr.MRFMtrTrqCmd -> FaultLog.MotorTorque
    connect PwrLmtFuncCr.MRFMtrTrqCmd -> TrqCmdScl.MRFMtrTrqCmd
    connect QuadDet.MtrQuad -> CurrCmd.MtrQuad
    connect Return.ReturnCmd -> ReturnFirewall.ReturnCmd
    connect ReturnFirewall.LimitedReturn -> AstLmt.LimitedReturn
    connect SignlCondn.Vehicle_LonAccel -> DampingFirewall.VehicleLonAccel
    connect SignlCondn.Vehicle_LonAccel -> FrqDepDmpnInrtCmp.VehicleLonAccel
    connect SignlCondn.VehicleSpeed -> ActivePull.VehicleSpeed
    connect SignlCondn.VehicleSpeed -> Assist.VehSpd
    connect SignlCondn.VehicleSpeed -> AssistFirewall.VehicleSpeed
    connect SignlCondn.VehicleSpeed -> AstLmt.VehSpd
    connect SignlCondn.VehicleSpeed -> AvgFricLrn.VehSpd
    connect SignlCondn.VehicleSpeed -> CmMtrCurr.VehSpd
    connect SignlCondn.VehicleSpeed -> CurrCmd.VehSpd
    connect SignlCondn.VehicleSpeed -> CustBattDiag.VehicleSpeed
    connect SignlCondn.VehicleSpeed -> Damping.VehicleSpeed
    connect SignlCondn.VehicleSpeed -> DampingFirewall.VehicleSpeed
    connect SignlCondn.VehicleSpeed -> DiagMgr10.VehSpd
    connect SignlCondn.VehicleSpeed -> DiagMgr11.VehSpd
    connect SignlCondn.VehicleSpeed -> DiagMgr6.VehSpd
    connect SignlCondn.VehicleSpeed -> DiagMgr9.VehSpd
    connect SignlCondn.VehicleSpeed -> EOTActuatorMng.VehicleSpeed
    connect SignlCondn.VehicleSpeed -> EtDmpFw.Vehicle_Speed
    connect SignlCondn.VehicleSpeed -> FrqDepDmpnInrtCmp.VehicleSpeed
    connect SignlCondn.VehicleSpeed -> HighFreqAssist.VehicleSpeed
    connect SignlCondn.VehicleSpeed -> HOWDetect.VehSpd
    connect SignlCondn.VehicleSpeed -> HystComp.VehicleSpeed
    connect SignlCondn.VehicleSpeed -> LmtCod.VehicleSpeed
    connect SignlCondn.VehicleSpeed -> PosServo.VehicleSpeed
    connect SignlCondn.VehicleSpeed -> PsaAgArbn.VehicleSpeed
    connect SignlCondn.VehicleSpeed -> PSADSG.VehicleSpeed
    connect SignlCondn.VehicleSpeed -> PSASH.VehicleSpeed
    connect SignlCondn.VehicleSpeed -> PSATA.VehicleSpeed
    connect SignlCondn.VehicleSpeed -> Return.VehicleSpeed
    connect SignlCondn.VehicleSpeed -> ReturnFirewall.VehicleSpeed
    connect SignlCondn.VehicleSpeed -> SrlComInput.VehicleSpeed
    connect SignlCondn.VehicleSpeed -> SrlComOutput.VehicleSpeed
    connect SignlCondn.VehicleSpeed -> StabilityComp.VehicleSpeed
    connect SignlCondn.VehicleSpeed -> StabilityComp2.VehicleSpeed
    connect SignlCondn.VehicleSpeed -> Sweep.VehSpd
    connect SignlCondn.VehicleSpeed -> TranlDampg.VehSpd
    connect SignlCondn.VehicleSpeed -> TrqLOA.VehicleSpeed
    connect SignlCondn.VehicleSpeed -> TuningSelAuth.VehicleSpeed
    connect SignlCondn.VehicleSpeed -> VehDyn.VehicleSpeed
    connect SignlCondn.VehicleSpeed -> VehSpdLmt.VehSpd
    connect SrlComDriver.AccelLat -> SrlComInput.AccelLat
    connect SrlComDriver.AnneeEcoule -> SrlComInput.AnneeEcoule
    connect SrlComDriver.BusOff -> DemIf.BusOff
    connect SrlComDriver.BusOff -> SrlComInput.BusOff
    connect SrlComDriver.ColumnAngleSetpoint -> SrlComInput.ColumnAngleSetpoint
    connect SrlComDriver.CompteurTemporelVehicule -> SrlComInput.CompteurTemporelVehicule
    connect SrlComDriver.ComputerRazGCT -> SrlComInput.ComputerRazGCT
    connect SrlComDriver.ConfigVhl -> SrlComInput.ConfigVhl
    connect SrlComDriver.DiagIntegraElec -> SrlComInput.DiagIntegraElec
    connect SrlComDriver.DiagMuxOn -> SrlComInput.DiagMuxOn
    connect SrlComDriver.DmdDelestDA -> SrlComInput.DmdDelestDA
    connect SrlComDriver.EffacDefaultDiag -> SrlComInput.EffacDefaultDiag
    connect SrlComDriver.ESPDeconnecte -> SrlComInput.ESPDeconnecte
    connect SrlComDriver.EtatMT -> SrlComInput.EtatMT
    connect SrlComDriver.EtatPrincipSev -> SrlComInput.EtatPrincipSevIn
    connect SrlComDriver.EtatReseauElec -> SrlComInput.EtatReseauElecIn
    connect SrlComDriver.ISDAT4V2BSI552MsgDLCError -> SrlComInput.ISDAT4V2BSI552MsgDLCError
    connect SrlComDriver.ISDAT4V2BSI552MsgRxTime -> SrlComInput.ISDAT4V2BSI552MsgRxTime
    connect SrlComDriver.ISDATABR50DMsgDLCError -> SrlComInput.ISDATABR50DMsgDLCError
    connect SrlComDriver.ISDATABR50DMsgRxTime -> SrlComInput.ISDATABR50DMsgRxTime
    connect SrlComDriver.ISDATBSI3F2MsgDLCError -> SrlComInput.ISDATBSI3F2MsgDLCError
    connect SrlComDriver.ISDATBSI3F2MsgRxTime -> SrlComInput.ISDATBSI3F2MsgRxTime
    connect SrlComDriver.ISDATBSI412MsgDLCError -> SrlComInput.ISDATBSI412MsgDLCError
    connect SrlComDriver.ISDATBSI412MsgRxTime -> SrlComInput.ISDATBSI412MsgRxTime
    connect SrlComDriver.ISDATBSI432MsgDLCError -> SrlComInput.ISDATBSI432MsgDLCError
    connect SrlComDriver.ISDATBSI432MsgRxTime -> SrlComInput.ISDATBSI432MsgRxTime
    connect SrlComDriver.ISDATBSI572MsgDLCError -> SrlComInput.ISDATBSI572MsgDLCError
    connect SrlComDriver.ISDATBSI572MsgRxTime -> SrlComInput.ISDATBSI572MsgRxTime
    connect SrlComDriver.ISDATDIRAMsgTxInProgress -> SrlComInput.ISDATDIRAMsgTxInProgress
    connect SrlComDriver.ISDATDIRAMsgTxTime -> SrlComInput.ISDATDIRAMsgTxTime
    connect SrlComDriver.ISDYN2CMMMsgDLCError -> SrlComInput.ISDYN2CMMMsgDLCError
    connect SrlComDriver.ISDYN2CMMMsgRxTime -> SrlComInput.ISDYN2CMMMsgRxTime
    connect SrlComDriver.ISDYN2FRE3CDMsgDLCError -> SrlComInput.ISDYN2FRE3CDMsgDLCError
    connect SrlComDriver.ISDYN2FRE3CDMsgRxTime -> SrlComInput.ISDYN2FRE3CDMsgRxTime
    connect SrlComDriver.ISDYNAASMsg -> SrlComInput.ISDYNAASMsg
    connect SrlComDriver.ISDYNAASMsgDLCError -> SrlComInput.ISDYNAASMsgDLCError
    connect SrlComDriver.ISDYNAASMsgRxTime -> SrlComInput.ISDYNAASMsgRxTime
    connect SrlComDriver.ISDYNABRMsg -> SrlComInput.ISDYNABRMsg
    connect SrlComDriver.ISDYNABRMsgDLCError -> SrlComInput.ISDYNABRMsgDLCError
    connect SrlComDriver.ISDYNABRMsgRxTime -> SrlComInput.ISDYNABRMsgRxTime
    connect SrlComDriver.ISDYNCDS34DMsgDLCError -> SrlComInput.ISDYNCDS34DMsgDLCError
    connect SrlComDriver.ISDYNCDS34DMsgRxTime -> SrlComInput.ISDYNCDS34DMsgRxTime
    connect SrlComDriver.ISDYNCMM208MsgDLCError -> SrlComInput.ISDYNCMM208MsgDLCError
    connect SrlComDriver.ISDYNCMM208MsgRxTime -> SrlComInput.ISDYNCMM208MsgRxTime
    connect SrlComDriver.ISDYNCMM388MsgDLCError -> SrlComInput.ISDYNCMM388MsgDLCError
    connect SrlComDriver.ISDYNCMM388MsgRxTime -> SrlComInput.ISDYNCMM388MsgRxTime
    connect SrlComDriver.ISDYNVOLMsg -> SrlComInput.ISDYNVOLMsg
    connect SrlComDriver.ISDYNVOLMsgDLCError -> SrlComInput.ISDYNVOLMsgDLCError
    connect SrlComDriver.ISDYNVOLMsgRxTime -> SrlComInput.ISDYNVOLMsgRxTime
    connect SrlComDriver.ISINTEELECTRONBSIMsgRxTime -> SrlComInput.ISINTEELECTRONBSIMsgRxTime
    connect SrlComDriver.JourEcoule -> SrlComInput.JourEcoule
    connect SrlComDriver.Kilometrage -> DiagSvc.Mileage
    connect SrlComDriver.Kilometrage -> SrlComInput.KilometrageIn
    connect SrlComDriver.LKAState -> SrlComInput.LKAState
    connect SrlComDriver.LKATrqFactReq -> SrlComInput.LKATrqFactReq
    connect SrlComDriver.LXAActivation -> SrlComInput.LXAActivation
    connect SrlComDriver.ModeDiag -> SrlComInput.ModeDiag
    connect SrlComDriver.PowerSupplies -> SrlComInput.PowerSuppliesIn
    connect SrlComDriver.PROTOHS1DYNUCF5CDMsg -> SrlComInput.PROTOHS1DYNUCF5CDMsg
    connect SrlComDriver.PROTOHS1DYNUCF5CDMsgDLCError -> SrlComInput.PROTOHS1DYNUCF5CDMsgDLCError
    connect SrlComDriver.PROTOHS1DYNUCF5CDMsgRxTime -> SrlComInput.PROTOHS1DYNUCF5CDMsgRxTime
    connect SrlComDriver.RegulABR -> SrlComInput.RegulAbr
    connect SrlComDriver.RegulESP -> SrlComInput.RegulEsp
    connect SrlComDriver.ReqLampeDefEsp -> SrlComInput.ReqLampeDefEsp
    connect SrlComDriver.ReqModeDA -> SrlComInput.ReqModeDA
    connect SrlComDriver.SecondeEcoulee -> SrlComInput.SecondeEcoulee
    connect SrlComDriver.ShuntPosition -> SrlComInput.ShuntPositionIn
    connect SrlComDriver.SrlComDriver_SCom -> NtWrap.C_SrlComDriver_SCom
    connect SrlComDriver.TxEnabled -> FaultLog.TxEnabled
    connect SrlComDriver.TxEnabled -> SrlComOutput.TxEnabled
    connect SrlComDriver.VitesseVehicleBV -> SrlComInput.VitesseVehicleBV
    connect SrlComInput.AbsActv -> PSASH.AbsActv
    connect SrlComInput.AngleVolant -> VehDyn.SrlHwAg
    connect SrlComInput.APAAuthn -> PSASH.ApaAuthn
    connect SrlComInput.ApaRelaxReq -> PSASH.ApaRelaxReq
    connect SrlComInput.APARequest -> PSASH.ApaCmdReq
    connect SrlComInput.ApaVehicleSpeedValid -> PSASH.VehicleSpeedValid
    connect SrlComInput.BSIDataMissing -> FaultLog.BSIDataMissing
    connect SrlComInput.CMMDataMissing -> FaultLog.CMMDataMissing
    connect SrlComInput.ColAngleSetpoint -> PSASH.LxaHwAgCmd
    connect SrlComInput.CompteurTemporelVehiculeRaw -> FaultLog.CompteurTemporelVehicule
    connect SrlComInput.ComputerRazGCTRaw -> FaultLog.ComputerRazGCT
    connect SrlComInput.CPKOK -> PSASH.CpkOk
    connect SrlComInput.DmdDelestDaSts -> CustBattDiag.DmdDelestDa
    connect SrlComInput.DmdDelestDaSts -> VehPwrMd.DmdDelestDASts
    connect SrlComInput.DmdDelestDaVld -> SrlComOutput.DmdDelestDaVld
    connect SrlComInput.DmdDelestDaVld -> VehPwrMd.DmdDelestDaVld
    connect SrlComInput.ElectronicIntegration -> DemIf.ElectronicIntegration
    connect SrlComInput.ElectronicIntegration -> SrlComDriver.ElectronicIntegration
    connect SrlComInput.EnergyModeState -> DigMSB.EnergyModeState
    connect SrlComInput.EngOn -> CustBattDiag.EngOn
    connect SrlComInput.EngOn -> VehPwrMd.EngOn
    connect SrlComInput.EscAckFromSerlCom -> PsaAgArbn.EscAckFromSerlCom
    connect SrlComInput.EscActv -> PSASH.EscActv
    connect SrlComInput.EscDataVldFromSerlCom -> PsaAgArbn.EscDataVldFromSerlCom
    connect SrlComInput.EscEna -> PSASH.EscEna
    connect SrlComInput.EscFltPrsnt -> PSASH.EscFltPrsnt
    connect SrlComInput.EscOffsFromSerlCom -> PsaAgArbn.EscOffsFromSerlCom
    connect SrlComInput.EscPrecisionFromSerlCom -> PsaAgArbn.EscPrecisionFromSerlCom
    connect SrlComInput.EtatMTRaw -> CustBattDiag.EtatMT
    connect SrlComInput.EtatMTRaw -> DemIf.EtatMt
    connect SrlComInput.EtatMTRaw -> DiagSvc.EngineState
    connect SrlComInput.EtatMTRaw -> FaultLog.EngineState
    connect SrlComInput.EtatMTRaw -> SrlComOutput.EtatMT
    connect SrlComInput.EtatMTRaw -> VehPwrMd.EtatMT
    connect SrlComInput.EtatPrincipSev -> FaultLog.EtatPrincipSev
    connect SrlComInput.EtatReseauElec -> FaultLog.EtatReseauElec
    connect SrlComInput.IgnTimeOff -> ThrmlDutyCycle.IgnTimeOff
    connect SrlComInput.ISDAT4V2BSI552MsgRxTimeRaw -> FaultLog.ISDAT4V2BSI552MsgRxTime
    connect SrlComInput.Kilometrage -> FaultLog.Kilometrage
    connect SrlComInput.LxaInpVld -> PSASH.LxaInpVld
    connect SrlComInput.LxaSeln -> PSASH.LpaSeld
    connect SrlComInput.LxaStateFilt -> PSASH.LxaState
    connect SrlComInput.LxaTqFacReq -> PSASH.LxaTqFacReq
    connect SrlComInput.MultiModeVld -> PSADMQ.PersSelnInpVld
    connect SrlComInput.PosSrvoHwAngle -> PSASH.ApaHwAgCmd
    connect SrlComInput.PowerSupplies -> FaultLog.PowerSupplies
    connect SrlComInput.ReqModeDAFinal -> PSADMQ.MultiModSwt
    connect SrlComInput.SerialComAngleValid -> VehDyn.SrlHwAgVld
    connect SrlComInput.ShuntPosition -> FaultLog.ShuntPosition
    connect SrlComInput.SrlComInput_SCom -> NtWrap.C_SrlComInput_SCom
    connect SrlComInput.SrlComVehSpd -> DiagSvc.SrlComVehSpd
    connect SrlComInput.SrlComVehSpd -> FaultLog.VehicleSpeed
    connect SrlComInput.SrlComVehSpd -> SignlCondn.SrlComVehSpeed
    connect SrlComInput.SrlComVehSpd -> VehPwrMd.SrlComVehSpd
    connect SrlComInput.ValidEngineStatus -> CustBattDiag.ValidEngineStatus
    connect SrlComInput.ValidEngineStatus -> SrlComOutput.ValidEngineStatus
    connect SrlComInput.VehicleLatAccel -> ActivePull.EstLatAcc
    connect SrlComInput.VehicleLatAccel -> AvgFricLrn.LatAcc
    connect SrlComInput.VehicleLatAccel -> TrqLOA.VehicleLatAccel
    connect SrlComInput.VehicleLatAccelValid -> TrqLOA.VehicleLatAccelValid
    connect SrlComInput.VehicleSpeedValid -> ActivePull.VehicleSpeedValid
    connect SrlComInput.VehicleSpeedValid -> AvgFricLrn.VehicleSpeedValid
    connect SrlComInput.VehicleSpeedValid -> CmMtrCurr.VhSpdValid
    connect SrlComInput.VehicleSpeedValid -> CustBattDiag.VehicleSpeedValid
    connect SrlComInput.VehicleSpeedValid -> DiagSvc.VehicleSpeedValid
    connect SrlComInput.VehicleSpeedValid -> PsaAgArbn.VehicleSpeedValid
    connect SrlComInput.VehicleSpeedValid -> SrlComOutput.VehicleSpeedValid
    connect SrlComInput.VehicleSpeedValid -> Sweep.VehSpdValid
    connect SrlComInput.VehicleSpeedValid -> TrqLOA.VehicleSpeedValid
    connect SrlComInput.VehicleSpeedValid -> VehDyn.VehicleSpeedValid
    connect SrlComInput.VehicleSpeedValid -> VehPwrMd.VehSpdValid
    connect SrlComInput.VehTimeValid -> ThrmlDutyCycle.VehTimeValid
    connect SrlComInput.VVHType -> SrlComDriver.VVHType
    connect SrlComOutput.IS_DAT_DIRA -> SrlComDriver.IS_DAT_DIRA
    connect SrlComOutput.IS_DYN_DAE -> DiagSvc.IS_DYN_DAE
    connect SrlComOutput.IS_DYN_DAE -> SrlComDriver.IS_DYN_DAE
    connect SrlComOutput.IS_DYN_VOL -> SrlComDriver.IS_DYN_VOL
    connect SrlComOutput.IS_SUPV_DIRA -> DiagSvc.IS_SUPV_DIRA
    connect SrlComOutput.IS_SUPV_DIRA -> SrlComDriver.IS_SUPV_DIRA
    connect StabilityComp.AssistCmd -> AstLmt.AssistCmd
    connect StabilityComp.AssistCmd -> Damping.AssistCmd
    connect StabilityComp2.SysAssistCmd -> StabilityComp.SysAssistCmd_MtrNm
    connect StaMd.MilestoneRqst -> HwPwUp.MilestoneRqst
    connect StaMd.SystemState -> CDDInterface10.SystemState
    connect StaMd.SystemState -> DampingFirewall.SystemState
    connect StaMd.SystemState -> DiagMgr10.SystemState
    connect StaMd.SystemState -> DiagSvc.SystemState
    connect StaMd.SystemState -> DigPhsReasDiag.SystemState
    connect StaMd.SystemState -> FrqDepDmpnInrtCmp.SystemState
    connect StaMd.SystemState -> HwPwUp.SystemState
    connect StaMd.SystemState -> MtrDrvDiag.SystemState
    connect StaMd.SystemState -> OvrVoltMon.SystemState
    connect StaMd.SystemState -> PeakCurrEst.SystemState
    connect StaMd.SystemState -> PICurrCntrl.SystemState
    connect StaMd.SystemState -> PSASH.SystemState
    connect StaMd.SystemState -> PwrLmtFuncCr.SystemState
    connect StaMd.SystemState -> RteErrata10.SystemState
    connect StaMd.SystemState -> SrlComInput.SystemState
    connect StaMd.SystemState -> SrlComOutput.SystemState
    connect StaMd.SystemState -> StaMd.CurrentSystemState
    connect StaMd.SystemState -> TqRsDg.SystemState
    connect StaMd.SystemState -> TranlDampg.SystemState
    connect StaMd11.SystemState11 -> CmMtrCurr.SystemState
    connect StaMd11.SystemState11 -> DiagMgr11.SystemState
    connect StaMd11.SystemState11 -> RteErrata11.SystemState
    connect StaMd6.SystemState6 -> DemIf.SystemState
    connect StaMd6.SystemState6 -> DiagMgr6.SystemState
    connect StaMd6.SystemState6 -> FaultLog.SystemState
    connect StaMd6.SystemState6 -> RteErrata6.SystemState
    connect StaMd6.SystemState6 -> SrlComDriver.SystemState
    connect StaMd9.SystemState9 -> ActivePull.SystemState
    connect StaMd9.SystemState9 -> AvgFricLrn.SystemState
    connect StaMd9.SystemState9 -> BatteryVoltage.SystemState
    connect StaMd9.SystemState9 -> BkCpPc.SystemState
    connect StaMd9.SystemState9 -> CustBattDiag.SystemState
    connect StaMd9.SystemState9 -> DiagMgr9.SystemState
    connect StaMd9.SystemState9 -> ePWM2.SystemState
    connect StaMd9.SystemState9 -> RteErrata9.SystemState
    connect StaMd9.SystemState9 -> ThrmlDutyCycle.SystemState
    connect StaMd9.SystemState9 -> TmprlMon.SystemState
    connect StaMd9.SystemState9 -> VehDyn.SystemState
    connect StaMd9.SystemState9 -> VehPwrMd.SystemState
    connect StOpCtrl.OutputRampMult -> LmtCod.OutputRampMult
    connect StOpCtrl.OutputRampMult -> PSASH.OutputRampMult
    connect StOpCtrl.OutputRampMult -> SrlComOutput.OutputRampMult
    connect StOpCtrl.OutputRampMult -> TqRsDg.OutputRampMult
    connect StOpCtrl.OutputRampMult -> VehPwrMd.OutputRampMult
    connect StOpCtrl.SysStReqDi -> ePWM2.RampDwnStatusComplete
    connect StOpCtrl.SysStReqDi -> SrlComOutput.RampDwnStatusComplete
    connect StOpCtrl.SysStReqDi -> StaMd.RampStatusComplete
    connect StOpCtrl.SysStReqDi -> StaMd11.RampStatusComplete
    connect StOpCtrl.SysStReqDi -> VehPwrMd.RampDwnStatusComplete
    connect Sweep.OutputHwTrq -> ActivePull.HwTorque
    connect Sweep.OutputHwTrq -> Assist.HwTrq
    connect Sweep.OutputHwTrq -> AssistFirewall.HwTorque
    connect Sweep.OutputHwTrq -> AvgFricLrn.HwTrq
    connect Sweep.OutputHwTrq -> Damping.HwTorque
    connect Sweep.OutputHwTrq -> DampingFirewall.HwTorque
    connect Sweep.OutputHwTrq -> DiagMgr10.HwTrq
    connect Sweep.OutputHwTrq -> DiagMgr11.HwTrq
    connect Sweep.OutputHwTrq -> DiagMgr6.HwTrq
    connect Sweep.OutputHwTrq -> DiagMgr9.HwTrq
    connect Sweep.OutputHwTrq -> DiagSvc.HandwheelTorque
    connect Sweep.OutputHwTrq -> EOTActuatorMng.HwTorque
    connect Sweep.OutputHwTrq -> FaultLog.HandwheelTorque
    connect Sweep.OutputHwTrq -> FrqDepDmpnInrtCmp.HwTorque
    connect Sweep.OutputHwTrq -> HighFreqAssist.HwTorque
    connect Sweep.OutputHwTrq -> HOWDetect.HwTrq
    connect Sweep.OutputHwTrq -> HystComp.HwTorque
    connect Sweep.OutputHwTrq -> LrnEOT.HwTorque
    connect Sweep.OutputHwTrq -> PosServo.HwTorque
    connect Sweep.OutputHwTrq -> PsaAgArbn.HwTorque
    connect Sweep.OutputHwTrq -> PSADSG.HwTorque
    connect Sweep.OutputHwTrq -> PSASH.HwTorque
    connect Sweep.OutputHwTrq -> PSATA.HwTorque
    connect Sweep.OutputHwTrq -> Return.HwTorque
    connect Sweep.OutputHwTrq -> SrlComOutput.HandwheelTorque
    connect Sweep.OutputHwTrq -> SrlComOutput.SrlComHwTrq
    connect Sweep.OutputHwTrq -> StabilityComp.HwTorque
    connect Sweep.OutputHwTrq -> StabilityComp2.HwTorque
    connect Sweep.OutputHwTrq -> TuningSelAuth.HwTorque
    connect Sweep.OutputHwTrq -> VehDyn.HwTorque
    connect Sweep2.OutputMtrTrq -> TranlDampg.SumLimTrqCmd
    connect ThrmlDutyCycle.DutyCycleLevel -> Assist.DutyCycleLevel
    connect ThrmlDutyCycle.ThermalLimit -> LmtCod.ThermalLimit
    connect ThrmlDutyCycle.ThermLimitPerc -> AstLmt.ThermalLimitPerc
    connect ThrmlDutyCycle.ThermLimitPerc -> PSASH.ThermLimitPerc
    connect TmprlMon.TMFTestComplete -> HwPwUp.TMFTestComplete
    connect TmprlMon.TMFTestComplete -> SrlComDriver.TMFTestComplete
    connect TmprlMon.TMFTestComplete -> StaMd.TMFTestComplete
    connect TmprlMon.TMFTestComplete -> StaMd11.TMFTestComplete
    connect TqRsDg.MtrCurrIdptSig -> LoaMgr.MotCurrIdptSig
    connect TranlDampg.CntrlDampComp -> ePWM2.CtrldDmpStsCmp
    connect TranlDampg.CntrlDampComp -> StaMd.ControlledDampStatusComplete
    connect TranlDampg.CntrlDampComp -> StaMd11.ControlledDampStatusComplete
    connect TranlDampg.CRFMtrTrqCmd -> AvgFricLrn.CRFMtrTrq
    connect TranlDampg.CRFMtrTrqCmd -> ComplErr.TorqueCmdCRF
    connect TranlDampg.CRFMtrTrqCmd -> PsaAgArbn.TorqueCmdCRF
    connect TranlDampg.CRFMtrTrqCmd -> VehDyn.TorqueCmdCRF
    connect TranlDampg.MRFMtrTrqCmd -> DiagMgr10.MtrTrq
    connect TranlDampg.MRFMtrTrqCmd -> DiagMgr11.MtrTrq
    connect TranlDampg.MRFMtrTrqCmd -> DiagMgr6.MtrTrq
    connect TranlDampg.MRFMtrTrqCmd -> DiagMgr9.MtrTrq
    connect TranlDampg.MRFMtrTrqCmd -> PwrLmtFuncCr.CntDisMtrTrqCmdMRF
    connect TrqCanc.TrqCanc_Scom -> NtWrap.C_TrqCanc_Scom
    connect TrqCmdScl.MRFMtrTrqCmdScl -> CurrCmd.MRFTrqCmdScl
    connect TrqCmdScl.MRFMtrTrqCmdScl -> QuadDet.MRFMtrTrqCmdScl
    connect TrqCmdScl.MRFMtrTrqCmdScl -> TrqCanc.MtrTrqCmdMRFScl
    connect TrqCmdScl.TrqCmdScl_SCom -> NtWrap.C_TrqCmdScl_SCom
    connect TrqLOA.TrqLOAAvail -> LoaMgr.TloaAvail
    connect TrqLOA.TrqLOACmd -> AstLmt.TloaCmd
    connect TuningSelAuth.ActiveTunPers -> ApXcp.ActiveTunPers
    connect TuningSelAuth.ActiveTunSet -> ApXcp.ActiveTunSet
    connect TuningSelAuth.TunReqGranted -> PSADMQ.TunReqGranted
    connect VehDyn.SensorlessAuthority -> AbsHwPos.SensorlessAuthority
    connect VehDyn.SensorlessAuthority -> PsaAgArbn.SensorlessAuthority
    connect VehDyn.SensorlessHwPos -> AbsHwPos.SensorlessHwPos
    connect VehDyn.SensorlessHwPos -> PsaAgArbn.SensorlessHwPos
    connect VehDyn.VehDyn_SCom -> NtWrap.C_VehDyn_SCom
    connect VehPwrMd.ATermActive -> StaMd.ATerm
    connect VehPwrMd.ATermActive -> StaMd11.ATerm
    connect VehPwrMd.CTermActive -> CustBattDiag.CTerm
    connect VehPwrMd.CTermActive -> DemIf.CTerm
    connect VehPwrMd.CTermActive -> SrlComInput.CTermActive
    connect VehPwrMd.CTermActive -> StaMd.CTerm
    connect VehPwrMd.CTermActive -> StaMd11.CTerm
    connect VehPwrMd.OperRampRate -> StOpCtrl.OperRampRate
    connect VehPwrMd.OperRampValue -> StOpCtrl.OperRampValue
    connect VehSpdLmt.AstVehSpdLimit -> LmtCod.AstVehSpdLimit
package /VehicleProject
  system EPS: fibex-element=EPS
    mapping EPS_MPPNG
      sw-impl-mappings:
        107 x swc to impl mapping:
          D_789277D0_FD51_41D8_90B1_A20EF77CB4A2_IMPL: component-implementation=Ap_AbsHwPos_Implementation, component=ECU_Composition.AbsHwPos
          D_149B8C4A_21D3_476B_88F8_C3FA6A83F982_IMPL: component-implementation=Ap_ActivePull_Implementation, component=ECU_Composition.ActivePull
          D_A694BC8D_BD8A_4057_8251_0949FA3FB395_IMPL: component-implementation=Ap_CtrlPolarityBrshlss_Implementation, component=ECU_Composition.Ap_CtrlPolarityBrshlss
          D_EA1D1D55_39F6_4B98_9E14_B63E3850B705_IMPL: component-implementation=Ap_ApXcp_Implementation, component=ECU_Composition.ApXcp
          D_5FB40304_BED4_4625_BF47_BD8ACD3E7727_IMPL: component-implementation=Ap_Assist_Implementation, component=ECU_Composition.Assist
          D_F5AB6A76_3ACE_4013_90AA_404B6CE6A782_IMPL: component-implementation=Ap_AssistFirewall_Implementation, component=ECU_Composition.AssistFirewall
          D_C9BDE675_29D3_44A3_AA59_5FFEB3C413A1_IMPL: component-implementation=Ap_AstLmt_Implementation, component=ECU_Composition.AstLmt
          D_0A3C66D9_7C9D_4485_A5F2_C67F21D5898D_IMPL: component-implementation=Ap_AvgFricLrn_Implementation, component=ECU_Composition.AvgFricLrn
          D_91C68A1C_C31A_4021_BB27_99C28D5B0DD8_IMPL: component-implementation=Ap_BatteryVoltage_Implementation, component=ECU_Composition.BatteryVoltage
          D_D36C7846_6212_4610_9315_5CAAE25A2ED0_IMPL: component-implementation=Sa_BkCpPc_Implementation, component=ECU_Composition.BkCpPc
          D_4F3F0B31_DF12_403E_9E6F_E4D7C9B55DF7_IMPL: component-implementation=Ap_BVDiag_Implementation, component=ECU_Composition.BVDiag
          D_DC692B9D_FD0D_4894_A7B2_C01DFA192DE7_IMPL: component-implementation=Sa_CDDInterface10_Implementation, component=ECU_Composition.CDDInterface10
          D_AA2AC90E_69E0_4743_8A9E_EDAA93C92576_IMPL: component-implementation=Sa_CDDInterface11_Implementation, component=ECU_Composition.CDDInterface11
          D_B6591A90_F59F_4F27_95CC_98229843AF07_IMPL: component-implementation=Sa_CDDInterface6_Implementation, component=ECU_Composition.CDDInterface6
          D_445A90D7_63C1_471E_931A_6F759BECBE6A_IMPL: component-implementation=Sa_CDDInterface9_Implementation, component=ECU_Composition.CDDInterface9
          D_60B7E970_5EF8_4D2D_848A_9EB262F9F2E8_IMPL: component-implementation=Ap_ChkPtAp10_Implementation, component=ECU_Composition.ChkPtAp10
          D_BA13EBFB_06EC_469E_9FAC_F4350A5ABB1E_IMPL: component-implementation=Ap_ChkPtAp11_Implementation, component=ECU_Composition.ChkPtAp11
          D_E4EA64CA_76DF_4ED6_B4AD_4A145F379152_IMPL: component-implementation=Ap_ChkPtAp6_Implementation, component=ECU_Composition.ChkPtAp6
          D_4105AFFA_1F5F_4AFD_A78E_8D981DA08A0A_IMPL: component-implementation=Ap_ChkPtAp9_Implementation, component=ECU_Composition.ChkPtAp9
          D_EC9BCCE6_B4EC_4A30_8ACB_92E65A64EEB7_IMPL: component-implementation=Sa_CmMtrCurr_Implementation, component=ECU_Composition.CmMtrCurr
          D_41131A3D_268B_4D31_BA8E_9C6C49D5C09F_IMPL: component-implementation=Ap_ComplErr_Implementation, component=ECU_Composition.ComplErr
          D_FBAF695C_1165_43B2_AC12_AF543DA4681E_IMPL: component-implementation=Sa_CtrlTemp_Implementation, component=ECU_Composition.CtrlTemp
          D_A78BEC5C_EA2A_43CF_8D39_244E91ADCD68_IMPL: component-implementation=Ap_CurrCmd_Implementation, component=ECU_Composition.CurrCmd
          D_4ACFD918_6814_4C37_9A1B_ADDFCB9F4AC0_IMPL: component-implementation=Ap_CurrParamComp_Implementation, component=ECU_Composition.CurrParamComp
          D_A558EB6B_6D98_4F18_81C1_58BBF12E5A05_IMPL: component-implementation=Ap_CustBattDiag_Implementation, component=ECU_Composition.CustBattDiag
          D_6D9BF964_6891_478D_B6AD_FE3A07B23299_IMPL: component-implementation=Ap_Damping_Implementation, component=ECU_Composition.Damping
          D_4301B862_67A0_4B4F_8858_F7E5D80EB5A7_IMPL: component-implementation=Ap_DampingFirewall_Implementation, component=ECU_Composition.DampingFirewall
          D_4420F45C_6217_4AFC_A45C_4BDA1FB64F8B_IMPL: component-implementation=Ap_DemIf_Implementation, component=ECU_Composition.DemIf
          D_FBE68905_1F20_4E35_A48E_CB70A4F7D547_IMPL: component-implementation=Ap_DiagMgr10_Implementation, component=ECU_Composition.DiagMgr10
          D_1D605359_371C_4DD1_B73B_4E2A94625032_IMPL: component-implementation=Ap_DiagMgr11_Implementation, component=ECU_Composition.DiagMgr11
          D_DF6650F7_B509_4131_ACC9_EA85B531D27B_IMPL: component-implementation=Ap_DiagMgr6_Implementation, component=ECU_Composition.DiagMgr6
          D_D2E4190A_8ECB_46D0_A8BC_D5E98700EED4_IMPL: component-implementation=Ap_DiagMgr9_Implementation, component=ECU_Composition.DiagMgr9
          D_2728C801_595C_4D69_9E88_F9B918391072_IMPL: component-implementation=Ap_DiagSvc_Implementation, component=ECU_Composition.DiagSvc
          D_EA1B67E9_3F31_4EA4_96C2_87E303D3F4A0_IMPL: component-implementation=Sa_DigMSB_Implementation, component=ECU_Composition.DigMSB
          D_B74B0A6B_1932_41C6_B137_BF861BC8CA47_IMPL: component-implementation=Ap_DigPhsReasDiag_Implementation, component=ECU_Composition.DigPhsReasDiag
          D_0FB6F51F_304B_407B_AC22_F4364A3695B1_IMPL: component-implementation=Ap_ElePwr_Implementation, component=ECU_Composition.ElePwr
          D_57040676_1A8B_4F4C_A8AB_A4964497454D_IMPL: component-implementation=Ap_EOTActuatorMng_Implementation, component=ECU_Composition.EOTActuatorMng
          D_04BDD42F_3CA1_43E2_95D4_5BC25B825DE6_IMPL: component-implementation=Ap_ePWM2_Implementation, component=ECU_Composition.ePWM2
          D_16EB6519_DAE3_4E47_B402_81FBE9846907_IMPL: component-implementation=Ap_EtDmpFw_Implementation, component=ECU_Composition.EtDmpFw
          D_22A0B7E6_C33B_4868_A20A_E409C18E40CB_IMPL: component-implementation=Ap_FaultLog_Implementation, component=ECU_Composition.FaultLog
          D_619BD674_A3BD_4858_A168_031E0158E3D5_IMPL: component-implementation=Ap_FltInjection_Implementation, component=ECU_Composition.FltInjection
          D_032DC5B6_9C6D_4331_BB03_DC11B82ED988_IMPL: component-implementation=Ap_FrqDepDmpnInrtCmp_Implementation, component=ECU_Composition.FrqDepDmpnInrtCmp
          D_544733FE_DA42_4BC0_8CD7_DF24F95F6C4E_IMPL: component-implementation=Ap_HighFreqAssist_Implementation, component=ECU_Composition.HighFreqAssist
          D_5D1C6622_7E64_4174_BF9F_BA11E12808E8_IMPL: component-implementation=Ap_HiLoadStall_Implementation, component=ECU_Composition.HiLoadStall
          D_6372A098_8691_4549_8D11_CFB5E6942CC4_IMPL: component-implementation=Ap_HOWDetect_Implementation, component=ECU_Composition.HOWDetect
          D_7CA49939_3AF8_4FD7_A294_89515FEBFEA2_IMPL: component-implementation=Ap_HwPwUp_Implementation, component=ECU_Composition.HwPwUp
          D_3AF5A8D9_C1EB_4AF5_92A7_1B5B16C722FA_IMPL: component-implementation=Sa_HwTqArbn_Implementation, component=ECU_Composition.HwTqArbn
          D_8E34077B_D99B_4C61_BF49_037D0184A970_IMPL: component-implementation=Sa_HwTqCorrln_Implementation, component=ECU_Composition.HwTqCorrln
          D_B75C6781_C4A7_49B6_B997_A734816EDCC1_IMPL: component-implementation=Ap_HystComp_Implementation, component=ECU_Composition.HystComp
          D_4A6C0EF3_EB8C_4218_A4D0_BBF79096363D_IMPL: component-implementation=IoHwAb10_Implementation, component=ECU_Composition.IoHwAb10
          D_CAB81159_F29E_4E6D_871C_1B7357E3CF92_IMPL: component-implementation=IoHwAb9_Implementation, component=ECU_Composition.IoHwAb9
          D_168F7644_41F6_43E3_A042_17CDF0FC191C_IMPL: component-implementation=IoHwAbstraction_Implementation, component=ECU_Composition.IoHwAbsDigSig
          D_03C859AC_D994_4980_B703_C899FA118B13_IMPL: component-implementation=Ap_LmtCod_Implementation, component=ECU_Composition.LmtCod
          D_C67A4806_0393_4F1B_8A59_17AEF90D4F0F_IMPL: component-implementation=Ap_LoaMgr_Implementation, component=ECU_Composition.LoaMgr
          D_876A905D_C6CC_4AA0_A63C_A04600E404AF_IMPL: component-implementation=Ap_LrnEOT_Implementation, component=ECU_Composition.LrnEOT
          D_9CF17787_B77A_4416_9EEB_DA552E2EF59A_IMPL: component-implementation=Sa_MtrDrvDiag_Implementation, component=ECU_Composition.MtrDrvDiag
          D_B4069DCE_3CCF_4730_9588_2EA04F12D425_IMPL: component-implementation=Ap_MtrTempEst_Implementation, component=ECU_Composition.MtrTempEst
          D_DC9F567C_1E4F_48CB_9165_01CA7B41124F_IMPL: component-implementation=Sa_MtrVel_Implementation, component=ECU_Composition.MtrVel
          D_87ACB8F3_799F_4A0E_8883_1B8ED1A719D2_IMPL: component-implementation=Sa_MtrVel2_Implementation, component=ECU_Composition.MtrVel2
          D_06686A35_E348_406C_BCB9_5BB81FDAD5A1_IMPL: component-implementation=Sa_MtrVel3_Implementation, component=ECU_Composition.MtrVel3
          D_C305DA9A_2FCA_4F67_ABD0_25A315CFAE5B_IMPL: component-implementation=Cd_Nhet1CfgAndUse_Implementation, component=ECU_Composition.Nhet1CfgAndUse
          D_9039402D_BE60_4757_9098_7B1CD70A9A3B_IMPL: component-implementation=NtWrap_Implementation, component=ECU_Composition.NtWrap
          D_0F9088E7_AF62_4921_8E49_8EE2C2C2C23C_IMPL: component-implementation=Sa_OvrVoltMon_Implementation, component=ECU_Composition.OvrVoltMon
          D_75A4012D_54F1_4630_A854_F0FB5868D5F6_IMPL: component-implementation=Ap_PeakCurrEst_Implementation, component=ECU_Composition.PeakCurrEst
          D_24533823_E907_40CD_900F_FA4B0659A6BD_IMPL: component-implementation=Cd_PhaseAbcFdbkMeas_Implementation, component=ECU_Composition.PhaseAbcFdbkMeas
          D_B3F82245_30F2_4DD7_9119_95ED25BA82DB_IMPL: component-implementation=Ap_PICurrCntrl_Implementation, component=ECU_Composition.PICurrCntrl
          D_489236FE_C745_4B5A_8338_90D6F54BEB1A_IMPL: component-implementation=Ap_PosServo_Implementation, component=ECU_Composition.PosServo
          D_BE9BD6DE_E9B7_41ED_8C41_D10246E6DD7F_IMPL: component-implementation=Ap_PsaAgArbn_Implementation, component=ECU_Composition.PsaAgArbn
          D_17CA5A09_9B8C_43C1_B3B4_F0F23626FB53_IMPL: component-implementation=Ap_PSADMQ_Implementation, component=ECU_Composition.PSADMQ
          D_5BADE128_5361_4349_A410_4F17263A7530_IMPL: component-implementation=Ap_PSADSG_Implementation, component=ECU_Composition.PSADSG
          D_E0D169CE_95F8_4C73_9A01_FEAE0304999F_IMPL: component-implementation=Ap_PSASH_Implementation, component=ECU_Composition.PSASH
          D_12496FBF_5401_43F4_9D72_4CC2075DAF54_IMPL: component-implementation=Ap_PSATA_Implementation, component=ECU_Composition.PSATA
          D_E2E89660_3D43_4A86_90D5_49A733FADB10_IMPL: component-implementation=Ap_PwrLmtFuncCr_Implementation, component=ECU_Composition.PwrLmtFuncCr
          D_A1B5BF0B_A9B6_4398_A157_7CB86CF73876_IMPL: component-implementation=Ap_QuadDet_Implementation, component=ECU_Composition.QuadDet
          D_0C93545C_00B8_41F8_A936_C7EC8456E778_IMPL: component-implementation=Ap_Return_Implementation, component=ECU_Composition.Return
          D_7D135240_B8AC_4B9B_8E1C_29C98A82ECD4_IMPL: component-implementation=Ap_ReturnFirewall_Implementation, component=ECU_Composition.ReturnFirewall
          D_3979051B_B5FC_406B_916F_D63E66AB2E8F_IMPL: component-implementation=RteErrata10_Implementation, component=ECU_Composition.RteErrata10
          D_67564948_BA54_44D1_B842_D027F1AB3182_IMPL: component-implementation=RteErrata11_Implementation, component=ECU_Composition.RteErrata11
          D_DCDFC83F_E3BB_4310_8459_ECC729C55567_IMPL: component-implementation=RteErrata6_Implementation, component=ECU_Composition.RteErrata6
          D_9A436C80_F2D8_4693_B950_5C798A1E2182_IMPL: component-implementation=RteErrata9_Implementation, component=ECU_Composition.RteErrata9
          D_49584E2A_E84B_446C_A723_FF82E2F791B5_IMPL: component-implementation=Sa_ShtdnMech_Implementation, component=ECU_Composition.ShtdnMech
          D_02D4242B_77CC_4254_8ED0_798D47DCA290_IMPL: component-implementation=Ap_SignlCondn_Implementation, component=ECU_Composition.SignlCondn
          D_D1034EE3_8A03_4EED_BB6B_9AD86A291FAA_IMPL: component-implementation=Cd_SrlComDriver_Implementation, component=ECU_Composition.SrlComDriver
          D_2D58FEE5_F8F6_4CC5_9086_EE413AF2E86F_IMPL: component-implementation=Ap_SrlComInput_Implementation, component=ECU_Composition.SrlComInput
          D_B90E142D_74EA_4C06_AD87_C4E02EC4A959_IMPL: component-implementation=Ap_SrlComOutput_Implementation, component=ECU_Composition.SrlComOutput
          D_1DA039FA_3BC3_4910_A38E_EF4DCBB3619A_IMPL: component-implementation=Ap_StabilityComp_Implementation, component=ECU_Composition.StabilityComp
          D_01A68C43_3D97_4911_92A7_58AA70A0B99F_IMPL: component-implementation=Ap_StabilityComp2_Implementation, component=ECU_Composition.StabilityComp2
          D_84B4C020_BA12_417C_B070_4C0453A080D0_IMPL: component-implementation=Ap_StaMd_Implementation, component=ECU_Composition.StaMd
          D_C00BA5BE_997A_4E2B_9BE2_009E30E2E936_IMPL: component-implementation=Ap_StaMd11_Implementation, component=ECU_Composition.StaMd11
          D_3BB135D2_AF03_419A_A07A_05D9B48979E1_IMPL: component-implementation=Ap_StaMd6_Implementation, component=ECU_Composition.StaMd6
          D_B43E87A1_2902_46D9_A447_7DD451C9CCF2_IMPL: component-implementation=Ap_StaMd9_Implementation, component=ECU_Composition.StaMd9
          D_B15A4998_323C_4717_9221_B2A11C7C8113_IMPL: component-implementation=Ap_StOpCtrl_Implementation, component=ECU_Composition.StOpCtrl
          D_392A6F17_A6BD_4BCC_8730_0E5830C996BD_IMPL: component-implementation=Ap_Sweep_Implementation, component=ECU_Composition.Sweep
          D_59EB9A52_6B37_4B13_B2DA_DAA6AC0AC884_IMPL: component-implementation=Ap_Sweep2_Implementation, component=ECU_Composition.Sweep2
          D_F3FBBE42_A3C8_49E8_9943_D0E681D21410_IMPL: component-implementation=Ap_ThrmlDutyCycle_Implementation, component=ECU_Composition.ThrmlDutyCycle
          D_30200635_25C5_4A9F_8D03_0F8AE2807F22_IMPL: component-implementation=Sa_TmprlMon_Implementation, component=ECU_Composition.TmprlMon
          D_9D979CA0_380B_4C3B_A454_54F145510051_IMPL: component-implementation=Sa_TmprlMon2_Implementation, component=ECU_Composition.TmprlMon2
          D_7BF150C0_7D1C_4C5F_84D8_F6B7456D80D3_IMPL: component-implementation=Ap_TqRsDg_Implementation, component=ECU_Composition.TqRsDg
          D_D7085736_23FB_44A7_86D2_724CB582D359_IMPL: component-implementation=Ap_TranlDampg_Implementation, component=ECU_Composition.TranlDampg
          D_8FDD87F8_34F5_47C7_A9BF_2C12260C629A_IMPL: component-implementation=Ap_TrqCanc_Implementation, component=ECU_Composition.TrqCanc
          D_95542286_71D4_4700_BDBC_B8593BCA890A_IMPL: component-implementation=Ap_TrqCmdScl_Implementation, component=ECU_Composition.TrqCmdScl
          D_C298E48E_7D6A_4FCF_939C_7738317320E4_IMPL: component-implementation=Ap_TrqLOA_Implementation, component=ECU_Composition.TrqLOA
          D_9CDB03B3_66E9_4124_B635_E264E1AB810C_IMPL: component-implementation=Ap_TuningSelAuth_Implementation, component=ECU_Composition.TuningSelAuth
          D_66BB528B_9F68_4E38_AD08_EA74EA678246_IMPL: component-implementation=Cd_uDiag_Implementation, component=ECU_Composition.uDiag
          D_17AA7964_51E1_45A6_96AD_C998B51EE7FC_IMPL: component-implementation=Ap_VehDyn_Implementation, component=ECU_Composition.VehDyn
          D_1ED374D4_E1A4_4A8C_816A_B038EF4BFB5D_IMPL: component-implementation=Ap_VehPwrMd_Implementation, component=ECU_Composition.VehPwrMd
          D_A4319678_09D6_4C66_89A8_058120618448_IMPL: component-implementation=Ap_VehSpdLmt_Implementation, component=ECU_Composition.VehSpdLmt
      sw-mappings:
        107 x swc to ecu mapping, all with ecu-instance=EPS:
          D_789277D0_FD51_41D8_90B1_A20EF77CB4A2_: component=ECU_Composition.AbsHwPos
          D_149B8C4A_21D3_476B_88F8_C3FA6A83F982_: component=ECU_Composition.ActivePull
          D_A694BC8D_BD8A_4057_8251_0949FA3FB395_: component=ECU_Composition.Ap_CtrlPolarityBrshlss
          D_EA1D1D55_39F6_4B98_9E14_B63E3850B705_: component=ECU_Composition.ApXcp
          D_5FB40304_BED4_4625_BF47_BD8ACD3E7727_: component=ECU_Composition.Assist
          D_F5AB6A76_3ACE_4013_90AA_404B6CE6A782_: component=ECU_Composition.AssistFirewall
          D_C9BDE675_29D3_44A3_AA59_5FFEB3C413A1_: component=ECU_Composition.AstLmt
          D_0A3C66D9_7C9D_4485_A5F2_C67F21D5898D_: component=ECU_Composition.AvgFricLrn
          D_91C68A1C_C31A_4021_BB27_99C28D5B0DD8_: component=ECU_Composition.BatteryVoltage
          D_D36C7846_6212_4610_9315_5CAAE25A2ED0_: component=ECU_Composition.BkCpPc
          D_4F3F0B31_DF12_403E_9E6F_E4D7C9B55DF7_: component=ECU_Composition.BVDiag
          D_DC692B9D_FD0D_4894_A7B2_C01DFA192DE7_: component=ECU_Composition.CDDInterface10
          D_AA2AC90E_69E0_4743_8A9E_EDAA93C92576_: component=ECU_Composition.CDDInterface11
          D_B6591A90_F59F_4F27_95CC_98229843AF07_: component=ECU_Composition.CDDInterface6
          D_445A90D7_63C1_471E_931A_6F759BECBE6A_: component=ECU_Composition.CDDInterface9
          D_60B7E970_5EF8_4D2D_848A_9EB262F9F2E8_: component=ECU_Composition.ChkPtAp10
          D_BA13EBFB_06EC_469E_9FAC_F4350A5ABB1E_: component=ECU_Composition.ChkPtAp11
          D_E4EA64CA_76DF_4ED6_B4AD_4A145F379152_: component=ECU_Composition.ChkPtAp6
          D_4105AFFA_1F5F_4AFD_A78E_8D981DA08A0A_: component=ECU_Composition.ChkPtAp9
          D_EC9BCCE6_B4EC_4A30_8ACB_92E65A64EEB7_: component=ECU_Composition.CmMtrCurr
          D_41131A3D_268B_4D31_BA8E_9C6C49D5C09F_: component=ECU_Composition.ComplErr
          D_FBAF695C_1165_43B2_AC12_AF543DA4681E_: component=ECU_Composition.CtrlTemp
          D_A78BEC5C_EA2A_43CF_8D39_244E91ADCD68_: component=ECU_Composition.CurrCmd
          D_4ACFD918_6814_4C37_9A1B_ADDFCB9F4AC0_: component=ECU_Composition.CurrParamComp
          D_A558EB6B_6D98_4F18_81C1_58BBF12E5A05_: component=ECU_Composition.CustBattDiag
          D_6D9BF964_6891_478D_B6AD_FE3A07B23299_: component=ECU_Composition.Damping
          D_4301B862_67A0_4B4F_8858_F7E5D80EB5A7_: component=ECU_Composition.DampingFirewall
          D_4420F45C_6217_4AFC_A45C_4BDA1FB64F8B_: component=ECU_Composition.DemIf
          D_FBE68905_1F20_4E35_A48E_CB70A4F7D547_: component=ECU_Composition.DiagMgr10
          D_1D605359_371C_4DD1_B73B_4E2A94625032_: component=ECU_Composition.DiagMgr11
          D_DF6650F7_B509_4131_ACC9_EA85B531D27B_: component=ECU_Composition.DiagMgr6
          D_D2E4190A_8ECB_46D0_A8BC_D5E98700EED4_: component=ECU_Composition.DiagMgr9
          D_2728C801_595C_4D69_9E88_F9B918391072_: component=ECU_Composition.DiagSvc
          D_EA1B67E9_3F31_4EA4_96C2_87E303D3F4A0_: component=ECU_Composition.DigMSB
          D_B74B0A6B_1932_41C6_B137_BF861BC8CA47_: component=ECU_Composition.DigPhsReasDiag
          D_0FB6F51F_304B_407B_AC22_F4364A3695B1_: component=ECU_Composition.ElePwr
          D_57040676_1A8B_4F4C_A8AB_A4964497454D_: component=ECU_Composition.EOTActuatorMng
          D_04BDD42F_3CA1_43E2_95D4_5BC25B825DE6_: component=ECU_Composition.ePWM2
          D_16EB6519_DAE3_4E47_B402_81FBE9846907_: component=ECU_Composition.EtDmpFw
          D_22A0B7E6_C33B_4868_A20A_E409C18E40CB_: component=ECU_Composition.FaultLog
          D_619BD674_A3BD_4858_A168_031E0158E3D5_: component=ECU_Composition.FltInjection
          D_032DC5B6_9C6D_4331_BB03_DC11B82ED988_: component=ECU_Composition.FrqDepDmpnInrtCmp
          D_544733FE_DA42_4BC0_8CD7_DF24F95F6C4E_: component=ECU_Composition.HighFreqAssist
          D_5D1C6622_7E64_4174_BF9F_BA11E12808E8_: component=ECU_Composition.HiLoadStall
          D_6372A098_8691_4549_8D11_CFB5E6942CC4_: component=ECU_Composition.HOWDetect
          D_7CA49939_3AF8_4FD7_A294_89515FEBFEA2_: component=ECU_Composition.HwPwUp
          D_3AF5A8D9_C1EB_4AF5_92A7_1B5B16C722FA_: component=ECU_Composition.HwTqArbn
          D_8E34077B_D99B_4C61_BF49_037D0184A970_: component=ECU_Composition.HwTqCorrln
          D_B75C6781_C4A7_49B6_B997_A734816EDCC1_: component=ECU_Composition.HystComp
          D_4A6C0EF3_EB8C_4218_A4D0_BBF79096363D_: component=ECU_Composition.IoHwAb10
          D_CAB81159_F29E_4E6D_871C_1B7357E3CF92_: component=ECU_Composition.IoHwAb9
          D_168F7644_41F6_43E3_A042_17CDF0FC191C_: component=ECU_Composition.IoHwAbsDigSig
          D_03C859AC_D994_4980_B703_C899FA118B13_: component=ECU_Composition.LmtCod
          D_C67A4806_0393_4F1B_8A59_17AEF90D4F0F_: component=ECU_Composition.LoaMgr
          D_876A905D_C6CC_4AA0_A63C_A04600E404AF_: component=ECU_Composition.LrnEOT
          D_9CF17787_B77A_4416_9EEB_DA552E2EF59A_: component=ECU_Composition.MtrDrvDiag
          D_B4069DCE_3CCF_4730_9588_2EA04F12D425_: component=ECU_Composition.MtrTempEst
          D_DC9F567C_1E4F_48CB_9165_01CA7B41124F_: component=ECU_Composition.MtrVel
          D_87ACB8F3_799F_4A0E_8883_1B8ED1A719D2_: component=ECU_Composition.MtrVel2
          D_06686A35_E348_406C_BCB9_5BB81FDAD5A1_: component=ECU_Composition.MtrVel3
          D_C305DA9A_2FCA_4F67_ABD0_25A315CFAE5B_: component=ECU_Composition.Nhet1CfgAndUse
          D_9039402D_BE60_4757_9098_7B1CD70A9A3B_: component=ECU_Composition.NtWrap
          D_0F9088E7_AF62_4921_8E49_8EE2C2C2C23C_: component=ECU_Composition.OvrVoltMon
          D_75A4012D_54F1_4630_A854_F0FB5868D5F6_: component=ECU_Composition.PeakCurrEst
          D_24533823_E907_40CD_900F_FA4B0659A6BD_: component=ECU_Composition.PhaseAbcFdbkMeas
          D_B3F82245_30F2_4DD7_9119_95ED25BA82DB_: component=ECU_Composition.PICurrCntrl
          D_489236FE_C745_4B5A_8338_90D6F54BEB1A_: component=ECU_Composition.PosServo
          D_BE9BD6DE_E9B7_41ED_8C41_D10246E6DD7F_: component=ECU_Composition.PsaAgArbn
          D_17CA5A09_9B8C_43C1_B3B4_F0F23626FB53_: component=ECU_Composition.PSADMQ
          D_5BADE128_5361_4349_A410_4F17263A7530_: component=ECU_Composition.PSADSG
          D_E0D169CE_95F8_4C73_9A01_FEAE0304999F_: component=ECU_Composition.PSASH
          D_12496FBF_5401_43F4_9D72_4CC2075DAF54_: component=ECU_Composition.PSATA
          D_E2E89660_3D43_4A86_90D5_49A733FADB10_: component=ECU_Composition.PwrLmtFuncCr
          D_A1B5BF0B_A9B6_4398_A157_7CB86CF73876_: component=ECU_Composition.QuadDet
          D_0C93545C_00B8_41F8_A936_C7EC8456E778_: component=ECU_Composition.Return
          D_7D135240_B8AC_4B9B_8E1C_29C98A82ECD4_: component=ECU_Composition.ReturnFirewall
          D_3979051B_B5FC_406B_916F_D63E66AB2E8F_: component=ECU_Composition.RteErrata10
          D_67564948_BA54_44D1_B842_D027F1AB3182_: component=ECU_Composition.RteErrata11
          D_DCDFC83F_E3BB_4310_8459_ECC729C55567_: component=ECU_Composition.RteErrata6
          D_9A436C80_F2D8_4693_B950_5C798A1E2182_: component=ECU_Composition.RteErrata9
          D_49584E2A_E84B_446C_A723_FF82E2F791B5_: component=ECU_Composition.ShtdnMech
          D_02D4242B_77CC_4254_8ED0_798D47DCA290_: component=ECU_Composition.SignlCondn
          D_D1034EE3_8A03_4EED_BB6B_9AD86A291FAA_: component=ECU_Composition.SrlComDriver
          D_2D58FEE5_F8F6_4CC5_9086_EE413AF2E86F_: component=ECU_Composition.SrlComInput
          D_B90E142D_74EA_4C06_AD87_C4E02EC4A959_: component=ECU_Composition.SrlComOutput
          D_1DA039FA_3BC3_4910_A38E_EF4DCBB3619A_: component=ECU_Composition.StabilityComp
          D_01A68C43_3D97_4911_92A7_58AA70A0B99F_: component=ECU_Composition.StabilityComp2
          D_84B4C020_BA12_417C_B070_4C0453A080D0_: component=ECU_Composition.StaMd
          D_C00BA5BE_997A_4E2B_9BE2_009E30E2E936_: component=ECU_Composition.StaMd11
          D_3BB135D2_AF03_419A_A07A_05D9B48979E1_: component=ECU_Composition.StaMd6
          D_B43E87A1_2902_46D9_A447_7DD451C9CCF2_: component=ECU_Composition.StaMd9
          D_B15A4998_323C_4717_9221_B2A11C7C8113_: component=ECU_Composition.StOpCtrl
          D_392A6F17_A6BD_4BCC_8730_0E5830C996BD_: component=ECU_Composition.Sweep
          D_59EB9A52_6B37_4B13_B2DA_DAA6AC0AC884_: component=ECU_Composition.Sweep2
          D_F3FBBE42_A3C8_49E8_9943_D0E681D21410_: component=ECU_Composition.ThrmlDutyCycle
          D_30200635_25C5_4A9F_8D03_0F8AE2807F22_: component=ECU_Composition.TmprlMon
          D_9D979CA0_380B_4C3B_A454_54F145510051_: component=ECU_Composition.TmprlMon2
          D_7BF150C0_7D1C_4C5F_84D8_F6B7456D80D3_: component=ECU_Composition.TqRsDg
          D_D7085736_23FB_44A7_86D2_724CB582D359_: component=ECU_Composition.TranlDampg
          D_8FDD87F8_34F5_47C7_A9BF_2C12260C629A_: component=ECU_Composition.TrqCanc
          D_95542286_71D4_4700_BDBC_B8593BCA890A_: component=ECU_Composition.TrqCmdScl
          D_C298E48E_7D6A_4FCF_939C_7738317320E4_: component=ECU_Composition.TrqLOA
          D_9CDB03B3_66E9_4124_B635_E264E1AB810C_: component=ECU_Composition.TuningSelAuth
          D_66BB528B_9F68_4E38_AD08_EA74EA678246_: component=ECU_Composition.uDiag
          D_17AA7964_51E1_45A6_96AD_C998B51EE7FC_: component=ECU_Composition.VehDyn
          D_1ED374D4_E1A4_4A8C_816A_B038EF4BFB5D_: component=ECU_Composition.VehPwrMd
          D_A4319678_09D6_4C66_89A8_058120618448_: component=ECU_Composition.VehSpdLmt
    software composition ECU_Composition: software-composition=ECU_Composition
