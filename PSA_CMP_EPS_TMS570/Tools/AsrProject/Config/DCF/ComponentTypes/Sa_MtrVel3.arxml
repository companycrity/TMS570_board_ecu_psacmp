AUTOSAR XML (schema 314)
package /ComponentType
  internal behavior Sa_MtrVel3_InternalBehavior: component=Sa_MtrVel3
    timing event MtrVel3_InitEvent: start-on-event=MtrVel3_Init, period=0
    runnable MtrVel3_Init
  sensor actuator software component type Sa_MtrVel3
  swc implementation Sa_MtrVel3_Implementation: behavior=Sa_MtrVel3_InternalBehavior
    code-descriptors:
      code Code: type=SRC
