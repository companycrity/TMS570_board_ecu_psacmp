AUTOSAR XML (schema 314)
package /ComponentType
  internal behavior WdgM_InternalBehavior: component=WdgM
    78 x operation invoked event:
      OIT_ActivateSupervisionEntity_SE000_SE_2ms_9_ActivateSupervisionEntity: start-on-event=ActivateSupervisionEntity, operation=SE000_SE_2ms_9.ActivateSupervisionEntity
      OIT_ActivateSupervisionEntity_SE001_SE_2ms_10_ActivateSupervisionEntity: start-on-event=ActivateSupervisionEntity, operation=SE001_SE_2ms_10.ActivateSupervisionEntity
      OIT_ActivateSupervisionEntity_SE002_SE_2ms_11_ActivateSupervisionEntity: start-on-event=ActivateSupervisionEntity, operation=SE002_SE_2ms_11.ActivateSupervisionEntity
      OIT_ActivateSupervisionEntity_SE003_SE_2ms_6_ActivateSupervisionEntity: start-on-event=ActivateSupervisionEntity, operation=SE003_SE_2ms_6.ActivateSupervisionEntity
      OIT_ActivateSupervisionEntity_SE004_SE_4ms_9_ActivateSupervisionEntity: start-on-event=ActivateSupervisionEntity, operation=SE004_SE_4ms_9.ActivateSupervisionEntity
      OIT_ActivateSupervisionEntity_SE005_SE_4ms_10_ActivateSupervisionEntity: start-on-event=ActivateSupervisionEntity, operation=SE005_SE_4ms_10.ActivateSupervisionEntity
      OIT_ActivateSupervisionEntity_SE006_SE_10ms_9_ActivateSupervisionEntity: start-on-event=ActivateSupervisionEntity, operation=SE006_SE_10ms_9.ActivateSupervisionEntity
      OIT_ActivateSupervisionEntity_SE007_SE_10ms_10a_ActivateSupervisionEntity: start-on-event=ActivateSupervisionEntity, operation=SE007_SE_10ms_10a.ActivateSupervisionEntity
      OIT_ActivateSupervisionEntity_SE008_SE_10ms_6_ActivateSupervisionEntity: start-on-event=ActivateSupervisionEntity, operation=SE008_SE_10ms_6.ActivateSupervisionEntity
      OIT_ActivateSupervisionEntity_SE009_SE_10ms_10b_ActivateSupervisionEntity: start-on-event=ActivateSupervisionEntity, operation=SE009_SE_10ms_10b.ActivateSupervisionEntity
      OIT_ActivateSupervisionEntity_SE010_SE_10ms_11_ActivateSupervisionEntity: start-on-event=ActivateSupervisionEntity, operation=SE010_SE_10ms_11.ActivateSupervisionEntity
      OIT_ActivateSupervisionEntity_SE011_SE_100ms_9_ActivateSupervisionEntity: start-on-event=ActivateSupervisionEntity, operation=SE011_SE_100ms_9.ActivateSupervisionEntity
      OIT_ActivateSupervisionEntity_SE012_SE_100ms_10_ActivateSupervisionEntity: start-on-event=ActivateSupervisionEntity, operation=SE012_SE_100ms_10.ActivateSupervisionEntity
      OIT_ActivateSupervisionEntity_SE013_SE_100ms_11_ActivateSupervisionEntity: start-on-event=ActivateSupervisionEntity, operation=SE013_SE_100ms_11.ActivateSupervisionEntity
      OIT_ActivateSupervisionEntity_SE014_SE_100ms_6_ActivateSupervisionEntity: start-on-event=ActivateSupervisionEntity, operation=SE014_SE_100ms_6.ActivateSupervisionEntity
      OIT_CheckpointReached_SE000_SE_2ms_9_CP000_ChkPtAp9_2msStart_CP_CheckpointReached: start-on-event=CheckpointReached, operation=SE000_SE_2ms_9_CP000_ChkPtAp9_2msStart_CP.CheckpointReached
      OIT_CheckpointReached_SE000_SE_2ms_9_CP001_ChkPtAp9_2msEnd_CP_CheckpointReached: start-on-event=CheckpointReached, operation=SE000_SE_2ms_9_CP001_ChkPtAp9_2msEnd_CP.CheckpointReached
      OIT_CheckpointReached_SE001_SE_2ms_10_CP000_ChkPtAp10_2msStart_CP_CheckpointReached: start-on-event=CheckpointReached, operation=SE001_SE_2ms_10_CP000_ChkPtAp10_2msStart_CP.CheckpointReached
      OIT_CheckpointReached_SE001_SE_2ms_10_CP001_ChkPtAp10_2msEnd_CP_CheckpointReached: start-on-event=CheckpointReached, operation=SE001_SE_2ms_10_CP001_ChkPtAp10_2msEnd_CP.CheckpointReached
      OIT_CheckpointReached_SE002_SE_2ms_11_CP000_ChkPtAp11_2msStart_CP_CheckpointReached: start-on-event=CheckpointReached, operation=SE002_SE_2ms_11_CP000_ChkPtAp11_2msStart_CP.CheckpointReached
      OIT_CheckpointReached_SE002_SE_2ms_11_CP001_ChkPtAp11_2msEnd_CP_CheckpointReached: start-on-event=CheckpointReached, operation=SE002_SE_2ms_11_CP001_ChkPtAp11_2msEnd_CP.CheckpointReached
      OIT_CheckpointReached_SE003_SE_2ms_6_CP000_ChkPtAp6_2msStart_CP_CheckpointReached: start-on-event=CheckpointReached, operation=SE003_SE_2ms_6_CP000_ChkPtAp6_2msStart_CP.CheckpointReached
      OIT_CheckpointReached_SE003_SE_2ms_6_CP001_ChkPtAp6_2msEnd_CP_CheckpointReached: start-on-event=CheckpointReached, operation=SE003_SE_2ms_6_CP001_ChkPtAp6_2msEnd_CP.CheckpointReached
      OIT_CheckpointReached_SE004_SE_4ms_9_CP000_ChkPtAp9_4msStart_CP_CheckpointReached: start-on-event=CheckpointReached, operation=SE004_SE_4ms_9_CP000_ChkPtAp9_4msStart_CP.CheckpointReached
      OIT_CheckpointReached_SE004_SE_4ms_9_CP001_ChkPtAp9_4msEnd_CP_CheckpointReached: start-on-event=CheckpointReached, operation=SE004_SE_4ms_9_CP001_ChkPtAp9_4msEnd_CP.CheckpointReached
      OIT_CheckpointReached_SE005_SE_4ms_10_CP000_ChkPtAp10_4msStart_CP_CheckpointReached: start-on-event=CheckpointReached, operation=SE005_SE_4ms_10_CP000_ChkPtAp10_4msStart_CP.CheckpointReached
      OIT_CheckpointReached_SE005_SE_4ms_10_CP001_ChkPtAp10_4msEnd_CP_CheckpointReached: start-on-event=CheckpointReached, operation=SE005_SE_4ms_10_CP001_ChkPtAp10_4msEnd_CP.CheckpointReached
      OIT_CheckpointReached_SE006_SE_10ms_9_CP000_ChkPtAp9_10msStart_CP_CheckpointReached: start-on-event=CheckpointReached, operation=SE006_SE_10ms_9_CP000_ChkPtAp9_10msStart_CP.CheckpointReached
      OIT_CheckpointReached_SE006_SE_10ms_9_CP001_ChkPtAp9_10msEnd_CP_CheckpointReached: start-on-event=CheckpointReached, operation=SE006_SE_10ms_9_CP001_ChkPtAp9_10msEnd_CP.CheckpointReached
      OIT_CheckpointReached_SE007_SE_10ms_10a_CP000_ChkPtAp10_10msaStart_CP_CheckpointReached: start-on-event=CheckpointReached, operation=SE007_SE_10ms_10a_CP000_ChkPtAp10_10msaStart_CP.CheckpointReached
      OIT_CheckpointReached_SE007_SE_10ms_10a_CP001_ChkPtAp10_10msaEnd_CP_CheckpointReached: start-on-event=CheckpointReached, operation=SE007_SE_10ms_10a_CP001_ChkPtAp10_10msaEnd_CP.CheckpointReached
      OIT_CheckpointReached_SE008_SE_10ms_6_CP000_ChkPtAp6_10msStart_CP_CheckpointReached: start-on-event=CheckpointReached, operation=SE008_SE_10ms_6_CP000_ChkPtAp6_10msStart_CP.CheckpointReached
      OIT_CheckpointReached_SE008_SE_10ms_6_CP001_ChkPtAp6_10msEnd_CP_CheckpointReached: start-on-event=CheckpointReached, operation=SE008_SE_10ms_6_CP001_ChkPtAp6_10msEnd_CP.CheckpointReached
      OIT_CheckpointReached_SE009_SE_10ms_10b_CP000_ChkPtAp10_10msbStart_CP_CheckpointReached: start-on-event=CheckpointReached, operation=SE009_SE_10ms_10b_CP000_ChkPtAp10_10msbStart_CP.CheckpointReached
      OIT_CheckpointReached_SE009_SE_10ms_10b_CP001_ChkPtAp10_10msbEnd_CP_CheckpointReached: start-on-event=CheckpointReached, operation=SE009_SE_10ms_10b_CP001_ChkPtAp10_10msbEnd_CP.CheckpointReached
      OIT_CheckpointReached_SE010_SE_10ms_11_CP000_ChkPtAp11_10msStart_CP_CheckpointReached: start-on-event=CheckpointReached, operation=SE010_SE_10ms_11_CP000_ChkPtAp11_10msStart_CP.CheckpointReached
      OIT_CheckpointReached_SE010_SE_10ms_11_CP001_ChkPtAp11_10msEnd_CP_CheckpointReached: start-on-event=CheckpointReached, operation=SE010_SE_10ms_11_CP001_ChkPtAp11_10msEnd_CP.CheckpointReached
      OIT_CheckpointReached_SE011_SE_100ms_9_CP000_ChkPtAp9_100msStart_CP_CheckpointReached: start-on-event=CheckpointReached, operation=SE011_SE_100ms_9_CP000_ChkPtAp9_100msStart_CP.CheckpointReached
      OIT_CheckpointReached_SE011_SE_100ms_9_CP001_ChkPtAp9_100msEnd_CP_CheckpointReached: start-on-event=CheckpointReached, operation=SE011_SE_100ms_9_CP001_ChkPtAp9_100msEnd_CP.CheckpointReached
      OIT_CheckpointReached_SE012_SE_100ms_10_CP000_ChkPtAp10_100msStart_CP_CheckpointReached: start-on-event=CheckpointReached, operation=SE012_SE_100ms_10_CP000_ChkPtAp10_100msStart_CP.CheckpointReached
      OIT_CheckpointReached_SE012_SE_100ms_10_CP001_ChkPtAp10_100msEnd_CP_CheckpointReached: start-on-event=CheckpointReached, operation=SE012_SE_100ms_10_CP001_ChkPtAp10_100msEnd_CP.CheckpointReached
      OIT_CheckpointReached_SE013_SE_100ms_11_CP000_ChkPtAp11_100msStart_CP_CheckpointReached: start-on-event=CheckpointReached, operation=SE013_SE_100ms_11_CP000_ChkPtAp11_100msStart_CP.CheckpointReached
      OIT_CheckpointReached_SE013_SE_100ms_11_CP001_ChkPtAp11_100msEnd_CP_CheckpointReached: start-on-event=CheckpointReached, operation=SE013_SE_100ms_11_CP001_ChkPtAp11_100msEnd_CP.CheckpointReached
      OIT_CheckpointReached_SE014_SE_100ms_6_CP000_ChkPtAp6_100msStart_CP_CheckpointReached: start-on-event=CheckpointReached, operation=SE014_SE_100ms_6_CP000_ChkPtAp6_100msStart_CP.CheckpointReached
      OIT_CheckpointReached_SE014_SE_100ms_6_CP001_ChkPtAp6_100msEnd_CP_CheckpointReached: start-on-event=CheckpointReached, operation=SE014_SE_100ms_6_CP001_ChkPtAp6_100msEnd_CP.CheckpointReached
      OIT_DeactivateSupervisionEntity_SE000_SE_2ms_9_DeactivateSupervisionEntity: start-on-event=DeactivateSupervisionEntity, operation=SE000_SE_2ms_9.DeactivateSupervisionEntity
      OIT_DeactivateSupervisionEntity_SE001_SE_2ms_10_DeactivateSupervisionEntity: start-on-event=DeactivateSupervisionEntity, operation=SE001_SE_2ms_10.DeactivateSupervisionEntity
      OIT_DeactivateSupervisionEntity_SE002_SE_2ms_11_DeactivateSupervisionEntity: start-on-event=DeactivateSupervisionEntity, operation=SE002_SE_2ms_11.DeactivateSupervisionEntity
      OIT_DeactivateSupervisionEntity_SE003_SE_2ms_6_DeactivateSupervisionEntity: start-on-event=DeactivateSupervisionEntity, operation=SE003_SE_2ms_6.DeactivateSupervisionEntity
      OIT_DeactivateSupervisionEntity_SE004_SE_4ms_9_DeactivateSupervisionEntity: start-on-event=DeactivateSupervisionEntity, operation=SE004_SE_4ms_9.DeactivateSupervisionEntity
      OIT_DeactivateSupervisionEntity_SE005_SE_4ms_10_DeactivateSupervisionEntity: start-on-event=DeactivateSupervisionEntity, operation=SE005_SE_4ms_10.DeactivateSupervisionEntity
      OIT_DeactivateSupervisionEntity_SE006_SE_10ms_9_DeactivateSupervisionEntity: start-on-event=DeactivateSupervisionEntity, operation=SE006_SE_10ms_9.DeactivateSupervisionEntity
      OIT_DeactivateSupervisionEntity_SE007_SE_10ms_10a_DeactivateSupervisionEntity: start-on-event=DeactivateSupervisionEntity, operation=SE007_SE_10ms_10a.DeactivateSupervisionEntity
      OIT_DeactivateSupervisionEntity_SE008_SE_10ms_6_DeactivateSupervisionEntity: start-on-event=DeactivateSupervisionEntity, operation=SE008_SE_10ms_6.DeactivateSupervisionEntity
      OIT_DeactivateSupervisionEntity_SE009_SE_10ms_10b_DeactivateSupervisionEntity: start-on-event=DeactivateSupervisionEntity, operation=SE009_SE_10ms_10b.DeactivateSupervisionEntity
      OIT_DeactivateSupervisionEntity_SE010_SE_10ms_11_DeactivateSupervisionEntity: start-on-event=DeactivateSupervisionEntity, operation=SE010_SE_10ms_11.DeactivateSupervisionEntity
      OIT_DeactivateSupervisionEntity_SE011_SE_100ms_9_DeactivateSupervisionEntity: start-on-event=DeactivateSupervisionEntity, operation=SE011_SE_100ms_9.DeactivateSupervisionEntity
      OIT_DeactivateSupervisionEntity_SE012_SE_100ms_10_DeactivateSupervisionEntity: start-on-event=DeactivateSupervisionEntity, operation=SE012_SE_100ms_10.DeactivateSupervisionEntity
      OIT_DeactivateSupervisionEntity_SE013_SE_100ms_11_DeactivateSupervisionEntity: start-on-event=DeactivateSupervisionEntity, operation=SE013_SE_100ms_11.DeactivateSupervisionEntity
      OIT_DeactivateSupervisionEntity_SE014_SE_100ms_6_DeactivateSupervisionEntity: start-on-event=DeactivateSupervisionEntity, operation=SE014_SE_100ms_6.DeactivateSupervisionEntity
      OIT_GetGlobalStatus_Global_GetGlobalStatus: start-on-event=GetGlobalStatus, operation=Global.GetGlobalStatus
      OIT_GetLocalStatus_SE000_SE_2ms_9_GetLocalStatus: start-on-event=GetLocalStatus, operation=SE000_SE_2ms_9.GetLocalStatus
      OIT_GetLocalStatus_SE001_SE_2ms_10_GetLocalStatus: start-on-event=GetLocalStatus, operation=SE001_SE_2ms_10.GetLocalStatus
      OIT_GetLocalStatus_SE002_SE_2ms_11_GetLocalStatus: start-on-event=GetLocalStatus, operation=SE002_SE_2ms_11.GetLocalStatus
      OIT_GetLocalStatus_SE003_SE_2ms_6_GetLocalStatus: start-on-event=GetLocalStatus, operation=SE003_SE_2ms_6.GetLocalStatus
      OIT_GetLocalStatus_SE004_SE_4ms_9_GetLocalStatus: start-on-event=GetLocalStatus, operation=SE004_SE_4ms_9.GetLocalStatus
      OIT_GetLocalStatus_SE005_SE_4ms_10_GetLocalStatus: start-on-event=GetLocalStatus, operation=SE005_SE_4ms_10.GetLocalStatus
      OIT_GetLocalStatus_SE006_SE_10ms_9_GetLocalStatus: start-on-event=GetLocalStatus, operation=SE006_SE_10ms_9.GetLocalStatus
      OIT_GetLocalStatus_SE007_SE_10ms_10a_GetLocalStatus: start-on-event=GetLocalStatus, operation=SE007_SE_10ms_10a.GetLocalStatus
      OIT_GetLocalStatus_SE008_SE_10ms_6_GetLocalStatus: start-on-event=GetLocalStatus, operation=SE008_SE_10ms_6.GetLocalStatus
      OIT_GetLocalStatus_SE009_SE_10ms_10b_GetLocalStatus: start-on-event=GetLocalStatus, operation=SE009_SE_10ms_10b.GetLocalStatus
      OIT_GetLocalStatus_SE010_SE_10ms_11_GetLocalStatus: start-on-event=GetLocalStatus, operation=SE010_SE_10ms_11.GetLocalStatus
      OIT_GetLocalStatus_SE011_SE_100ms_9_GetLocalStatus: start-on-event=GetLocalStatus, operation=SE011_SE_100ms_9.GetLocalStatus
      OIT_GetLocalStatus_SE012_SE_100ms_10_GetLocalStatus: start-on-event=GetLocalStatus, operation=SE012_SE_100ms_10.GetLocalStatus
      OIT_GetLocalStatus_SE013_SE_100ms_11_GetLocalStatus: start-on-event=GetLocalStatus, operation=SE013_SE_100ms_11.GetLocalStatus
      OIT_GetLocalStatus_SE014_SE_100ms_6_GetLocalStatus: start-on-event=GetLocalStatus, operation=SE014_SE_100ms_6.GetLocalStatus
      OIT_GetMode_Global_GetMode: start-on-event=GetMode, operation=Global.GetMode
      OIT_GlobalStateChangeCbk_Global_GlobalStateChangeCbk: start-on-event=GlobalStateChangeCbk, operation=Global.GlobalStateChangeCbk
    timing event TMT_MainFunction: start-on-event=MainFunction, period=0.004
    operation invoked event OIT_PerformReset_Global_PerformReset: start-on-event=PerformReset, operation=Global.PerformReset
    operation invoked event OIT_SetMode_MODE_0_CALLER_ID_0_SetMode: start-on-event=SetMode, operation=MODE_0_CALLER_ID_0.SetMode
    port-api-options port-api-option={enable-take-address=false, indirect-api=false, port=Global}:
      port-api-option enable-take-address=false, indirect-api=false, port=MODE_0_CALLER_ID_0:
        port-arg-values:
          integer literal MODE_0: type=WdgM_ModeType, value=0
          integer literal CALLER_0: type=UInt16, value=0
      port-api-option enable-take-address=false, indirect-api=false, port=SE000_SE_2ms_9:
        port-arg-values:
          integer literal SE000_SE_2ms_9_GLS: type=WdgM_SupervisedEntityIdType, value=0
      port-api-option enable-take-address=false, indirect-api=false, port=SE000_SE_2ms_9_CP000_ChkPtAp9_2msStart_CP:
        port-arg-values:
          integer literal SE000_SE_2ms_9_0: type=WdgM_SupervisedEntityIdType, value=0
          integer literal CP000_ChkPtAp9_2msStart_CP: type=WdgM_CheckpointIdType, value=0
      port-api-option enable-take-address=false, indirect-api=false, port=SE000_SE_2ms_9_CP001_ChkPtAp9_2msEnd_CP:
        port-arg-values:
          integer literal SE000_SE_2ms_9_1: type=WdgM_SupervisedEntityIdType, value=0
          integer literal CP001_ChkPtAp9_2msEnd_CP: type=WdgM_CheckpointIdType, value=1
      port-api-option enable-take-address=false, indirect-api=false, port=SE001_SE_2ms_10:
        port-arg-values:
          integer literal SE001_SE_2ms_10_GLS: type=WdgM_SupervisedEntityIdType, value=1
      port-api-option enable-take-address=false, indirect-api=false, port=SE001_SE_2ms_10_CP000_ChkPtAp10_2msStart_CP:
        port-arg-values:
          integer literal SE001_SE_2ms_10_0: type=WdgM_SupervisedEntityIdType, value=1
          integer literal CP000_ChkPtAp10_2msStart_CP: type=WdgM_CheckpointIdType, value=0
      port-api-option enable-take-address=false, indirect-api=false, port=SE001_SE_2ms_10_CP001_ChkPtAp10_2msEnd_CP:
        port-arg-values:
          integer literal SE001_SE_2ms_10_1: type=WdgM_SupervisedEntityIdType, value=1
          integer literal CP001_ChkPtAp10_2msEnd_CP: type=WdgM_CheckpointIdType, value=1
      port-api-option enable-take-address=false, indirect-api=false, port=SE002_SE_2ms_11:
        port-arg-values:
          integer literal SE002_SE_2ms_11_GLS: type=WdgM_SupervisedEntityIdType, value=2
      port-api-option enable-take-address=false, indirect-api=false, port=SE002_SE_2ms_11_CP000_ChkPtAp11_2msStart_CP:
        port-arg-values:
          integer literal SE002_SE_2ms_11_0: type=WdgM_SupervisedEntityIdType, value=2
          integer literal CP000_ChkPtAp11_2msStart_CP: type=WdgM_CheckpointIdType, value=0
      port-api-option enable-take-address=false, indirect-api=false, port=SE002_SE_2ms_11_CP001_ChkPtAp11_2msEnd_CP:
        port-arg-values:
          integer literal SE002_SE_2ms_11_1: type=WdgM_SupervisedEntityIdType, value=2
          integer literal CP001_ChkPtAp11_2msEnd_CP: type=WdgM_CheckpointIdType, value=1
      port-api-option enable-take-address=false, indirect-api=false, port=SE003_SE_2ms_6:
        port-arg-values:
          integer literal SE003_SE_2ms_6_GLS: type=WdgM_SupervisedEntityIdType, value=3
      port-api-option enable-take-address=false, indirect-api=false, port=SE003_SE_2ms_6_CP000_ChkPtAp6_2msStart_CP:
        port-arg-values:
          integer literal SE003_SE_2ms_6_0: type=WdgM_SupervisedEntityIdType, value=3
          integer literal CP000_ChkPtAp6_2msStart_CP: type=WdgM_CheckpointIdType, value=0
      port-api-option enable-take-address=false, indirect-api=false, port=SE003_SE_2ms_6_CP001_ChkPtAp6_2msEnd_CP:
        port-arg-values:
          integer literal SE003_SE_2ms_6_1: type=WdgM_SupervisedEntityIdType, value=3
          integer literal CP001_ChkPtAp6_2msEnd_CP: type=WdgM_CheckpointIdType, value=1
      port-api-option enable-take-address=false, indirect-api=false, port=SE004_SE_4ms_9:
        port-arg-values:
          integer literal SE004_SE_4ms_9_GLS: type=WdgM_SupervisedEntityIdType, value=4
      port-api-option enable-take-address=false, indirect-api=false, port=SE004_SE_4ms_9_CP000_ChkPtAp9_4msStart_CP:
        port-arg-values:
          integer literal SE004_SE_4ms_9_0: type=WdgM_SupervisedEntityIdType, value=4
          integer literal CP000_ChkPtAp9_4msStart_CP: type=WdgM_CheckpointIdType, value=0
      port-api-option enable-take-address=false, indirect-api=false, port=SE004_SE_4ms_9_CP001_ChkPtAp9_4msEnd_CP:
        port-arg-values:
          integer literal SE004_SE_4ms_9_1: type=WdgM_SupervisedEntityIdType, value=4
          integer literal CP001_ChkPtAp9_4msEnd_CP: type=WdgM_CheckpointIdType, value=1
      port-api-option enable-take-address=false, indirect-api=false, port=SE005_SE_4ms_10:
        port-arg-values:
          integer literal SE005_SE_4ms_10_GLS: type=WdgM_SupervisedEntityIdType, value=5
      port-api-option enable-take-address=false, indirect-api=false, port=SE005_SE_4ms_10_CP000_ChkPtAp10_4msStart_CP:
        port-arg-values:
          integer literal SE005_SE_4ms_10_0: type=WdgM_SupervisedEntityIdType, value=5
          integer literal CP000_ChkPtAp10_4msStart_CP: type=WdgM_CheckpointIdType, value=0
      port-api-option enable-take-address=false, indirect-api=false, port=SE005_SE_4ms_10_CP001_ChkPtAp10_4msEnd_CP:
        port-arg-values:
          integer literal SE005_SE_4ms_10_1: type=WdgM_SupervisedEntityIdType, value=5
          integer literal CP001_ChkPtAp10_4msEnd_CP: type=WdgM_CheckpointIdType, value=1
      port-api-option enable-take-address=false, indirect-api=false, port=SE006_SE_10ms_9:
        port-arg-values:
          integer literal SE006_SE_10ms_9_GLS: type=WdgM_SupervisedEntityIdType, value=6
      port-api-option enable-take-address=false, indirect-api=false, port=SE006_SE_10ms_9_CP000_ChkPtAp9_10msStart_CP:
        port-arg-values:
          integer literal SE006_SE_10ms_9_0: type=WdgM_SupervisedEntityIdType, value=6
          integer literal CP000_ChkPtAp9_10msStart_CP: type=WdgM_CheckpointIdType, value=0
      port-api-option enable-take-address=false, indirect-api=false, port=SE006_SE_10ms_9_CP001_ChkPtAp9_10msEnd_CP:
        port-arg-values:
          integer literal SE006_SE_10ms_9_1: type=WdgM_SupervisedEntityIdType, value=6
          integer literal CP001_ChkPtAp9_10msEnd_CP: type=WdgM_CheckpointIdType, value=1
      port-api-option enable-take-address=false, indirect-api=false, port=SE007_SE_10ms_10a:
        port-arg-values:
          integer literal SE007_SE_10ms_10a_GLS: type=WdgM_SupervisedEntityIdType, value=7
      port-api-option enable-take-address=false, indirect-api=false, port=SE007_SE_10ms_10a_CP000_ChkPtAp10_10msaStart_CP:
        port-arg-values:
          integer literal SE007_SE_10ms_10a_0: type=WdgM_SupervisedEntityIdType, value=7
          integer literal CP000_ChkPtAp10_10msaStart_CP: type=WdgM_CheckpointIdType, value=0
      port-api-option enable-take-address=false, indirect-api=false, port=SE007_SE_10ms_10a_CP001_ChkPtAp10_10msaEnd_CP:
        port-arg-values:
          integer literal SE007_SE_10ms_10a_1: type=WdgM_SupervisedEntityIdType, value=7
          integer literal CP001_ChkPtAp10_10msaEnd_CP: type=WdgM_CheckpointIdType, value=1
      port-api-option enable-take-address=false, indirect-api=false, port=SE008_SE_10ms_6:
        port-arg-values:
          integer literal SE008_SE_10ms_6_GLS: type=WdgM_SupervisedEntityIdType, value=8
      port-api-option enable-take-address=false, indirect-api=false, port=SE008_SE_10ms_6_CP000_ChkPtAp6_10msStart_CP:
        port-arg-values:
          integer literal SE008_SE_10ms_6_0: type=WdgM_SupervisedEntityIdType, value=8
          integer literal CP000_ChkPtAp6_10msStart_CP: type=WdgM_CheckpointIdType, value=0
      port-api-option enable-take-address=false, indirect-api=false, port=SE008_SE_10ms_6_CP001_ChkPtAp6_10msEnd_CP:
        port-arg-values:
          integer literal SE008_SE_10ms_6_1: type=WdgM_SupervisedEntityIdType, value=8
          integer literal CP001_ChkPtAp6_10msEnd_CP: type=WdgM_CheckpointIdType, value=1
      port-api-option enable-take-address=false, indirect-api=false, port=SE009_SE_10ms_10b:
        port-arg-values:
          integer literal SE009_SE_10ms_10b_GLS: type=WdgM_SupervisedEntityIdType, value=9
      port-api-option enable-take-address=false, indirect-api=false, port=SE009_SE_10ms_10b_CP000_ChkPtAp10_10msbStart_CP:
        port-arg-values:
          integer literal SE009_SE_10ms_10b_0: type=WdgM_SupervisedEntityIdType, value=9
          integer literal CP000_ChkPtAp10_10msbStart_CP: type=WdgM_CheckpointIdType, value=0
      port-api-option enable-take-address=false, indirect-api=false, port=SE009_SE_10ms_10b_CP001_ChkPtAp10_10msbEnd_CP:
        port-arg-values:
          integer literal SE009_SE_10ms_10b_1: type=WdgM_SupervisedEntityIdType, value=9
          integer literal CP001_ChkPtAp10_10msbEnd_CP: type=WdgM_CheckpointIdType, value=1
      port-api-option enable-take-address=false, indirect-api=false, port=SE010_SE_10ms_11:
        port-arg-values:
          integer literal SE010_SE_10ms_11_GLS: type=WdgM_SupervisedEntityIdType, value=10
      port-api-option enable-take-address=false, indirect-api=false, port=SE010_SE_10ms_11_CP000_ChkPtAp11_10msStart_CP:
        port-arg-values:
          integer literal SE010_SE_10ms_11_0: type=WdgM_SupervisedEntityIdType, value=10
          integer literal CP000_ChkPtAp11_10msStart_CP: type=WdgM_CheckpointIdType, value=0
      port-api-option enable-take-address=false, indirect-api=false, port=SE010_SE_10ms_11_CP001_ChkPtAp11_10msEnd_CP:
        port-arg-values:
          integer literal SE010_SE_10ms_11_1: type=WdgM_SupervisedEntityIdType, value=10
          integer literal CP001_ChkPtAp11_10msEnd_CP: type=WdgM_CheckpointIdType, value=1
      port-api-option enable-take-address=false, indirect-api=false, port=SE011_SE_100ms_9:
        port-arg-values:
          integer literal SE011_SE_100ms_9_GLS: type=WdgM_SupervisedEntityIdType, value=11
      port-api-option enable-take-address=false, indirect-api=false, port=SE011_SE_100ms_9_CP000_ChkPtAp9_100msStart_CP:
        port-arg-values:
          integer literal SE011_SE_100ms_9_0: type=WdgM_SupervisedEntityIdType, value=11
          integer literal CP000_ChkPtAp9_100msStart_CP: type=WdgM_CheckpointIdType, value=0
      port-api-option enable-take-address=false, indirect-api=false, port=SE011_SE_100ms_9_CP001_ChkPtAp9_100msEnd_CP:
        port-arg-values:
          integer literal SE011_SE_100ms_9_1: type=WdgM_SupervisedEntityIdType, value=11
          integer literal CP001_ChkPtAp9_100msEnd_CP: type=WdgM_CheckpointIdType, value=1
      port-api-option enable-take-address=false, indirect-api=false, port=SE012_SE_100ms_10:
        port-arg-values:
          integer literal SE012_SE_100ms_10_GLS: type=WdgM_SupervisedEntityIdType, value=12
      port-api-option enable-take-address=false, indirect-api=false, port=SE012_SE_100ms_10_CP000_ChkPtAp10_100msStart_CP:
        port-arg-values:
          integer literal SE012_SE_100ms_10_0: type=WdgM_SupervisedEntityIdType, value=12
          integer literal CP000_ChkPtAp10_100msStart_CP: type=WdgM_CheckpointIdType, value=0
      port-api-option enable-take-address=false, indirect-api=false, port=SE012_SE_100ms_10_CP001_ChkPtAp10_100msEnd_CP:
        port-arg-values:
          integer literal SE012_SE_100ms_10_1: type=WdgM_SupervisedEntityIdType, value=12
          integer literal CP001_ChkPtAp10_100msEnd_CP: type=WdgM_CheckpointIdType, value=1
      port-api-option enable-take-address=false, indirect-api=false, port=SE013_SE_100ms_11:
        port-arg-values:
          integer literal SE013_SE_100ms_11_GLS: type=WdgM_SupervisedEntityIdType, value=13
      port-api-option enable-take-address=false, indirect-api=false, port=SE013_SE_100ms_11_CP000_ChkPtAp11_100msStart_CP:
        port-arg-values:
          integer literal SE013_SE_100ms_11_0: type=WdgM_SupervisedEntityIdType, value=13
          integer literal CP000_ChkPtAp11_100msStart_CP: type=WdgM_CheckpointIdType, value=0
      port-api-option enable-take-address=false, indirect-api=false, port=SE013_SE_100ms_11_CP001_ChkPtAp11_100msEnd_CP:
        port-arg-values:
          integer literal SE013_SE_100ms_11_1: type=WdgM_SupervisedEntityIdType, value=13
          integer literal CP001_ChkPtAp11_100msEnd_CP: type=WdgM_CheckpointIdType, value=1
      port-api-option enable-take-address=false, indirect-api=false, port=SE014_SE_100ms_6:
        port-arg-values:
          integer literal SE014_SE_100ms_6_GLS: type=WdgM_SupervisedEntityIdType, value=14
      port-api-option enable-take-address=false, indirect-api=false, port=SE014_SE_100ms_6_CP000_ChkPtAp6_100msStart_CP:
        port-arg-values:
          integer literal SE014_SE_100ms_6_0: type=WdgM_SupervisedEntityIdType, value=14
          integer literal CP000_ChkPtAp6_100msStart_CP: type=WdgM_CheckpointIdType, value=0
      port-api-option enable-take-address=false, indirect-api=false, port=SE014_SE_100ms_6_CP001_ChkPtAp6_100msEnd_CP:
        port-arg-values:
          integer literal SE014_SE_100ms_6_1: type=WdgM_SupervisedEntityIdType, value=14
          integer literal CP001_ChkPtAp6_100msEnd_CP: type=WdgM_CheckpointIdType, value=1
    10 x runnable, all with can-be-invoked-concurrently=true:
      ActivateSupervisionEntity: symbol=WdgM_ActivateSupervisionEntity
      CheckpointReached: symbol=WdgM_CheckpointReached
      DeactivateSupervisionEntity: symbol=WdgM_DeactivateSupervisionEntity
      GetGlobalStatus: symbol=WdgM_GetGlobalStatus
      GetLocalStatus: symbol=WdgM_GetLocalStatus
      GetMode: symbol=WdgM_GetMode
      GlobalStateChangeCbk
      MainFunction: symbol=WdgM_MainFunction
      PerformReset: symbol=WdgM_PerformReset
      SetMode: symbol=WdgM_SetMode
  service component type WdgM: category=ServiceComponent
    47 x provide port:
      Global: provided-interface=WdgM_GlobalMode  # P-Port Prototype for Global Mode
        provided-com-specs:
          operation=GetGlobalStatus, queue-length=1
          operation=GetMode, queue-length=1
          operation=GlobalStateChangeCbk, queue-length=1
          operation=LocalStateChangeCbk, queue-length=1
          operation=MainFunction, queue-length=1
          operation=PerformReset, queue-length=1
          operation=SetMode, queue-length=1
      MODE_0_CALLER_ID_0: provided-interface=WdgM_GlobalMode  # P-Port Prototype for Trigger Mode 0 and Caller ID 0
        provided-com-specs:
          operation=GetGlobalStatus, queue-length=1
          operation=GetMode, queue-length=1
          operation=GlobalStateChangeCbk, queue-length=1
          operation=LocalStateChangeCbk, queue-length=1
          operation=MainFunction, queue-length=1
          operation=PerformReset, queue-length=1
          operation=SetMode, queue-length=1
      SE000_SE_2ms_9: provided-interface=WdgM_IndividualMode  # P-Port Prototype for Supervised Entity SE_2ms_9 with ID 0
        provided-com-specs:
          operation=ActivateSupervisionEntity, queue-length=1
          operation=DeactivateSupervisionEntity, queue-length=1
          operation=GetLocalStatus, queue-length=1
      SE000_SE_2ms_9_CP000_ChkPtAp9_2msStart_CP: server-com-spec{operation=CheckpointReached, queue-length=1}, provided-interface=WdgM_AliveSupervision  # P-Port Prototype for Supervised Entity SE_2ms_9 with ID 0 and Checkpoint ChkPtAp9_2msStart_CP with ID 0.
      SE000_SE_2ms_9_CP001_ChkPtAp9_2msEnd_CP: server-com-spec{operation=CheckpointReached, queue-length=1}, provided-interface=WdgM_AliveSupervision  # P-Port Prototype for Supervised Entity SE_2ms_9 with ID 0 and Checkpoint ChkPtAp9_2msEnd_CP with ID 1.
      SE001_SE_2ms_10: provided-interface=WdgM_IndividualMode  # P-Port Prototype for Supervised Entity SE_2ms_10 with ID 1
        provided-com-specs:
          operation=ActivateSupervisionEntity, queue-length=1
          operation=DeactivateSupervisionEntity, queue-length=1
          operation=GetLocalStatus, queue-length=1
      SE001_SE_2ms_10_CP000_ChkPtAp10_2msStart_CP: server-com-spec{operation=CheckpointReached, queue-length=1}, provided-interface=WdgM_AliveSupervision  # P-Port Prototype for Supervised Entity SE_2ms_10 with ID 1 and Checkpoint ChkPtAp10_2msStart_CP with ID 0.
      SE001_SE_2ms_10_CP001_ChkPtAp10_2msEnd_CP: server-com-spec{operation=CheckpointReached, queue-length=1}, provided-interface=WdgM_AliveSupervision  # P-Port Prototype for Supervised Entity SE_2ms_10 with ID 1 and Checkpoint ChkPtAp10_2msEnd_CP with ID 1.
      SE002_SE_2ms_11: provided-interface=WdgM_IndividualMode  # P-Port Prototype for Supervised Entity SE_2ms_11 with ID 2
        provided-com-specs:
          operation=ActivateSupervisionEntity, queue-length=1
          operation=DeactivateSupervisionEntity, queue-length=1
          operation=GetLocalStatus, queue-length=1
      SE002_SE_2ms_11_CP000_ChkPtAp11_2msStart_CP: server-com-spec{operation=CheckpointReached, queue-length=1}, provided-interface=WdgM_AliveSupervision  # P-Port Prototype for Supervised Entity SE_2ms_11 with ID 2 and Checkpoint ChkPtAp11_2msStart_CP with ID 0.
      SE002_SE_2ms_11_CP001_ChkPtAp11_2msEnd_CP: server-com-spec{operation=CheckpointReached, queue-length=1}, provided-interface=WdgM_AliveSupervision  # P-Port Prototype for Supervised Entity SE_2ms_11 with ID 2 and Checkpoint ChkPtAp11_2msEnd_CP with ID 1.
      SE003_SE_2ms_6: provided-interface=WdgM_IndividualMode  # P-Port Prototype for Supervised Entity SE_2ms_6 with ID 3
        provided-com-specs:
          operation=ActivateSupervisionEntity, queue-length=1
          operation=DeactivateSupervisionEntity, queue-length=1
          operation=GetLocalStatus, queue-length=1
      SE003_SE_2ms_6_CP000_ChkPtAp6_2msStart_CP: server-com-spec{operation=CheckpointReached, queue-length=1}, provided-interface=WdgM_AliveSupervision  # P-Port Prototype for Supervised Entity SE_2ms_6 with ID 3 and Checkpoint ChkPtAp6_2msStart_CP with ID 0.
      SE003_SE_2ms_6_CP001_ChkPtAp6_2msEnd_CP: server-com-spec{operation=CheckpointReached, queue-length=1}, provided-interface=WdgM_AliveSupervision  # P-Port Prototype for Supervised Entity SE_2ms_6 with ID 3 and Checkpoint ChkPtAp6_2msEnd_CP with ID 1.
      SE004_SE_4ms_9: provided-interface=WdgM_IndividualMode  # P-Port Prototype for Supervised Entity SE_4ms_9 with ID 4
        provided-com-specs:
          operation=ActivateSupervisionEntity, queue-length=1
          operation=DeactivateSupervisionEntity, queue-length=1
          operation=GetLocalStatus, queue-length=1
      SE004_SE_4ms_9_CP000_ChkPtAp9_4msStart_CP: server-com-spec{operation=CheckpointReached, queue-length=1}, provided-interface=WdgM_AliveSupervision  # P-Port Prototype for Supervised Entity SE_4ms_9 with ID 4 and Checkpoint ChkPtAp9_4msStart_CP with ID 0.
      SE004_SE_4ms_9_CP001_ChkPtAp9_4msEnd_CP: server-com-spec{operation=CheckpointReached, queue-length=1}, provided-interface=WdgM_AliveSupervision  # P-Port Prototype for Supervised Entity SE_4ms_9 with ID 4 and Checkpoint ChkPtAp9_4msEnd_CP with ID 1.
      SE005_SE_4ms_10: provided-interface=WdgM_IndividualMode  # P-Port Prototype for Supervised Entity SE_4ms_10 with ID 5
        provided-com-specs:
          operation=ActivateSupervisionEntity, queue-length=1
          operation=DeactivateSupervisionEntity, queue-length=1
          operation=GetLocalStatus, queue-length=1
      SE005_SE_4ms_10_CP000_ChkPtAp10_4msStart_CP: server-com-spec{operation=CheckpointReached, queue-length=1}, provided-interface=WdgM_AliveSupervision  # P-Port Prototype for Supervised Entity SE_4ms_10 with ID 5 and Checkpoint ChkPtAp10_4msStart_CP with ID 0.
      SE005_SE_4ms_10_CP001_ChkPtAp10_4msEnd_CP: server-com-spec{operation=CheckpointReached, queue-length=1}, provided-interface=WdgM_AliveSupervision  # P-Port Prototype for Supervised Entity SE_4ms_10 with ID 5 and Checkpoint ChkPtAp10_4msEnd_CP with ID 1.
      SE006_SE_10ms_9: provided-interface=WdgM_IndividualMode  # P-Port Prototype for Supervised Entity SE_10ms_9 with ID 6
        provided-com-specs:
          operation=ActivateSupervisionEntity, queue-length=1
          operation=DeactivateSupervisionEntity, queue-length=1
          operation=GetLocalStatus, queue-length=1
      SE006_SE_10ms_9_CP000_ChkPtAp9_10msStart_CP: server-com-spec{operation=CheckpointReached, queue-length=1}, provided-interface=WdgM_AliveSupervision  # P-Port Prototype for Supervised Entity SE_10ms_9 with ID 6 and Checkpoint ChkPtAp9_10msStart_CP with ID 0.
      SE006_SE_10ms_9_CP001_ChkPtAp9_10msEnd_CP: server-com-spec{operation=CheckpointReached, queue-length=1}, provided-interface=WdgM_AliveSupervision  # P-Port Prototype for Supervised Entity SE_10ms_9 with ID 6 and Checkpoint ChkPtAp9_10msEnd_CP with ID 1.
      SE007_SE_10ms_10a: provided-interface=WdgM_IndividualMode  # P-Port Prototype for Supervised Entity SE_10ms_10a with ID 7
        provided-com-specs:
          operation=ActivateSupervisionEntity, queue-length=1
          operation=DeactivateSupervisionEntity, queue-length=1
          operation=GetLocalStatus, queue-length=1
      SE007_SE_10ms_10a_CP000_ChkPtAp10_10msaStart_CP: server-com-spec{operation=CheckpointReached, queue-length=1}, provided-interface=WdgM_AliveSupervision  # P-Port Prototype for Supervised Entity SE_10ms_10a with ID 7 and Checkpoint ChkPtAp10_10msaStart_CP with ID 0.
      SE007_SE_10ms_10a_CP001_ChkPtAp10_10msaEnd_CP: server-com-spec{operation=CheckpointReached, queue-length=1}, provided-interface=WdgM_AliveSupervision  # P-Port Prototype for Supervised Entity SE_10ms_10a with ID 7 and Checkpoint ChkPtAp10_10msaEnd_CP with ID 1.
      SE008_SE_10ms_6: provided-interface=WdgM_IndividualMode  # P-Port Prototype for Supervised Entity SE_10ms_6 with ID 8
        provided-com-specs:
          operation=ActivateSupervisionEntity, queue-length=1
          operation=DeactivateSupervisionEntity, queue-length=1
          operation=GetLocalStatus, queue-length=1
      SE008_SE_10ms_6_CP000_ChkPtAp6_10msStart_CP: server-com-spec{operation=CheckpointReached, queue-length=1}, provided-interface=WdgM_AliveSupervision  # P-Port Prototype for Supervised Entity SE_10ms_6 with ID 8 and Checkpoint ChkPtAp6_10msStart_CP with ID 0.
      SE008_SE_10ms_6_CP001_ChkPtAp6_10msEnd_CP: server-com-spec{operation=CheckpointReached, queue-length=1}, provided-interface=WdgM_AliveSupervision  # P-Port Prototype for Supervised Entity SE_10ms_6 with ID 8 and Checkpoint ChkPtAp6_10msEnd_CP with ID 1.
      SE009_SE_10ms_10b: provided-interface=WdgM_IndividualMode  # P-Port Prototype for Supervised Entity SE_10ms_10b with ID 9
        provided-com-specs:
          operation=ActivateSupervisionEntity, queue-length=1
          operation=DeactivateSupervisionEntity, queue-length=1
          operation=GetLocalStatus, queue-length=1
      SE009_SE_10ms_10b_CP000_ChkPtAp10_10msbStart_CP: server-com-spec{operation=CheckpointReached, queue-length=1}, provided-interface=WdgM_AliveSupervision  # P-Port Prototype for Supervised Entity SE_10ms_10b with ID 9 and Checkpoint ChkPtAp10_10msbStart_CP with ID 0.
      SE009_SE_10ms_10b_CP001_ChkPtAp10_10msbEnd_CP: server-com-spec{operation=CheckpointReached, queue-length=1}, provided-interface=WdgM_AliveSupervision  # P-Port Prototype for Supervised Entity SE_10ms_10b with ID 9 and Checkpoint ChkPtAp10_10msbEnd_CP with ID 1.
      SE010_SE_10ms_11: provided-interface=WdgM_IndividualMode  # P-Port Prototype for Supervised Entity SE_10ms_11 with ID 10
        provided-com-specs:
          operation=ActivateSupervisionEntity, queue-length=1
          operation=DeactivateSupervisionEntity, queue-length=1
          operation=GetLocalStatus, queue-length=1
      SE010_SE_10ms_11_CP000_ChkPtAp11_10msStart_CP: server-com-spec{operation=CheckpointReached, queue-length=1}, provided-interface=WdgM_AliveSupervision  # P-Port Prototype for Supervised Entity SE_10ms_11 with ID 10 and Checkpoint ChkPtAp11_10msStart_CP with ID 0.
      SE010_SE_10ms_11_CP001_ChkPtAp11_10msEnd_CP: server-com-spec{operation=CheckpointReached, queue-length=1}, provided-interface=WdgM_AliveSupervision  # P-Port Prototype for Supervised Entity SE_10ms_11 with ID 10 and Checkpoint ChkPtAp11_10msEnd_CP with ID 1.
      SE011_SE_100ms_9: provided-interface=WdgM_IndividualMode  # P-Port Prototype for Supervised Entity SE_100ms_9 with ID 11
        provided-com-specs:
          operation=ActivateSupervisionEntity, queue-length=1
          operation=DeactivateSupervisionEntity, queue-length=1
          operation=GetLocalStatus, queue-length=1
      SE011_SE_100ms_9_CP000_ChkPtAp9_100msStart_CP: server-com-spec{operation=CheckpointReached, queue-length=1}, provided-interface=WdgM_AliveSupervision  # P-Port Prototype for Supervised Entity SE_100ms_9 with ID 11 and Checkpoint ChkPtAp9_100msStart_CP with ID 0.
      SE011_SE_100ms_9_CP001_ChkPtAp9_100msEnd_CP: server-com-spec{operation=CheckpointReached, queue-length=1}, provided-interface=WdgM_AliveSupervision  # P-Port Prototype for Supervised Entity SE_100ms_9 with ID 11 and Checkpoint ChkPtAp9_100msEnd_CP with ID 1.
      SE012_SE_100ms_10: provided-interface=WdgM_IndividualMode  # P-Port Prototype for Supervised Entity SE_100ms_10 with ID 12
        provided-com-specs:
          operation=ActivateSupervisionEntity, queue-length=1
          operation=DeactivateSupervisionEntity, queue-length=1
          operation=GetLocalStatus, queue-length=1
      SE012_SE_100ms_10_CP000_ChkPtAp10_100msStart_CP: server-com-spec{operation=CheckpointReached, queue-length=1}, provided-interface=WdgM_AliveSupervision  # P-Port Prototype for Supervised Entity SE_100ms_10 with ID 12 and Checkpoint ChkPtAp10_100msStart_CP with ID 0.
      SE012_SE_100ms_10_CP001_ChkPtAp10_100msEnd_CP: server-com-spec{operation=CheckpointReached, queue-length=1}, provided-interface=WdgM_AliveSupervision  # P-Port Prototype for Supervised Entity SE_100ms_10 with ID 12 and Checkpoint ChkPtAp10_100msEnd_CP with ID 1.
      SE013_SE_100ms_11: provided-interface=WdgM_IndividualMode  # P-Port Prototype for Supervised Entity SE_100ms_11 with ID 13
        provided-com-specs:
          operation=ActivateSupervisionEntity, queue-length=1
          operation=DeactivateSupervisionEntity, queue-length=1
          operation=GetLocalStatus, queue-length=1
      SE013_SE_100ms_11_CP000_ChkPtAp11_100msStart_CP: server-com-spec{operation=CheckpointReached, queue-length=1}, provided-interface=WdgM_AliveSupervision  # P-Port Prototype for Supervised Entity SE_100ms_11 with ID 13 and Checkpoint ChkPtAp11_100msStart_CP with ID 0.
      SE013_SE_100ms_11_CP001_ChkPtAp11_100msEnd_CP: server-com-spec{operation=CheckpointReached, queue-length=1}, provided-interface=WdgM_AliveSupervision  # P-Port Prototype for Supervised Entity SE_100ms_11 with ID 13 and Checkpoint ChkPtAp11_100msEnd_CP with ID 1.
      SE014_SE_100ms_6: provided-interface=WdgM_IndividualMode  # P-Port Prototype for Supervised Entity SE_100ms_6 with ID 14
        provided-com-specs:
          operation=ActivateSupervisionEntity, queue-length=1
          operation=DeactivateSupervisionEntity, queue-length=1
          operation=GetLocalStatus, queue-length=1
      SE014_SE_100ms_6_CP000_ChkPtAp6_100msStart_CP: server-com-spec{operation=CheckpointReached, queue-length=1}, provided-interface=WdgM_AliveSupervision  # P-Port Prototype for Supervised Entity SE_100ms_6 with ID 14 and Checkpoint ChkPtAp6_100msStart_CP with ID 0.
      SE014_SE_100ms_6_CP001_ChkPtAp6_100msEnd_CP: server-com-spec{operation=CheckpointReached, queue-length=1}, provided-interface=WdgM_AliveSupervision  # P-Port Prototype for Supervised Entity SE_100ms_6 with ID 14 and Checkpoint ChkPtAp6_100msEnd_CP with ID 1.
  swc implementation WdgM_Implementation: behavior=WdgM_InternalBehavior
    code-descriptors:
      code Code: type=SRC
