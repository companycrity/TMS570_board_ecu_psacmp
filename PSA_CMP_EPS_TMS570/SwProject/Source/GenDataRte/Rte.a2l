/*
COPYRIGHT
Copyright (c) 2006-2011 by Vector Informatik GmbH. All rights reserved.
This software is copyright protected and proprietary to Vector Informatik GmbH.
Vector Informatik GmbH grants to you only those rights as set out in the license conditions.
License:  License CBD1010124 valid for CBD1010124 Nexteer  Package: BMW MSR SIP BAC3.0 Micro: TI TMS570 TMS570LS30306  Compiler: Code Composer Studio 4.9.0
*/
/begin MEASUREMENT Rte_CDDInterface9_ExpectedOnTimeC_Cnt_u32 "MICROSAR RTE" ULONG NO_COMPU_METHOD 0 0 0 4294967295 ECU_ADDRESS 0 /end MEASUREMENT
/begin MEASUREMENT Rte_CDDInterface9_IgnCnt_Cnt_u16 "MICROSAR RTE" UWORD NO_COMPU_METHOD 0 0 0 65535 ECU_ADDRESS 0 /end MEASUREMENT
/begin MEASUREMENT Rte_CDDInterface9_LRPRPhaseadvanceCaptured_Cnt_s16 "MICROSAR RTE" SWORD NO_COMPU_METHOD 0 0 -32768 32767 ECU_ADDRESS 0 /end MEASUREMENT
/begin MEASUREMENT Rte_CDDInterface9_MECTemp_Cnt_u08 "MICROSAR RTE" UBYTE NO_COMPU_METHOD 0 0 0 255 ECU_ADDRESS 0 /end MEASUREMENT
/begin MEASUREMENT Rte_CDDInterface9_MechMtrPos1_Rev_f32 "MICROSAR RTE" FLOAT32_IEEE NO_COMPU_METHOD 0 0 1.175494351e-38 3.402823466e+38 ECU_ADDRESS 0 /end MEASUREMENT
/begin MEASUREMENT Rte_CDDInterface9_MechMtrPos1Timestamp_USec_u32 "MICROSAR RTE" ULONG NO_COMPU_METHOD 0 0 0 4294967295 ECU_ADDRESS 0 /end MEASUREMENT
/begin MEASUREMENT Rte_CDDInterface9_MechMtrPos2Timestamp_USec_u32 "MICROSAR RTE" ULONG NO_COMPU_METHOD 0 0 0 4294967295 ECU_ADDRESS 0 /end MEASUREMENT
/begin MEASUREMENT Rte_CDDInterface9_ModIdxFinal_Uls_f32 "MICROSAR RTE" FLOAT32_IEEE NO_COMPU_METHOD 0 0 1.175494351e-38 3.402823466e+38 ECU_ADDRESS 0 /end MEASUREMENT
/begin MEASUREMENT Rte_CDDInterface9_MtrCurrDax_Amp_f32 "MICROSAR RTE" FLOAT32_IEEE NO_COMPU_METHOD 0 0 1.175494351e-38 3.402823466e+38 ECU_ADDRESS 0 /end MEASUREMENT
/begin MEASUREMENT Rte_CDDInterface9_MtrCurrK1_Amp_f32 "MICROSAR RTE" FLOAT32_IEEE NO_COMPU_METHOD 0 0 1.175494351e-38 3.402823466e+38 ECU_ADDRESS 0 /end MEASUREMENT
/begin MEASUREMENT Rte_CDDInterface9_MtrCurrK2_Amp_f32 "MICROSAR RTE" FLOAT32_IEEE NO_COMPU_METHOD 0 0 1.175494351e-38 3.402823466e+38 ECU_ADDRESS 0 /end MEASUREMENT
/begin MEASUREMENT Rte_CDDInterface9_MtrCurrQax_Amp_f32 "MICROSAR RTE" FLOAT32_IEEE NO_COMPU_METHOD 0 0 1.175494351e-38 3.402823466e+38 ECU_ADDRESS 0 /end MEASUREMENT
/begin MEASUREMENT Rte_CDDInterface9_MtrCurrQaxFinalRef_Amp_f32 "MICROSAR RTE" FLOAT32_IEEE NO_COMPU_METHOD 0 0 1.175494351e-38 3.402823466e+38 ECU_ADDRESS 0 /end MEASUREMENT
/begin MEASUREMENT Rte_CDDInterface9_MtrVoltDax_Volt_f32 "This signal is intended to communicate any type voltage signal measured by the ecu.  This signal has a lower limit of 0 which reequires users of the signal to provide divide by 0 protection if it is used as a denominator in a calculation.  See Vecu port p" FLOAT32_IEEE NO_COMPU_METHOD 0 0 1.175494351e-38 3.402823466e+38 ECU_ADDRESS 0 /end MEASUREMENT
/begin MEASUREMENT Rte_CDDInterface9_MtrVoltQax_Volt_f32 "This signal is intended to communicate any type voltage signal measured by the ecu.  This signal has a lower limit of 0 which reequires users of the signal to provide divide by 0 protection if it is used as a denominator in a calculation.  See Vecu port p" FLOAT32_IEEE NO_COMPU_METHOD 0 0 1.175494351e-38 3.402823466e+38 ECU_ADDRESS 0 /end MEASUREMENT
/begin MEASUREMENT Rte_CDDInterface9_RxMtrPosParityAccum_Cnt_u16 "MICROSAR RTE" UWORD NO_COMPU_METHOD 0 0 0 65535 ECU_ADDRESS 0 /end MEASUREMENT
/begin MEASUREMENT Rte_CDDInterface9_SysCCorrMtrPosElec_Rev_f32 "MICROSAR RTE" FLOAT32_IEEE NO_COMPU_METHOD 0 0 1.175494351e-38 3.402823466e+38 ECU_ADDRESS 0 /end MEASUREMENT
/begin MEASUREMENT Rte_CDDInterface9_SysCVSwitchADC_Cnt_u16 "MICROSAR RTE" UWORD NO_COMPU_METHOD 0 0 0 65535 ECU_ADDRESS 0 /end MEASUREMENT
/begin MEASUREMENT Rte_CDDInterface9_UncorrMechMtrPos1_Rev_u0p16 "MICROSAR RTE" UWORD NO_COMPU_METHOD 0 0 0 65535 ECU_ADDRESS 0 /end MEASUREMENT
/begin MEASUREMENT Rte_CmMtrCurr_CurrTempOffset.CurrOffsetY1_Volts_s4p11 "MICROSAR RTE" SWORD NO_COMPU_METHOD 0 0 -32768 32767 MATRIX_DIM 16 1 1 ECU_ADDRESS 0 READ_WRITE /end MEASUREMENT
/begin MEASUREMENT Rte_CmMtrCurr_CurrTempOffset.CurrOffsetY2_Volts_s4p11 "MICROSAR RTE" SWORD NO_COMPU_METHOD 0 0 -32768 32767 MATRIX_DIM 16 1 1 ECU_ADDRESS 0 READ_WRITE /end MEASUREMENT
/begin MEASUREMENT Rte_CmMtrCurr_CurrTempOffset.CurrTempOffsetX_DegC_s10p5 "MICROSAR RTE" SWORD NO_COMPU_METHOD 0 0 -32768 32767 MATRIX_DIM 16 1 1 ECU_ADDRESS 0 READ_WRITE /end MEASUREMENT
/begin MEASUREMENT Rte_CmMtrCurr_CurrentGainSvc_Cnt_lgc "MICROSAR RTE" UBYTE RTE_CM_BOOLEAN 0 0 0 255 ECU_ADDRESS 0 /end MEASUREMENT
/begin MEASUREMENT Rte_CtrlTemp_FiltMeasTemp_DegC_f32 "MICROSAR RTE" FLOAT32_IEEE NO_COMPU_METHOD 0 0 1.175494351e-38 3.402823466e+38 ECU_ADDRESS 0 /end MEASUREMENT
/begin MEASUREMENT Rte_CurrCmd_MtrCurrAngle_Rev_f32 "MICROSAR RTE" FLOAT32_IEEE NO_COMPU_METHOD 0 0 1.175494351e-38 3.402823466e+38 ECU_ADDRESS 0 /end MEASUREMENT
/begin MEASUREMENT Rte_CmMtrCurr_ShCurrCal.EOLMtrCurr1OffsetDiff_Volts_f32 "MICROSAR RTE" FLOAT32_IEEE NO_COMPU_METHOD 0 0 1.175494351e-38 3.402823466e+38 ECU_ADDRESS 0 READ_WRITE /end MEASUREMENT
/begin MEASUREMENT Rte_CmMtrCurr_ShCurrCal.EOLMtrCurr1OffsetLo_Volts_f32 "MICROSAR RTE" FLOAT32_IEEE NO_COMPU_METHOD 0 0 1.175494351e-38 3.402823466e+38 ECU_ADDRESS 0 READ_WRITE /end MEASUREMENT
/begin MEASUREMENT Rte_CmMtrCurr_ShCurrCal.EOLMtrCurr2OffsetDiff_Volts_f32 "MICROSAR RTE" FLOAT32_IEEE NO_COMPU_METHOD 0 0 1.175494351e-38 3.402823466e+38 ECU_ADDRESS 0 READ_WRITE /end MEASUREMENT
/begin MEASUREMENT Rte_CmMtrCurr_ShCurrCal.EOLMtrCurr2OffsetLo_Volts_f32 "MICROSAR RTE" FLOAT32_IEEE NO_COMPU_METHOD 0 0 1.175494351e-38 3.402823466e+38 ECU_ADDRESS 0 READ_WRITE /end MEASUREMENT
/begin MEASUREMENT Rte_CmMtrCurr_ShCurrCal.EOLMtrCurrVcalCmd_VoltCnts_f32 "MICROSAR RTE" FLOAT32_IEEE NO_COMPU_METHOD 0 0 1.175494351e-38 3.402823466e+38 ECU_ADDRESS 0 READ_WRITE /end MEASUREMENT
/begin MEASUREMENT Rte_CmMtrCurr_ShCurrCal.EOLPhscurr1Gain_AmpspVolt_f32 "MICROSAR RTE" FLOAT32_IEEE NO_COMPU_METHOD 0 0 1.175494351e-38 3.402823466e+38 ECU_ADDRESS 0 READ_WRITE /end MEASUREMENT
/begin MEASUREMENT Rte_CmMtrCurr_ShCurrCal.EOLPhscurr2Gain_AmpspVolt_f32 "MICROSAR RTE" FLOAT32_IEEE NO_COMPU_METHOD 0 0 1.175494351e-38 3.402823466e+38 ECU_ADDRESS 0 READ_WRITE /end MEASUREMENT
/begin MEASUREMENT Rte_CtrlTemp_AmbTemp_DegC_f32 "MICROSAR RTE" FLOAT32_IEEE NO_COMPU_METHOD 0 0 1.175494351e-38 3.402823466e+38 ECU_ADDRESS 0 /end MEASUREMENT
/begin MEASUREMENT Rte_DiagMgr10_DiagStsDefTemp_Cnt_lgc "MICROSAR RTE" UBYTE RTE_CM_BOOLEAN 0 0 0 255 ECU_ADDRESS 0 /end MEASUREMENT
/begin MEASUREMENT Rte_IoHwAb10_TemperatureADC_Volt_f32 "This signal is intended to communicate any type voltage signal measured by the ecu.  This signal has a lower limit of 0 which reequires users of the signal to provide divide by 0 protection if it is used as a denominator in a calculation.  See Vecu port p" FLOAT32_IEEE NO_COMPU_METHOD 0 0 1.175494351e-38 3.402823466e+38 ECU_ADDRESS 0 /end MEASUREMENT
/begin MEASUREMENT Rte_CurrCmd_DualEcuMotCtrlMtgnEna_Cnt_lgc "MICROSAR RTE" UBYTE RTE_CM_BOOLEAN 0 0 0 255 ECU_ADDRESS 0 /end MEASUREMENT
/begin MEASUREMENT Rte_CurrParamComp_EstKe_VpRadpS_f32 "MICROSAR RTE" FLOAT32_IEEE NO_COMPU_METHOD 0 0 1.175494351e-38 3.402823466e+38 ECU_ADDRESS 0 /end MEASUREMENT
/begin MEASUREMENT Rte_CurrParamComp_EstLd_Henry_f32 "MICROSAR RTE" FLOAT32_IEEE NO_COMPU_METHOD 0 0 1.175494351e-38 3.402823466e+38 ECU_ADDRESS 0 /end MEASUREMENT
/begin MEASUREMENT Rte_CurrParamComp_EstLq_Henry_f32 "MICROSAR RTE" FLOAT32_IEEE NO_COMPU_METHOD 0 0 1.175494351e-38 3.402823466e+38 ECU_ADDRESS 0 /end MEASUREMENT
/begin MEASUREMENT Rte_CurrParamComp_EstR_Ohm_f32 "MICROSAR RTE" FLOAT32_IEEE NO_COMPU_METHOD 0 0 1.175494351e-38 3.402823466e+38 ECU_ADDRESS 0 /end MEASUREMENT
/begin MEASUREMENT Rte_TrqCmdScl_MRFMtrTrqCmdScl_MtrNm_f32 "MICROSAR RTE" FLOAT32_IEEE NO_COMPU_METHOD 0 0 1.175494351e-38 3.402823466e+38 ECU_ADDRESS 0 /end MEASUREMENT
/begin MEASUREMENT Rte_CurrCmd_MtrCurrDaxRef_Amp_f32 "MICROSAR RTE" FLOAT32_IEEE NO_COMPU_METHOD 0 0 1.175494351e-38 3.402823466e+38 ECU_ADDRESS 0 /end MEASUREMENT
/begin MEASUREMENT Rte_CurrCmd_MtrCurrQaxRef_Amp_f32 "MICROSAR RTE" FLOAT32_IEEE NO_COMPU_METHOD 0 0 1.175494351e-38 3.402823466e+38 ECU_ADDRESS 0 /end MEASUREMENT
/begin MEASUREMENT Rte_QuadDet_MtrQuad_Cnt_u08 "MICROSAR RTE" UBYTE NO_COMPU_METHOD 0 0 0 255 ECU_ADDRESS 0 /end MEASUREMENT
/begin MEASUREMENT Rte_CurrCmd_MtrVoltDaxFFStatic_Volt_f32 "This signal is intended to communicate any type voltage signal measured by the ecu.  This signal has a lower limit of 0 which reequires users of the signal to provide divide by 0 protection if it is used as a denominator in a calculation.  See Vecu port p" FLOAT32_IEEE NO_COMPU_METHOD 0 0 1.175494351e-38 3.402823466e+38 ECU_ADDRESS 0 /end MEASUREMENT
/begin MEASUREMENT Rte_CurrCmd_MtrVoltQaxFFStatic_Volt_f32 "This signal is intended to communicate any type voltage signal measured by the ecu.  This signal has a lower limit of 0 which reequires users of the signal to provide divide by 0 protection if it is used as a denominator in a calculation.  See Vecu port p" FLOAT32_IEEE NO_COMPU_METHOD 0 0 1.175494351e-38 3.402823466e+38 ECU_ADDRESS 0 /end MEASUREMENT
/begin MEASUREMENT Rte_MtrTempEst_CuTempEst_DegC_f32 "MICROSAR RTE" FLOAT32_IEEE NO_COMPU_METHOD 0 0 1.175494351e-38 3.402823466e+38 ECU_ADDRESS 0 /end MEASUREMENT
/begin MEASUREMENT Rte_CurrParamComp_EOLNomMtrParam.NomKe_VpRadpS_f32 "MICROSAR RTE" FLOAT32_IEEE NO_COMPU_METHOD 0 0 1.175494351e-38 3.402823466e+38 ECU_ADDRESS 0 READ_WRITE /end MEASUREMENT
/begin MEASUREMENT Rte_CurrParamComp_EOLNomMtrParam.NomRmtr_Ohm_f32 "MICROSAR RTE" FLOAT32_IEEE NO_COMPU_METHOD 0 0 1.175494351e-38 3.402823466e+38 ECU_ADDRESS 0 READ_WRITE /end MEASUREMENT
/begin MEASUREMENT Rte_MtrTempEst_MagTempEst_DegC_f32 "MICROSAR RTE" FLOAT32_IEEE NO_COMPU_METHOD 0 0 1.175494351e-38 3.402823466e+38 ECU_ADDRESS 0 /end MEASUREMENT
/begin MEASUREMENT Rte_MtrTempEst_SiTempEst_DegC_f32 "MICROSAR RTE" FLOAT32_IEEE NO_COMPU_METHOD 0 0 1.175494351e-38 3.402823466e+38 ECU_ADDRESS 0 /end MEASUREMENT
/begin MEASUREMENT Rte_VehPwrMd_CTermActive_Cnt_lgc "MICROSAR RTE" UBYTE RTE_CM_BOOLEAN 0 0 0 255 ECU_ADDRESS 0 /end MEASUREMENT
/begin MEASUREMENT Rte_SrlComInput_DmdDelestDaSts_Cnt_u08 "MICROSAR RTE" UBYTE NO_COMPU_METHOD 0 0 0 255 ECU_ADDRESS 0 /end MEASUREMENT
/begin MEASUREMENT Rte_SrlComInput_EngOn_Cnt_lgc "MICROSAR RTE" UBYTE RTE_CM_BOOLEAN 0 0 0 255 ECU_ADDRESS 0 /end MEASUREMENT
/begin MEASUREMENT Rte_SrlComInput_EtatMTRaw_Cnt_u08 "MICROSAR RTE" UBYTE NO_COMPU_METHOD 0 0 0 255 ECU_ADDRESS 0 /end MEASUREMENT
/begin MEASUREMENT Rte_SrlComInput_ValidEngineStatus_Cnt_lgc "MICROSAR RTE" UBYTE RTE_CM_BOOLEAN 0 0 0 255 ECU_ADDRESS 0 /end MEASUREMENT
/begin MEASUREMENT Rte_Damping_CustomDamp_MtrNm_f32 "MICROSAR RTE" FLOAT32_IEEE NO_COMPU_METHOD 0 0 1.175494351e-38 3.402823466e+38 ECU_ADDRESS 0 /end MEASUREMENT
/begin MEASUREMENT Rte_Damping_DampingCmd_MtrNm_f32 "MICROSAR RTE" FLOAT32_IEEE NO_COMPU_METHOD 0 0 1.175494351e-38 3.402823466e+38 ECU_ADDRESS 0 /end MEASUREMENT
/begin MEASUREMENT Rte_Damping_DampingDDFactor_Uls_f32 "MICROSAR RTE" FLOAT32_IEEE NO_COMPU_METHOD 0 0 1.175494351e-38 3.402823466e+38 ECU_ADDRESS 0 /end MEASUREMENT
/begin MEASUREMENT Rte_MtrVel_MotorVelCRF_MtrRadpS_f32 "MICROSAR RTE" FLOAT32_IEEE NO_COMPU_METHOD 0 0 1.175494351e-38 3.402823466e+38 ECU_ADDRESS 0 /end MEASUREMENT
/begin MEASUREMENT Rte_PSADSG_PsaDampgCmd_MtrNm_f32 "MICROSAR RTE" FLOAT32_IEEE NO_COMPU_METHOD 0 0 1.175494351e-38 3.402823466e+38 ECU_ADDRESS 0 /end MEASUREMENT
/begin MEASUREMENT Rte_FrqDepDmpnInrtCmp_FrqDepDmpnInrtCmp_MtrNm_f32 "MICROSAR RTE" FLOAT32_IEEE NO_COMPU_METHOD 0 0 1.175494351e-38 3.402823466e+38 ECU_ADDRESS 0 /end MEASUREMENT
/begin MEASUREMENT Rte_SignlCondn_Vehicle_LonAccel_KphpS_f32 "MICROSAR RTE" FLOAT32_IEEE NO_COMPU_METHOD 0 0 1.175494351e-38 3.402823466e+38 ECU_ADDRESS 0 /end MEASUREMENT
/begin MEASUREMENT Rte_DampingFirewall_WIRCmdAmpBlnd_MtrNm_f32 "MICROSAR RTE" FLOAT32_IEEE NO_COMPU_METHOD 0 0 1.175494351e-38 3.402823466e+38 ECU_ADDRESS 0 /end MEASUREMENT
/begin MEASUREMENT Rte_SrlComDriver_BusOff_Cnt_lgc "MICROSAR RTE" UBYTE RTE_CM_BOOLEAN 0 0 0 255 ECU_ADDRESS 0 /end MEASUREMENT
/begin MEASUREMENT Rte_DemIf_CTCFailed_Cnt_lgc "MICROSAR RTE" UBYTE RTE_CM_BOOLEAN 0 0 0 255 ECU_ADDRESS 0 /end MEASUREMENT
/begin MEASUREMENT Rte_SrlComInput_ElectronicIntegration_Cnt_lgc "MICROSAR RTE" UBYTE RTE_CM_BOOLEAN 0 0 0 255 ECU_ADDRESS 0 /end MEASUREMENT
/begin MEASUREMENT Rte_DiagMgr10_DiagNoofActiveInverter_Cnt_u08 "MICROSAR RTE" UBYTE NO_COMPU_METHOD 0 0 0 255 ECU_ADDRESS 0 /end MEASUREMENT
/begin MEASUREMENT Rte_DiagMgr10_DiagRampRate_XpmS_f32 "MICROSAR RTE" FLOAT32_IEEE NO_COMPU_METHOD 0 0 1.175494351e-38 3.402823466e+38 ECU_ADDRESS 0 /end MEASUREMENT
/begin MEASUREMENT Rte_DiagMgr10_DiagRampValue_Uls_f32 "MICROSAR RTE" FLOAT32_IEEE NO_COMPU_METHOD 0 0 1.175494351e-38 3.402823466e+38 ECU_ADDRESS 0 /end MEASUREMENT
/begin MEASUREMENT Rte_DiagMgr10_DiagRmpToZeroActive_Cnt_lgc "MICROSAR RTE" UBYTE RTE_CM_BOOLEAN 0 0 0 255 ECU_ADDRESS 0 /end MEASUREMENT
/begin MEASUREMENT Rte_DiagMgr10_DiagStsCtrldDisRmpPres_Cnt_lgc "MICROSAR RTE" UBYTE RTE_CM_BOOLEAN 0 0 0 255 ECU_ADDRESS 0 /end MEASUREMENT
/begin MEASUREMENT Rte_DiagMgr10_DiagStsDefVehSpd_Cnt_lgc "MICROSAR RTE" UBYTE RTE_CM_BOOLEAN 0 0 0 255 ECU_ADDRESS 0 /end MEASUREMENT
/begin MEASUREMENT Rte_DiagMgr10_DiagStsInverter1Inactive_Cnt_lgc "MICROSAR RTE" UBYTE RTE_CM_BOOLEAN 0 0 0 255 ECU_ADDRESS 0 /end MEASUREMENT
/begin MEASUREMENT Rte_DiagMgr10_DiagStsInverter2Inactive_Cnt_lgc "MICROSAR RTE" UBYTE RTE_CM_BOOLEAN 0 0 0 255 ECU_ADDRESS 0 /end MEASUREMENT
/begin MEASUREMENT Rte_DiagMgr10_DiagStsNonRecRmpToZeroFltPres_Cnt_lgc "MICROSAR RTE" UBYTE RTE_CM_BOOLEAN 0 0 0 255 ECU_ADDRESS 0 /end MEASUREMENT
/begin MEASUREMENT Rte_DiagMgr10_DiagStsRecRmpToZeroFltPres_Cnt_lgc "MICROSAR RTE" UBYTE RTE_CM_BOOLEAN 0 0 0 255 ECU_ADDRESS 0 /end MEASUREMENT
/begin MEASUREMENT Rte_DiagMgr10_DiagStsScomHWANotValid_Cnt_lgc "MICROSAR RTE" UBYTE RTE_CM_BOOLEAN 0 0 0 255 ECU_ADDRESS 0 /end MEASUREMENT
/begin MEASUREMENT Rte_DiagMgr10_DiagStsWIRDisable_Cnt_lgc "MICROSAR RTE" UBYTE RTE_CM_BOOLEAN 0 0 0 255 ECU_ADDRESS 0 /end MEASUREMENT
/begin MEASUREMENT Rte_TranlDampg_MRFMtrTrqCmd_MtrNm_f32 "MICROSAR RTE" FLOAT32_IEEE NO_COMPU_METHOD 0 0 1.175494351e-38 3.402823466e+38 ECU_ADDRESS 0 /end MEASUREMENT
/begin MEASUREMENT Rte_PwrLmtFuncCr_MRFMtrTrqCmd_MtrNm_f32 "MICROSAR RTE" FLOAT32_IEEE NO_COMPU_METHOD 0 0 1.175494351e-38 3.402823466e+38 ECU_ADDRESS 0 /end MEASUREMENT
/begin MEASUREMENT Rte_SrlComDriver_Kilometrage_Cnt_u32 "MICROSAR RTE" ULONG NO_COMPU_METHOD 0 0 0 4294967295 ECU_ADDRESS 0 /end MEASUREMENT
/begin MEASUREMENT Rte_SrlComInput_SrlComVehSpd_Kph_f32 "MICROSAR RTE" FLOAT32_IEEE NO_COMPU_METHOD 0 0 1.175494351e-38 3.402823466e+38 ECU_ADDRESS 0 /end MEASUREMENT
/begin MEASUREMENT Rte_DigMSB_AlignedCumMechMtrPosMRF_Deg_f32 "MICROSAR RTE" FLOAT32_IEEE NO_COMPU_METHOD 0 0 1.175494351e-38 3.402823466e+38 ECU_ADDRESS 0 /end MEASUREMENT
/begin MEASUREMENT Rte_DigMSB_CumMechMtrPosMRF_Deg_f32 "MICROSAR RTE" FLOAT32_IEEE NO_COMPU_METHOD 0 0 1.175494351e-38 3.402823466e+38 ECU_ADDRESS 0 /end MEASUREMENT
/begin MEASUREMENT Rte_DigMSB_CumMechMtrPosStatus_Cnt_u08 "MICROSAR RTE" UBYTE NO_COMPU_METHOD 0 0 0 255 ECU_ADDRESS 0 /end MEASUREMENT
/begin MEASUREMENT Rte_DigMSB_DigMSBEOLData.CRC_Cnt_u16 "MICROSAR RTE" UWORD NO_COMPU_METHOD 0 0 0 65535 ECU_ADDRESS 0 READ_WRITE /end MEASUREMENT
/begin MEASUREMENT Rte_DigMSB_DigMSBEOLData.MtrPos1HarCompTbl_Rev_s2p13 "MICROSAR RTE" SWORD NO_COMPU_METHOD 0 0 -32768 32767 MATRIX_DIM 1024 1 1 ECU_ADDRESS 0 READ_WRITE /end MEASUREMENT
/begin MEASUREMENT Rte_DigMSB_DigMSBEOLData.MtrPos2HarCompTbl_Rev_s2p13 "MICROSAR RTE" SWORD NO_COMPU_METHOD 0 0 -32768 32767 MATRIX_DIM 1024 1 1 ECU_ADDRESS 0 READ_WRITE /end MEASUREMENT
/begin MEASUREMENT Rte_DigMSB_DigMSBEOLData.MtrPosBEMFRedundant_Rev_u0p16 "MICROSAR RTE" UWORD NO_COMPU_METHOD 0 0 0 65535 ECU_ADDRESS 0 READ_WRITE /end MEASUREMENT
/begin MEASUREMENT Rte_DigMSB_DigMSBEOLData.MtrPosBEMF_Rev_u0p16 "MICROSAR RTE" UWORD NO_COMPU_METHOD 0 0 0 65535 ECU_ADDRESS 0 READ_WRITE /end MEASUREMENT
/begin MEASUREMENT Rte_DigMSB_MechMtrPos2_Rev_u0p16 "MICROSAR RTE" UWORD NO_COMPU_METHOD 0 0 0 65535 ECU_ADDRESS 0 /end MEASUREMENT
/begin MEASUREMENT Rte_DigMSB_SysCCumMechMtrPosMRF_Deg_f32 "MICROSAR RTE" FLOAT32_IEEE NO_COMPU_METHOD 0 0 1.175494351e-38 3.402823466e+38 ECU_ADDRESS 0 /end MEASUREMENT
/begin MEASUREMENT Rte_MtrDrvDiag_GateDriveResetActive_Cnt_lgc "MICROSAR RTE" UBYTE RTE_CM_BOOLEAN 0 0 0 255 ECU_ADDRESS 0 /end MEASUREMENT
/begin MEASUREMENT Rte_PhaseAbcFdbkMeas_MeasuredOnTimeA_Cnt_u32 "MICROSAR RTE" ULONG NO_COMPU_METHOD 0 0 0 4294967295 ECU_ADDRESS 0 /end MEASUREMENT
/begin MEASUREMENT Rte_PhaseAbcFdbkMeas_MeasuredOnTimeB_Cnt_u32 "MICROSAR RTE" ULONG NO_COMPU_METHOD 0 0 0 4294967295 ECU_ADDRESS 0 /end MEASUREMENT
/begin MEASUREMENT Rte_PhaseAbcFdbkMeas_MeasuredOnTimeC_Cnt_u32 "MICROSAR RTE" ULONG NO_COMPU_METHOD 0 0 0 4294967295 ECU_ADDRESS 0 /end MEASUREMENT
/begin MEASUREMENT Rte_DigPhsReasDiag_PDActivateTest_Cnt_lgc "MICROSAR RTE" UBYTE RTE_CM_BOOLEAN 0 0 0 255 ECU_ADDRESS 0 /end MEASUREMENT
/begin MEASUREMENT Rte_EOTActuatorMng_AssistEOTDamping_MtrNm_f32 "MICROSAR RTE" FLOAT32_IEEE NO_COMPU_METHOD 0 0 1.175494351e-38 3.402823466e+38 ECU_ADDRESS 0 /end MEASUREMENT
/begin MEASUREMENT Rte_EOTActuatorMng_AssistEOTGain_Uls_f32 "MICROSAR RTE" FLOAT32_IEEE NO_COMPU_METHOD 0 0 1.175494351e-38 3.402823466e+38 ECU_ADDRESS 0 /end MEASUREMENT
/begin MEASUREMENT Rte_EOTActuatorMng_AssistEOTLimit_MtrNm_f32 "MICROSAR RTE" FLOAT32_IEEE NO_COMPU_METHOD 0 0 1.175494351e-38 3.402823466e+38 ECU_ADDRESS 0 /end MEASUREMENT
/begin MEASUREMENT Rte_LrnEOT_CCWPosition_HwDeg_f32 "MICROSAR RTE" FLOAT32_IEEE NO_COMPU_METHOD 0 0 1.175494351e-38 3.402823466e+38 ECU_ADDRESS 0 /end MEASUREMENT
/begin MEASUREMENT Rte_LrnEOT_CCWFound_Cnt_lgc "MICROSAR RTE" UBYTE RTE_CM_BOOLEAN 0 0 0 255 ECU_ADDRESS 0 /end MEASUREMENT
/begin MEASUREMENT Rte_LrnEOT_CWPosition_HwDeg_f32 "MICROSAR RTE" FLOAT32_IEEE NO_COMPU_METHOD 0 0 1.175494351e-38 3.402823466e+38 ECU_ADDRESS 0 /end MEASUREMENT
/begin MEASUREMENT Rte_LrnEOT_CWFound_Cnt_lgc "MICROSAR RTE" UBYTE RTE_CM_BOOLEAN 0 0 0 255 ECU_ADDRESS 0 /end MEASUREMENT
/begin MEASUREMENT Rte_ElePwr_ElectricPower_Watt_f32 "MICROSAR RTE" FLOAT32_IEEE NO_COMPU_METHOD 0 0 1.175494351e-38 3.402823466e+38 ECU_ADDRESS 0 /end MEASUREMENT
/begin MEASUREMENT Rte_ElePwr_SupplyCurrent_Amp_f32 "MICROSAR RTE" FLOAT32_IEEE NO_COMPU_METHOD 0 0 1.175494351e-38 3.402823466e+38 ECU_ADDRESS 0 /end MEASUREMENT
/begin MEASUREMENT Rte_SrlComInput_BSIDataMissing_Cnt_lgc "MICROSAR RTE" UBYTE RTE_CM_BOOLEAN 0 0 0 255 ECU_ADDRESS 0 /end MEASUREMENT
/begin MEASUREMENT Rte_SrlComInput_CMMDataMissing_Cnt_lgc "MICROSAR RTE" UBYTE RTE_CM_BOOLEAN 0 0 0 255 ECU_ADDRESS 0 /end MEASUREMENT
/begin MEASUREMENT Rte_SrlComInput_CompteurTemporelVehiculeRaw_Cnt_u32 "MICROSAR RTE" ULONG NO_COMPU_METHOD 0 0 0 4294967295 ECU_ADDRESS 0 /end MEASUREMENT
/begin MEASUREMENT Rte_SrlComInput_ComputerRazGCTRaw_Cnt_u08 "MICROSAR RTE" UBYTE NO_COMPU_METHOD 0 0 0 255 ECU_ADDRESS 0 /end MEASUREMENT
/begin MEASUREMENT Rte_SrlComInput_EtatPrincipSev_Cnt_u08 "MICROSAR RTE" UBYTE NO_COMPU_METHOD 0 0 0 255 ECU_ADDRESS 0 /end MEASUREMENT
/begin MEASUREMENT Rte_SrlComInput_EtatReseauElec_Cnt_u08 "MICROSAR RTE" UBYTE NO_COMPU_METHOD 0 0 0 255 ECU_ADDRESS 0 /end MEASUREMENT
/begin MEASUREMENT Rte_FaultLog_FaultLog.CTCFailData[0].Byte1_Cnt_u08 "MICROSAR RTE" UBYTE NO_COMPU_METHOD 0 0 0 255 ECU_ADDRESS 0 READ_WRITE /end MEASUREMENT
/begin MEASUREMENT Rte_FaultLog_FaultLog.CTCFailData[0].Byte2_Cnt_u08 "MICROSAR RTE" UBYTE NO_COMPU_METHOD 0 0 0 255 ECU_ADDRESS 0 READ_WRITE /end MEASUREMENT
/begin MEASUREMENT Rte_FaultLog_FaultLog.CTCFailData[0].Byte3_Cnt_u08 "MICROSAR RTE" UBYTE NO_COMPU_METHOD 0 0 0 255 ECU_ADDRESS 0 READ_WRITE /end MEASUREMENT
/begin MEASUREMENT Rte_FaultLog_FaultLog.CTCFailData[0].Byte4_Cnt_u08 "MICROSAR RTE" UBYTE NO_COMPU_METHOD 0 0 0 255 ECU_ADDRESS 0 READ_WRITE /end MEASUREMENT
/begin MEASUREMENT Rte_FaultLog_FaultLog.CTCFailData[0].Byte5_Cnt_u08 "MICROSAR RTE" UBYTE NO_COMPU_METHOD 0 0 0 255 ECU_ADDRESS 0 READ_WRITE /end MEASUREMENT
/begin MEASUREMENT Rte_FaultLog_FaultLog.CTCFailData[0].Byte6_Cnt_u08 "MICROSAR RTE" UBYTE NO_COMPU_METHOD 0 0 0 255 ECU_ADDRESS 0 READ_WRITE /end MEASUREMENT
/begin MEASUREMENT Rte_FaultLog_FaultLog.CTCFailData[0].Reserved1_Cnt_u08 "MICROSAR RTE" UBYTE NO_COMPU_METHOD 0 0 0 255 ECU_ADDRESS 0 READ_WRITE /end MEASUREMENT
/begin MEASUREMENT Rte_FaultLog_FaultLog.CTCFailData[0].Reserved2_Cnt_u08 "MICROSAR RTE" UBYTE NO_COMPU_METHOD 0 0 0 255 ECU_ADDRESS 0 READ_WRITE /end MEASUREMENT
/begin MEASUREMENT Rte_FaultLog_FaultLog.CTCFailData[10].Byte1_Cnt_u08 "MICROSAR RTE" UBYTE NO_COMPU_METHOD 0 0 0 255 ECU_ADDRESS 0 READ_WRITE /end MEASUREMENT
/begin MEASUREMENT Rte_FaultLog_FaultLog.CTCFailData[10].Byte2_Cnt_u08 "MICROSAR RTE" UBYTE NO_COMPU_METHOD 0 0 0 255 ECU_ADDRESS 0 READ_WRITE /end MEASUREMENT
/begin MEASUREMENT Rte_FaultLog_FaultLog.CTCFailData[10].Byte3_Cnt_u08 "MICROSAR RTE" UBYTE NO_COMPU_METHOD 0 0 0 255 ECU_ADDRESS 0 READ_WRITE /end MEASUREMENT
/begin MEASUREMENT Rte_FaultLog_FaultLog.CTCFailData[10].Byte4_Cnt_u08 "MICROSAR RTE" UBYTE NO_COMPU_METHOD 0 0 0 255 ECU_ADDRESS 0 READ_WRITE /end MEASUREMENT
/begin MEASUREMENT Rte_FaultLog_FaultLog.CTCFailData[10].Byte5_Cnt_u08 "MICROSAR RTE" UBYTE NO_COMPU_METHOD 0 0 0 255 ECU_ADDRESS 0 READ_WRITE /end MEASUREMENT
/begin MEASUREMENT Rte_FaultLog_FaultLog.CTCFailData[10].Byte6_Cnt_u08 "MICROSAR RTE" UBYTE NO_COMPU_METHOD 0 0 0 255 ECU_ADDRESS 0 READ_WRITE /end MEASUREMENT
/begin MEASUREMENT Rte_FaultLog_FaultLog.CTCFailData[10].Reserved1_Cnt_u08 "MICROSAR RTE" UBYTE NO_COMPU_METHOD 0 0 0 255 ECU_ADDRESS 0 READ_WRITE /end MEASUREMENT
/begin MEASUREMENT Rte_FaultLog_FaultLog.CTCFailData[10].Reserved2_Cnt_u08 "MICROSAR RTE" UBYTE NO_COMPU_METHOD 0 0 0 255 ECU_ADDRESS 0 READ_WRITE /end MEASUREMENT
/begin MEASUREMENT Rte_FaultLog_FaultLog.CTCFailData[11].Byte1_Cnt_u08 "MICROSAR RTE" UBYTE NO_COMPU_METHOD 0 0 0 255 ECU_ADDRESS 0 READ_WRITE /end MEASUREMENT
/begin MEASUREMENT Rte_FaultLog_FaultLog.CTCFailData[11].Byte2_Cnt_u08 "MICROSAR RTE" UBYTE NO_COMPU_METHOD 0 0 0 255 ECU_ADDRESS 0 READ_WRITE /end MEASUREMENT
/begin MEASUREMENT Rte_FaultLog_FaultLog.CTCFailData[11].Byte3_Cnt_u08 "MICROSAR RTE" UBYTE NO_COMPU_METHOD 0 0 0 255 ECU_ADDRESS 0 READ_WRITE /end MEASUREMENT
/begin MEASUREMENT Rte_FaultLog_FaultLog.CTCFailData[11].Byte4_Cnt_u08 "MICROSAR RTE" UBYTE NO_COMPU_METHOD 0 0 0 255 ECU_ADDRESS 0 READ_WRITE /end MEASUREMENT
/begin MEASUREMENT Rte_FaultLog_FaultLog.CTCFailData[11].Byte5_Cnt_u08 "MICROSAR RTE" UBYTE NO_COMPU_METHOD 0 0 0 255 ECU_ADDRESS 0 READ_WRITE /end MEASUREMENT
/begin MEASUREMENT Rte_FaultLog_FaultLog.CTCFailData[11].Byte6_Cnt_u08 "MICROSAR RTE" UBYTE NO_COMPU_METHOD 0 0 0 255 ECU_ADDRESS 0 READ_WRITE /end MEASUREMENT
/begin MEASUREMENT Rte_FaultLog_FaultLog.CTCFailData[11].Reserved1_Cnt_u08 "MICROSAR RTE" UBYTE NO_COMPU_METHOD 0 0 0 255 ECU_ADDRESS 0 READ_WRITE /end MEASUREMENT
/begin MEASUREMENT Rte_FaultLog_FaultLog.CTCFailData[11].Reserved2_Cnt_u08 "MICROSAR RTE" UBYTE NO_COMPU_METHOD 0 0 0 255 ECU_ADDRESS 0 READ_WRITE /end MEASUREMENT
/begin MEASUREMENT Rte_FaultLog_FaultLog.CTCFailData[12].Byte1_Cnt_u08 "MICROSAR RTE" UBYTE NO_COMPU_METHOD 0 0 0 255 ECU_ADDRESS 0 READ_WRITE /end MEASUREMENT
/begin MEASUREMENT Rte_FaultLog_FaultLog.CTCFailData[12].Byte2_Cnt_u08 "MICROSAR RTE" UBYTE NO_COMPU_METHOD 0 0 0 255 ECU_ADDRESS 0 READ_WRITE /end MEASUREMENT
/begin MEASUREMENT Rte_FaultLog_FaultLog.CTCFailData[12].Byte3_Cnt_u08 "MICROSAR RTE" UBYTE NO_COMPU_METHOD 0 0 0 255 ECU_ADDRESS 0 READ_WRITE /end MEASUREMENT
/begin MEASUREMENT Rte_FaultLog_FaultLog.CTCFailData[12].Byte4_Cnt_u08 "MICROSAR RTE" UBYTE NO_COMPU_METHOD 0 0 0 255 ECU_ADDRESS 0 READ_WRITE /end MEASUREMENT
/begin MEASUREMENT Rte_FaultLog_FaultLog.CTCFailData[12].Byte5_Cnt_u08 "MICROSAR RTE" UBYTE NO_COMPU_METHOD 0 0 0 255 ECU_ADDRESS 0 READ_WRITE /end MEASUREMENT
/begin MEASUREMENT Rte_FaultLog_FaultLog.CTCFailData[12].Byte6_Cnt_u08 "MICROSAR RTE" UBYTE NO_COMPU_METHOD 0 0 0 255 ECU_ADDRESS 0 READ_WRITE /end MEASUREMENT
/begin MEASUREMENT Rte_FaultLog_FaultLog.CTCFailData[12].Reserved1_Cnt_u08 "MICROSAR RTE" UBYTE NO_COMPU_METHOD 0 0 0 255 ECU_ADDRESS 0 READ_WRITE /end MEASUREMENT
/begin MEASUREMENT Rte_FaultLog_FaultLog.CTCFailData[12].Reserved2_Cnt_u08 "MICROSAR RTE" UBYTE NO_COMPU_METHOD 0 0 0 255 ECU_ADDRESS 0 READ_WRITE /end MEASUREMENT
/begin MEASUREMENT Rte_FaultLog_FaultLog.CTCFailData[13].Byte1_Cnt_u08 "MICROSAR RTE" UBYTE NO_COMPU_METHOD 0 0 0 255 ECU_ADDRESS 0 READ_WRITE /end MEASUREMENT
/begin MEASUREMENT Rte_FaultLog_FaultLog.CTCFailData[13].Byte2_Cnt_u08 "MICROSAR RTE" UBYTE NO_COMPU_METHOD 0 0 0 255 ECU_ADDRESS 0 READ_WRITE /end MEASUREMENT
/begin MEASUREMENT Rte_FaultLog_FaultLog.CTCFailData[13].Byte3_Cnt_u08 "MICROSAR RTE" UBYTE NO_COMPU_METHOD 0 0 0 255 ECU_ADDRESS 0 READ_WRITE /end MEASUREMENT
/begin MEASUREMENT Rte_FaultLog_FaultLog.CTCFailData[13].Byte4_Cnt_u08 "MICROSAR RTE" UBYTE NO_COMPU_METHOD 0 0 0 255 ECU_ADDRESS 0 READ_WRITE /end MEASUREMENT
/begin MEASUREMENT Rte_FaultLog_FaultLog.CTCFailData[13].Byte5_Cnt_u08 "MICROSAR RTE" UBYTE NO_COMPU_METHOD 0 0 0 255 ECU_ADDRESS 0 READ_WRITE /end MEASUREMENT
/begin MEASUREMENT Rte_FaultLog_FaultLog.CTCFailData[13].Byte6_Cnt_u08 "MICROSAR RTE" UBYTE NO_COMPU_METHOD 0 0 0 255 ECU_ADDRESS 0 READ_WRITE /end MEASUREMENT
/begin MEASUREMENT Rte_FaultLog_FaultLog.CTCFailData[13].Reserved1_Cnt_u08 "MICROSAR RTE" UBYTE NO_COMPU_METHOD 0 0 0 255 ECU_ADDRESS 0 READ_WRITE /end MEASUREMENT
/begin MEASUREMENT Rte_FaultLog_FaultLog.CTCFailData[13].Reserved2_Cnt_u08 "MICROSAR RTE" UBYTE NO_COMPU_METHOD 0 0 0 255 ECU_ADDRESS 0 READ_WRITE /end MEASUREMENT
/begin MEASUREMENT Rte_FaultLog_FaultLog.CTCFailData[14].Byte1_Cnt_u08 "MICROSAR RTE" UBYTE NO_COMPU_METHOD 0 0 0 255 ECU_ADDRESS 0 READ_WRITE /end MEASUREMENT
/begin MEASUREMENT Rte_FaultLog_FaultLog.CTCFailData[14].Byte2_Cnt_u08 "MICROSAR RTE" UBYTE NO_COMPU_METHOD 0 0 0 255 ECU_ADDRESS 0 READ_WRITE /end MEASUREMENT
/begin MEASUREMENT Rte_FaultLog_FaultLog.CTCFailData[14].Byte3_Cnt_u08 "MICROSAR RTE" UBYTE NO_COMPU_METHOD 0 0 0 255 ECU_ADDRESS 0 READ_WRITE /end MEASUREMENT
/begin MEASUREMENT Rte_FaultLog_FaultLog.CTCFailData[14].Byte4_Cnt_u08 "MICROSAR RTE" UBYTE NO_COMPU_METHOD 0 0 0 255 ECU_ADDRESS 0 READ_WRITE /end MEASUREMENT
/begin MEASUREMENT Rte_FaultLog_FaultLog.CTCFailData[14].Byte5_Cnt_u08 "MICROSAR RTE" UBYTE NO_COMPU_METHOD 0 0 0 255 ECU_ADDRESS 0 READ_WRITE /end MEASUREMENT
/begin MEASUREMENT Rte_FaultLog_FaultLog.CTCFailData[14].Byte6_Cnt_u08 "MICROSAR RTE" UBYTE NO_COMPU_METHOD 0 0 0 255 ECU_ADDRESS 0 READ_WRITE /end MEASUREMENT
/begin MEASUREMENT Rte_FaultLog_FaultLog.CTCFailData[14].Reserved1_Cnt_u08 "MICROSAR RTE" UBYTE NO_COMPU_METHOD 0 0 0 255 ECU_ADDRESS 0 READ_WRITE /end MEASUREMENT
/begin MEASUREMENT Rte_FaultLog_FaultLog.CTCFailData[14].Reserved2_Cnt_u08 "MICROSAR RTE" UBYTE NO_COMPU_METHOD 0 0 0 255 ECU_ADDRESS 0 READ_WRITE /end MEASUREMENT
/begin MEASUREMENT Rte_FaultLog_FaultLog.CTCFailData[15].Byte1_Cnt_u08 "MICROSAR RTE" UBYTE NO_COMPU_METHOD 0 0 0 255 ECU_ADDRESS 0 READ_WRITE /end MEASUREMENT
/begin MEASUREMENT Rte_FaultLog_FaultLog.CTCFailData[15].Byte2_Cnt_u08 "MICROSAR RTE" UBYTE NO_COMPU_METHOD 0 0 0 255 ECU_ADDRESS 0 READ_WRITE /end MEASUREMENT
/begin MEASUREMENT Rte_FaultLog_FaultLog.CTCFailData[15].Byte3_Cnt_u08 "MICROSAR RTE" UBYTE NO_COMPU_METHOD 0 0 0 255 ECU_ADDRESS 0 READ_WRITE /end MEASUREMENT
/begin MEASUREMENT Rte_FaultLog_FaultLog.CTCFailData[15].Byte4_Cnt_u08 "MICROSAR RTE" UBYTE NO_COMPU_METHOD 0 0 0 255 ECU_ADDRESS 0 READ_WRITE /end MEASUREMENT
/begin MEASUREMENT Rte_FaultLog_FaultLog.CTCFailData[15].Byte5_Cnt_u08 "MICROSAR RTE" UBYTE NO_COMPU_METHOD 0 0 0 255 ECU_ADDRESS 0 READ_WRITE /end MEASUREMENT
/begin MEASUREMENT Rte_FaultLog_FaultLog.CTCFailData[15].Byte6_Cnt_u08 "MICROSAR RTE" UBYTE NO_COMPU_METHOD 0 0 0 255 ECU_ADDRESS 0 READ_WRITE /end MEASUREMENT
/begin MEASUREMENT Rte_FaultLog_FaultLog.CTCFailData[15].Reserved1_Cnt_u08 "MICROSAR RTE" UBYTE NO_COMPU_METHOD 0 0 0 255 ECU_ADDRESS 0 READ_WRITE /end MEASUREMENT
/begin MEASUREMENT Rte_FaultLog_FaultLog.CTCFailData[15].Reserved2_Cnt_u08 "MICROSAR RTE" UBYTE NO_COMPU_METHOD 0 0 0 255 ECU_ADDRESS 0 READ_WRITE /end MEASUREMENT
/begin MEASUREMENT Rte_FaultLog_FaultLog.CTCFailData[16].Byte1_Cnt_u08 "MICROSAR RTE" UBYTE NO_COMPU_METHOD 0 0 0 255 ECU_ADDRESS 0 READ_WRITE /end MEASUREMENT
/begin MEASUREMENT Rte_FaultLog_FaultLog.CTCFailData[16].Byte2_Cnt_u08 "MICROSAR RTE" UBYTE NO_COMPU_METHOD 0 0 0 255 ECU_ADDRESS 0 READ_WRITE /end MEASUREMENT
/begin MEASUREMENT Rte_FaultLog_FaultLog.CTCFailData[16].Byte3_Cnt_u08 "MICROSAR RTE" UBYTE NO_COMPU_METHOD 0 0 0 255 ECU_ADDRESS 0 READ_WRITE /end MEASUREMENT
/begin MEASUREMENT Rte_FaultLog_FaultLog.CTCFailData[16].Byte4_Cnt_u08 "MICROSAR RTE" UBYTE NO_COMPU_METHOD 0 0 0 255 ECU_ADDRESS 0 READ_WRITE /end MEASUREMENT
/begin MEASUREMENT Rte_FaultLog_FaultLog.CTCFailData[16].Byte5_Cnt_u08 "MICROSAR RTE" UBYTE NO_COMPU_METHOD 0 0 0 255 ECU_ADDRESS 0 READ_WRITE /end MEASUREMENT
/begin MEASUREMENT Rte_FaultLog_FaultLog.CTCFailData[16].Byte6_Cnt_u08 "MICROSAR RTE" UBYTE NO_COMPU_METHOD 0 0 0 255 ECU_ADDRESS 0 READ_WRITE /end MEASUREMENT
/begin MEASUREMENT Rte_FaultLog_FaultLog.CTCFailData[16].Reserved1_Cnt_u08 "MICROSAR RTE" UBYTE NO_COMPU_METHOD 0 0 0 255 ECU_ADDRESS 0 READ_WRITE /end MEASUREMENT
/begin MEASUREMENT Rte_FaultLog_FaultLog.CTCFailData[16].Reserved2_Cnt_u08 "MICROSAR RTE" UBYTE NO_COMPU_METHOD 0 0 0 255 ECU_ADDRESS 0 READ_WRITE /end MEASUREMENT
/begin MEASUREMENT Rte_FaultLog_FaultLog.CTCFailData[17].Byte1_Cnt_u08 "MICROSAR RTE" UBYTE NO_COMPU_METHOD 0 0 0 255 ECU_ADDRESS 0 READ_WRITE /end MEASUREMENT
/begin MEASUREMENT Rte_FaultLog_FaultLog.CTCFailData[17].Byte2_Cnt_u08 "MICROSAR RTE" UBYTE NO_COMPU_METHOD 0 0 0 255 ECU_ADDRESS 0 READ_WRITE /end MEASUREMENT
/begin MEASUREMENT Rte_FaultLog_FaultLog.CTCFailData[17].Byte3_Cnt_u08 "MICROSAR RTE" UBYTE NO_COMPU_METHOD 0 0 0 255 ECU_ADDRESS 0 READ_WRITE /end MEASUREMENT
/begin MEASUREMENT Rte_FaultLog_FaultLog.CTCFailData[17].Byte4_Cnt_u08 "MICROSAR RTE" UBYTE NO_COMPU_METHOD 0 0 0 255 ECU_ADDRESS 0 READ_WRITE /end MEASUREMENT
/begin MEASUREMENT Rte_FaultLog_FaultLog.CTCFailData[17].Byte5_Cnt_u08 "MICROSAR RTE" UBYTE NO_COMPU_METHOD 0 0 0 255 ECU_ADDRESS 0 READ_WRITE /end MEASUREMENT
/begin MEASUREMENT Rte_FaultLog_FaultLog.CTCFailData[17].Byte6_Cnt_u08 "MICROSAR RTE" UBYTE NO_COMPU_METHOD 0 0 0 255 ECU_ADDRESS 0 READ_WRITE /end MEASUREMENT
/begin MEASUREMENT Rte_FaultLog_FaultLog.CTCFailData[17].Reserved1_Cnt_u08 "MICROSAR RTE" UBYTE NO_COMPU_METHOD 0 0 0 255 ECU_ADDRESS 0 READ_WRITE /end MEASUREMENT
/begin MEASUREMENT Rte_FaultLog_FaultLog.CTCFailData[17].Reserved2_Cnt_u08 "MICROSAR RTE" UBYTE NO_COMPU_METHOD 0 0 0 255 ECU_ADDRESS 0 READ_WRITE /end MEASUREMENT
/begin MEASUREMENT Rte_FaultLog_FaultLog.CTCFailData[18].Byte1_Cnt_u08 "MICROSAR RTE" UBYTE NO_COMPU_METHOD 0 0 0 255 ECU_ADDRESS 0 READ_WRITE /end MEASUREMENT
/begin MEASUREMENT Rte_FaultLog_FaultLog.CTCFailData[18].Byte2_Cnt_u08 "MICROSAR RTE" UBYTE NO_COMPU_METHOD 0 0 0 255 ECU_ADDRESS 0 READ_WRITE /end MEASUREMENT
/begin MEASUREMENT Rte_FaultLog_FaultLog.CTCFailData[18].Byte3_Cnt_u08 "MICROSAR RTE" UBYTE NO_COMPU_METHOD 0 0 0 255 ECU_ADDRESS 0 READ_WRITE /end MEASUREMENT
/begin MEASUREMENT Rte_FaultLog_FaultLog.CTCFailData[18].Byte4_Cnt_u08 "MICROSAR RTE" UBYTE NO_COMPU_METHOD 0 0 0 255 ECU_ADDRESS 0 READ_WRITE /end MEASUREMENT
/begin MEASUREMENT Rte_FaultLog_FaultLog.CTCFailData[18].Byte5_Cnt_u08 "MICROSAR RTE" UBYTE NO_COMPU_METHOD 0 0 0 255 ECU_ADDRESS 0 READ_WRITE /end MEASUREMENT
/begin MEASUREMENT Rte_FaultLog_FaultLog.CTCFailData[18].Byte6_Cnt_u08 "MICROSAR RTE" UBYTE NO_COMPU_METHOD 0 0 0 255 ECU_ADDRESS 0 READ_WRITE /end MEASUREMENT
/begin MEASUREMENT Rte_FaultLog_FaultLog.CTCFailData[18].Reserved1_Cnt_u08 "MICROSAR RTE" UBYTE NO_COMPU_METHOD 0 0 0 255 ECU_ADDRESS 0 READ_WRITE /end MEASUREMENT
/begin MEASUREMENT Rte_FaultLog_FaultLog.CTCFailData[18].Reserved2_Cnt_u08 "MICROSAR RTE" UBYTE NO_COMPU_METHOD 0 0 0 255 ECU_ADDRESS 0 READ_WRITE /end MEASUREMENT
/begin MEASUREMENT Rte_FaultLog_FaultLog.CTCFailData[19].Byte1_Cnt_u08 "MICROSAR RTE" UBYTE NO_COMPU_METHOD 0 0 0 255 ECU_ADDRESS 0 READ_WRITE /end MEASUREMENT
/begin MEASUREMENT Rte_FaultLog_FaultLog.CTCFailData[19].Byte2_Cnt_u08 "MICROSAR RTE" UBYTE NO_COMPU_METHOD 0 0 0 255 ECU_ADDRESS 0 READ_WRITE /end MEASUREMENT
/begin MEASUREMENT Rte_FaultLog_FaultLog.CTCFailData[19].Byte3_Cnt_u08 "MICROSAR RTE" UBYTE NO_COMPU_METHOD 0 0 0 255 ECU_ADDRESS 0 READ_WRITE /end MEASUREMENT
/begin MEASUREMENT Rte_FaultLog_FaultLog.CTCFailData[19].Byte4_Cnt_u08 "MICROSAR RTE" UBYTE NO_COMPU_METHOD 0 0 0 255 ECU_ADDRESS 0 READ_WRITE /end MEASUREMENT
/begin MEASUREMENT Rte_FaultLog_FaultLog.CTCFailData[19].Byte5_Cnt_u08 "MICROSAR RTE" UBYTE NO_COMPU_METHOD 0 0 0 255 ECU_ADDRESS 0 READ_WRITE /end MEASUREMENT
/begin MEASUREMENT Rte_FaultLog_FaultLog.CTCFailData[19].Byte6_Cnt_u08 "MICROSAR RTE" UBYTE NO_COMPU_METHOD 0 0 0 255 ECU_ADDRESS 0 READ_WRITE /end MEASUREMENT
/begin MEASUREMENT Rte_FaultLog_FaultLog.CTCFailData[19].Reserved1_Cnt_u08 "MICROSAR RTE" UBYTE NO_COMPU_METHOD 0 0 0 255 ECU_ADDRESS 0 READ_WRITE /end MEASUREMENT
/begin MEASUREMENT Rte_FaultLog_FaultLog.CTCFailData[19].Reserved2_Cnt_u08 "MICROSAR RTE" UBYTE NO_COMPU_METHOD 0 0 0 255 ECU_ADDRESS 0 READ_WRITE /end MEASUREMENT
/begin MEASUREMENT Rte_FaultLog_FaultLog.CTCFailData[1].Byte1_Cnt_u08 "MICROSAR RTE" UBYTE NO_COMPU_METHOD 0 0 0 255 ECU_ADDRESS 0 READ_WRITE /end MEASUREMENT
/begin MEASUREMENT Rte_FaultLog_FaultLog.CTCFailData[1].Byte2_Cnt_u08 "MICROSAR RTE" UBYTE NO_COMPU_METHOD 0 0 0 255 ECU_ADDRESS 0 READ_WRITE /end MEASUREMENT
/begin MEASUREMENT Rte_FaultLog_FaultLog.CTCFailData[1].Byte3_Cnt_u08 "MICROSAR RTE" UBYTE NO_COMPU_METHOD 0 0 0 255 ECU_ADDRESS 0 READ_WRITE /end MEASUREMENT
/begin MEASUREMENT Rte_FaultLog_FaultLog.CTCFailData[1].Byte4_Cnt_u08 "MICROSAR RTE" UBYTE NO_COMPU_METHOD 0 0 0 255 ECU_ADDRESS 0 READ_WRITE /end MEASUREMENT
/begin MEASUREMENT Rte_FaultLog_FaultLog.CTCFailData[1].Byte5_Cnt_u08 "MICROSAR RTE" UBYTE NO_COMPU_METHOD 0 0 0 255 ECU_ADDRESS 0 READ_WRITE /end MEASUREMENT
/begin MEASUREMENT Rte_FaultLog_FaultLog.CTCFailData[1].Byte6_Cnt_u08 "MICROSAR RTE" UBYTE NO_COMPU_METHOD 0 0 0 255 ECU_ADDRESS 0 READ_WRITE /end MEASUREMENT
/begin MEASUREMENT Rte_FaultLog_FaultLog.CTCFailData[1].Reserved1_Cnt_u08 "MICROSAR RTE" UBYTE NO_COMPU_METHOD 0 0 0 255 ECU_ADDRESS 0 READ_WRITE /end MEASUREMENT
/begin MEASUREMENT Rte_FaultLog_FaultLog.CTCFailData[1].Reserved2_Cnt_u08 "MICROSAR RTE" UBYTE NO_COMPU_METHOD 0 0 0 255 ECU_ADDRESS 0 READ_WRITE /end MEASUREMENT
/begin MEASUREMENT Rte_FaultLog_FaultLog.CTCFailData[20].Byte1_Cnt_u08 "MICROSAR RTE" UBYTE NO_COMPU_METHOD 0 0 0 255 ECU_ADDRESS 0 READ_WRITE /end MEASUREMENT
/begin MEASUREMENT Rte_FaultLog_FaultLog.CTCFailData[20].Byte2_Cnt_u08 "MICROSAR RTE" UBYTE NO_COMPU_METHOD 0 0 0 255 ECU_ADDRESS 0 READ_WRITE /end MEASUREMENT
/begin MEASUREMENT Rte_FaultLog_FaultLog.CTCFailData[20].Byte3_Cnt_u08 "MICROSAR RTE" UBYTE NO_COMPU_METHOD 0 0 0 255 ECU_ADDRESS 0 READ_WRITE /end MEASUREMENT
/begin MEASUREMENT Rte_FaultLog_FaultLog.CTCFailData[20].Byte4_Cnt_u08 "MICROSAR RTE" UBYTE NO_COMPU_METHOD 0 0 0 255 ECU_ADDRESS 0 READ_WRITE /end MEASUREMENT
/begin MEASUREMENT Rte_FaultLog_FaultLog.CTCFailData[20].Byte5_Cnt_u08 "MICROSAR RTE" UBYTE NO_COMPU_METHOD 0 0 0 255 ECU_ADDRESS 0 READ_WRITE /end MEASUREMENT
/begin MEASUREMENT Rte_FaultLog_FaultLog.CTCFailData[20].Byte6_Cnt_u08 "MICROSAR RTE" UBYTE NO_COMPU_METHOD 0 0 0 255 ECU_ADDRESS 0 READ_WRITE /end MEASUREMENT
/begin MEASUREMENT Rte_FaultLog_FaultLog.CTCFailData[20].Reserved1_Cnt_u08 "MICROSAR RTE" UBYTE NO_COMPU_METHOD 0 0 0 255 ECU_ADDRESS 0 READ_WRITE /end MEASUREMENT
/begin MEASUREMENT Rte_FaultLog_FaultLog.CTCFailData[20].Reserved2_Cnt_u08 "MICROSAR RTE" UBYTE NO_COMPU_METHOD 0 0 0 255 ECU_ADDRESS 0 READ_WRITE /end MEASUREMENT
/begin MEASUREMENT Rte_FaultLog_FaultLog.CTCFailData[21].Byte1_Cnt_u08 "MICROSAR RTE" UBYTE NO_COMPU_METHOD 0 0 0 255 ECU_ADDRESS 0 READ_WRITE /end MEASUREMENT
/begin MEASUREMENT Rte_FaultLog_FaultLog.CTCFailData[21].Byte2_Cnt_u08 "MICROSAR RTE" UBYTE NO_COMPU_METHOD 0 0 0 255 ECU_ADDRESS 0 READ_WRITE /end MEASUREMENT
/begin MEASUREMENT Rte_FaultLog_FaultLog.CTCFailData[21].Byte3_Cnt_u08 "MICROSAR RTE" UBYTE NO_COMPU_METHOD 0 0 0 255 ECU_ADDRESS 0 READ_WRITE /end MEASUREMENT
/begin MEASUREMENT Rte_FaultLog_FaultLog.CTCFailData[21].Byte4_Cnt_u08 "MICROSAR RTE" UBYTE NO_COMPU_METHOD 0 0 0 255 ECU_ADDRESS 0 READ_WRITE /end MEASUREMENT
/begin MEASUREMENT Rte_FaultLog_FaultLog.CTCFailData[21].Byte5_Cnt_u08 "MICROSAR RTE" UBYTE NO_COMPU_METHOD 0 0 0 255 ECU_ADDRESS 0 READ_WRITE /end MEASUREMENT
/begin MEASUREMENT Rte_FaultLog_FaultLog.CTCFailData[21].Byte6_Cnt_u08 "MICROSAR RTE" UBYTE NO_COMPU_METHOD 0 0 0 255 ECU_ADDRESS 0 READ_WRITE /end MEASUREMENT
/begin MEASUREMENT Rte_FaultLog_FaultLog.CTCFailData[21].Reserved1_Cnt_u08 "MICROSAR RTE" UBYTE NO_COMPU_METHOD 0 0 0 255 ECU_ADDRESS 0 READ_WRITE /end MEASUREMENT
/begin MEASUREMENT Rte_FaultLog_FaultLog.CTCFailData[21].Reserved2_Cnt_u08 "MICROSAR RTE" UBYTE NO_COMPU_METHOD 0 0 0 255 ECU_ADDRESS 0 READ_WRITE /end MEASUREMENT
/begin MEASUREMENT Rte_FaultLog_FaultLog.CTCFailData[22].Byte1_Cnt_u08 "MICROSAR RTE" UBYTE NO_COMPU_METHOD 0 0 0 255 ECU_ADDRESS 0 READ_WRITE /end MEASUREMENT
/begin MEASUREMENT Rte_FaultLog_FaultLog.CTCFailData[22].Byte2_Cnt_u08 "MICROSAR RTE" UBYTE NO_COMPU_METHOD 0 0 0 255 ECU_ADDRESS 0 READ_WRITE /end MEASUREMENT
/begin MEASUREMENT Rte_FaultLog_FaultLog.CTCFailData[22].Byte3_Cnt_u08 "MICROSAR RTE" UBYTE NO_COMPU_METHOD 0 0 0 255 ECU_ADDRESS 0 READ_WRITE /end MEASUREMENT
/begin MEASUREMENT Rte_FaultLog_FaultLog.CTCFailData[22].Byte4_Cnt_u08 "MICROSAR RTE" UBYTE NO_COMPU_METHOD 0 0 0 255 ECU_ADDRESS 0 READ_WRITE /end MEASUREMENT
/begin MEASUREMENT Rte_FaultLog_FaultLog.CTCFailData[22].Byte5_Cnt_u08 "MICROSAR RTE" UBYTE NO_COMPU_METHOD 0 0 0 255 ECU_ADDRESS 0 READ_WRITE /end MEASUREMENT
/begin MEASUREMENT Rte_FaultLog_FaultLog.CTCFailData[22].Byte6_Cnt_u08 "MICROSAR RTE" UBYTE NO_COMPU_METHOD 0 0 0 255 ECU_ADDRESS 0 READ_WRITE /end MEASUREMENT
/begin MEASUREMENT Rte_FaultLog_FaultLog.CTCFailData[22].Reserved1_Cnt_u08 "MICROSAR RTE" UBYTE NO_COMPU_METHOD 0 0 0 255 ECU_ADDRESS 0 READ_WRITE /end MEASUREMENT
/begin MEASUREMENT Rte_FaultLog_FaultLog.CTCFailData[22].Reserved2_Cnt_u08 "MICROSAR RTE" UBYTE NO_COMPU_METHOD 0 0 0 255 ECU_ADDRESS 0 READ_WRITE /end MEASUREMENT
/begin MEASUREMENT Rte_FaultLog_FaultLog.CTCFailData[23].Byte1_Cnt_u08 "MICROSAR RTE" UBYTE NO_COMPU_METHOD 0 0 0 255 ECU_ADDRESS 0 READ_WRITE /end MEASUREMENT
/begin MEASUREMENT Rte_FaultLog_FaultLog.CTCFailData[23].Byte2_Cnt_u08 "MICROSAR RTE" UBYTE NO_COMPU_METHOD 0 0 0 255 ECU_ADDRESS 0 READ_WRITE /end MEASUREMENT
/begin MEASUREMENT Rte_FaultLog_FaultLog.CTCFailData[23].Byte3_Cnt_u08 "MICROSAR RTE" UBYTE NO_COMPU_METHOD 0 0 0 255 ECU_ADDRESS 0 READ_WRITE /end MEASUREMENT
/begin MEASUREMENT Rte_FaultLog_FaultLog.CTCFailData[23].Byte4_Cnt_u08 "MICROSAR RTE" UBYTE NO_COMPU_METHOD 0 0 0 255 ECU_ADDRESS 0 READ_WRITE /end MEASUREMENT
/begin MEASUREMENT Rte_FaultLog_FaultLog.CTCFailData[23].Byte5_Cnt_u08 "MICROSAR RTE" UBYTE NO_COMPU_METHOD 0 0 0 255 ECU_ADDRESS 0 READ_WRITE /end MEASUREMENT
/begin MEASUREMENT Rte_FaultLog_FaultLog.CTCFailData[23].Byte6_Cnt_u08 "MICROSAR RTE" UBYTE NO_COMPU_METHOD 0 0 0 255 ECU_ADDRESS 0 READ_WRITE /end MEASUREMENT
/begin MEASUREMENT Rte_FaultLog_FaultLog.CTCFailData[23].Reserved1_Cnt_u08 "MICROSAR RTE" UBYTE NO_COMPU_METHOD 0 0 0 255 ECU_ADDRESS 0 READ_WRITE /end MEASUREMENT
/begin MEASUREMENT Rte_FaultLog_FaultLog.CTCFailData[23].Reserved2_Cnt_u08 "MICROSAR RTE" UBYTE NO_COMPU_METHOD 0 0 0 255 ECU_ADDRESS 0 READ_WRITE /end MEASUREMENT
/begin MEASUREMENT Rte_FaultLog_FaultLog.CTCFailData[24].Byte1_Cnt_u08 "MICROSAR RTE" UBYTE NO_COMPU_METHOD 0 0 0 255 ECU_ADDRESS 0 READ_WRITE /end MEASUREMENT
/begin MEASUREMENT Rte_FaultLog_FaultLog.CTCFailData[24].Byte2_Cnt_u08 "MICROSAR RTE" UBYTE NO_COMPU_METHOD 0 0 0 255 ECU_ADDRESS 0 READ_WRITE /end MEASUREMENT
/begin MEASUREMENT Rte_FaultLog_FaultLog.CTCFailData[24].Byte3_Cnt_u08 "MICROSAR RTE" UBYTE NO_COMPU_METHOD 0 0 0 255 ECU_ADDRESS 0 READ_WRITE /end MEASUREMENT
/begin MEASUREMENT Rte_FaultLog_FaultLog.CTCFailData[24].Byte4_Cnt_u08 "MICROSAR RTE" UBYTE NO_COMPU_METHOD 0 0 0 255 ECU_ADDRESS 0 READ_WRITE /end MEASUREMENT
/begin MEASUREMENT Rte_FaultLog_FaultLog.CTCFailData[24].Byte5_Cnt_u08 "MICROSAR RTE" UBYTE NO_COMPU_METHOD 0 0 0 255 ECU_ADDRESS 0 READ_WRITE /end MEASUREMENT
/begin MEASUREMENT Rte_FaultLog_FaultLog.CTCFailData[24].Byte6_Cnt_u08 "MICROSAR RTE" UBYTE NO_COMPU_METHOD 0 0 0 255 ECU_ADDRESS 0 READ_WRITE /end MEASUREMENT
/begin MEASUREMENT Rte_FaultLog_FaultLog.CTCFailData[24].Reserved1_Cnt_u08 "MICROSAR RTE" UBYTE NO_COMPU_METHOD 0 0 0 255 ECU_ADDRESS 0 READ_WRITE /end MEASUREMENT
/begin MEASUREMENT Rte_FaultLog_FaultLog.CTCFailData[24].Reserved2_Cnt_u08 "MICROSAR RTE" UBYTE NO_COMPU_METHOD 0 0 0 255 ECU_ADDRESS 0 READ_WRITE /end MEASUREMENT
/begin MEASUREMENT Rte_FaultLog_FaultLog.CTCFailData[25].Byte1_Cnt_u08 "MICROSAR RTE" UBYTE NO_COMPU_METHOD 0 0 0 255 ECU_ADDRESS 0 READ_WRITE /end MEASUREMENT
/begin MEASUREMENT Rte_FaultLog_FaultLog.CTCFailData[25].Byte2_Cnt_u08 "MICROSAR RTE" UBYTE NO_COMPU_METHOD 0 0 0 255 ECU_ADDRESS 0 READ_WRITE /end MEASUREMENT
/begin MEASUREMENT Rte_FaultLog_FaultLog.CTCFailData[25].Byte3_Cnt_u08 "MICROSAR RTE" UBYTE NO_COMPU_METHOD 0 0 0 255 ECU_ADDRESS 0 READ_WRITE /end MEASUREMENT
/begin MEASUREMENT Rte_FaultLog_FaultLog.CTCFailData[25].Byte4_Cnt_u08 "MICROSAR RTE" UBYTE NO_COMPU_METHOD 0 0 0 255 ECU_ADDRESS 0 READ_WRITE /end MEASUREMENT
/begin MEASUREMENT Rte_FaultLog_FaultLog.CTCFailData[25].Byte5_Cnt_u08 "MICROSAR RTE" UBYTE NO_COMPU_METHOD 0 0 0 255 ECU_ADDRESS 0 READ_WRITE /end MEASUREMENT
/begin MEASUREMENT Rte_FaultLog_FaultLog.CTCFailData[25].Byte6_Cnt_u08 "MICROSAR RTE" UBYTE NO_COMPU_METHOD 0 0 0 255 ECU_ADDRESS 0 READ_WRITE /end MEASUREMENT
/begin MEASUREMENT Rte_FaultLog_FaultLog.CTCFailData[25].Reserved1_Cnt_u08 "MICROSAR RTE" UBYTE NO_COMPU_METHOD 0 0 0 255 ECU_ADDRESS 0 READ_WRITE /end MEASUREMENT
/begin MEASUREMENT Rte_FaultLog_FaultLog.CTCFailData[25].Reserved2_Cnt_u08 "MICROSAR RTE" UBYTE NO_COMPU_METHOD 0 0 0 255 ECU_ADDRESS 0 READ_WRITE /end MEASUREMENT
/begin MEASUREMENT Rte_FaultLog_FaultLog.CTCFailData[26].Byte1_Cnt_u08 "MICROSAR RTE" UBYTE NO_COMPU_METHOD 0 0 0 255 ECU_ADDRESS 0 READ_WRITE /end MEASUREMENT
/begin MEASUREMENT Rte_FaultLog_FaultLog.CTCFailData[26].Byte2_Cnt_u08 "MICROSAR RTE" UBYTE NO_COMPU_METHOD 0 0 0 255 ECU_ADDRESS 0 READ_WRITE /end MEASUREMENT
/begin MEASUREMENT Rte_FaultLog_FaultLog.CTCFailData[26].Byte3_Cnt_u08 "MICROSAR RTE" UBYTE NO_COMPU_METHOD 0 0 0 255 ECU_ADDRESS 0 READ_WRITE /end MEASUREMENT
/begin MEASUREMENT Rte_FaultLog_FaultLog.CTCFailData[26].Byte4_Cnt_u08 "MICROSAR RTE" UBYTE NO_COMPU_METHOD 0 0 0 255 ECU_ADDRESS 0 READ_WRITE /end MEASUREMENT
/begin MEASUREMENT Rte_FaultLog_FaultLog.CTCFailData[26].Byte5_Cnt_u08 "MICROSAR RTE" UBYTE NO_COMPU_METHOD 0 0 0 255 ECU_ADDRESS 0 READ_WRITE /end MEASUREMENT
/begin MEASUREMENT Rte_FaultLog_FaultLog.CTCFailData[26].Byte6_Cnt_u08 "MICROSAR RTE" UBYTE NO_COMPU_METHOD 0 0 0 255 ECU_ADDRESS 0 READ_WRITE /end MEASUREMENT
/begin MEASUREMENT Rte_FaultLog_FaultLog.CTCFailData[26].Reserved1_Cnt_u08 "MICROSAR RTE" UBYTE NO_COMPU_METHOD 0 0 0 255 ECU_ADDRESS 0 READ_WRITE /end MEASUREMENT
/begin MEASUREMENT Rte_FaultLog_FaultLog.CTCFailData[26].Reserved2_Cnt_u08 "MICROSAR RTE" UBYTE NO_COMPU_METHOD 0 0 0 255 ECU_ADDRESS 0 READ_WRITE /end MEASUREMENT
/begin MEASUREMENT Rte_FaultLog_FaultLog.CTCFailData[27].Byte1_Cnt_u08 "MICROSAR RTE" UBYTE NO_COMPU_METHOD 0 0 0 255 ECU_ADDRESS 0 READ_WRITE /end MEASUREMENT
/begin MEASUREMENT Rte_FaultLog_FaultLog.CTCFailData[27].Byte2_Cnt_u08 "MICROSAR RTE" UBYTE NO_COMPU_METHOD 0 0 0 255 ECU_ADDRESS 0 READ_WRITE /end MEASUREMENT
/begin MEASUREMENT Rte_FaultLog_FaultLog.CTCFailData[27].Byte3_Cnt_u08 "MICROSAR RTE" UBYTE NO_COMPU_METHOD 0 0 0 255 ECU_ADDRESS 0 READ_WRITE /end MEASUREMENT
/begin MEASUREMENT Rte_FaultLog_FaultLog.CTCFailData[27].Byte4_Cnt_u08 "MICROSAR RTE" UBYTE NO_COMPU_METHOD 0 0 0 255 ECU_ADDRESS 0 READ_WRITE /end MEASUREMENT
/begin MEASUREMENT Rte_FaultLog_FaultLog.CTCFailData[27].Byte5_Cnt_u08 "MICROSAR RTE" UBYTE NO_COMPU_METHOD 0 0 0 255 ECU_ADDRESS 0 READ_WRITE /end MEASUREMENT
/begin MEASUREMENT Rte_FaultLog_FaultLog.CTCFailData[27].Byte6_Cnt_u08 "MICROSAR RTE" UBYTE NO_COMPU_METHOD 0 0 0 255 ECU_ADDRESS 0 READ_WRITE /end MEASUREMENT
/begin MEASUREMENT Rte_FaultLog_FaultLog.CTCFailData[27].Reserved1_Cnt_u08 "MICROSAR RTE" UBYTE NO_COMPU_METHOD 0 0 0 255 ECU_ADDRESS 0 READ_WRITE /end MEASUREMENT
/begin MEASUREMENT Rte_FaultLog_FaultLog.CTCFailData[27].Reserved2_Cnt_u08 "MICROSAR RTE" UBYTE NO_COMPU_METHOD 0 0 0 255 ECU_ADDRESS 0 READ_WRITE /end MEASUREMENT
/begin MEASUREMENT Rte_FaultLog_FaultLog.CTCFailData[28].Byte1_Cnt_u08 "MICROSAR RTE" UBYTE NO_COMPU_METHOD 0 0 0 255 ECU_ADDRESS 0 READ_WRITE /end MEASUREMENT
/begin MEASUREMENT Rte_FaultLog_FaultLog.CTCFailData[28].Byte2_Cnt_u08 "MICROSAR RTE" UBYTE NO_COMPU_METHOD 0 0 0 255 ECU_ADDRESS 0 READ_WRITE /end MEASUREMENT
/begin MEASUREMENT Rte_FaultLog_FaultLog.CTCFailData[28].Byte3_Cnt_u08 "MICROSAR RTE" UBYTE NO_COMPU_METHOD 0 0 0 255 ECU_ADDRESS 0 READ_WRITE /end MEASUREMENT
/begin MEASUREMENT Rte_FaultLog_FaultLog.CTCFailData[28].Byte4_Cnt_u08 "MICROSAR RTE" UBYTE NO_COMPU_METHOD 0 0 0 255 ECU_ADDRESS 0 READ_WRITE /end MEASUREMENT
/begin MEASUREMENT Rte_FaultLog_FaultLog.CTCFailData[28].Byte5_Cnt_u08 "MICROSAR RTE" UBYTE NO_COMPU_METHOD 0 0 0 255 ECU_ADDRESS 0 READ_WRITE /end MEASUREMENT
/begin MEASUREMENT Rte_FaultLog_FaultLog.CTCFailData[28].Byte6_Cnt_u08 "MICROSAR RTE" UBYTE NO_COMPU_METHOD 0 0 0 255 ECU_ADDRESS 0 READ_WRITE /end MEASUREMENT
/begin MEASUREMENT Rte_FaultLog_FaultLog.CTCFailData[28].Reserved1_Cnt_u08 "MICROSAR RTE" UBYTE NO_COMPU_METHOD 0 0 0 255 ECU_ADDRESS 0 READ_WRITE /end MEASUREMENT
/begin MEASUREMENT Rte_FaultLog_FaultLog.CTCFailData[28].Reserved2_Cnt_u08 "MICROSAR RTE" UBYTE NO_COMPU_METHOD 0 0 0 255 ECU_ADDRESS 0 READ_WRITE /end MEASUREMENT
/begin MEASUREMENT Rte_FaultLog_FaultLog.CTCFailData[29].Byte1_Cnt_u08 "MICROSAR RTE" UBYTE NO_COMPU_METHOD 0 0 0 255 ECU_ADDRESS 0 READ_WRITE /end MEASUREMENT
/begin MEASUREMENT Rte_FaultLog_FaultLog.CTCFailData[29].Byte2_Cnt_u08 "MICROSAR RTE" UBYTE NO_COMPU_METHOD 0 0 0 255 ECU_ADDRESS 0 READ_WRITE /end MEASUREMENT
/begin MEASUREMENT Rte_FaultLog_FaultLog.CTCFailData[29].Byte3_Cnt_u08 "MICROSAR RTE" UBYTE NO_COMPU_METHOD 0 0 0 255 ECU_ADDRESS 0 READ_WRITE /end MEASUREMENT
/begin MEASUREMENT Rte_FaultLog_FaultLog.CTCFailData[29].Byte4_Cnt_u08 "MICROSAR RTE" UBYTE NO_COMPU_METHOD 0 0 0 255 ECU_ADDRESS 0 READ_WRITE /end MEASUREMENT
/begin MEASUREMENT Rte_FaultLog_FaultLog.CTCFailData[29].Byte5_Cnt_u08 "MICROSAR RTE" UBYTE NO_COMPU_METHOD 0 0 0 255 ECU_ADDRESS 0 READ_WRITE /end MEASUREMENT
/begin MEASUREMENT Rte_FaultLog_FaultLog.CTCFailData[29].Byte6_Cnt_u08 "MICROSAR RTE" UBYTE NO_COMPU_METHOD 0 0 0 255 ECU_ADDRESS 0 READ_WRITE /end MEASUREMENT
/begin MEASUREMENT Rte_FaultLog_FaultLog.CTCFailData[29].Reserved1_Cnt_u08 "MICROSAR RTE" UBYTE NO_COMPU_METHOD 0 0 0 255 ECU_ADDRESS 0 READ_WRITE /end MEASUREMENT
/begin MEASUREMENT Rte_FaultLog_FaultLog.CTCFailData[29].Reserved2_Cnt_u08 "MICROSAR RTE" UBYTE NO_COMPU_METHOD 0 0 0 255 ECU_ADDRESS 0 READ_WRITE /end MEASUREMENT
/begin MEASUREMENT Rte_FaultLog_FaultLog.CTCFailData[2].Byte1_Cnt_u08 "MICROSAR RTE" UBYTE NO_COMPU_METHOD 0 0 0 255 ECU_ADDRESS 0 READ_WRITE /end MEASUREMENT
/begin MEASUREMENT Rte_FaultLog_FaultLog.CTCFailData[2].Byte2_Cnt_u08 "MICROSAR RTE" UBYTE NO_COMPU_METHOD 0 0 0 255 ECU_ADDRESS 0 READ_WRITE /end MEASUREMENT
/begin MEASUREMENT Rte_FaultLog_FaultLog.CTCFailData[2].Byte3_Cnt_u08 "MICROSAR RTE" UBYTE NO_COMPU_METHOD 0 0 0 255 ECU_ADDRESS 0 READ_WRITE /end MEASUREMENT
/begin MEASUREMENT Rte_FaultLog_FaultLog.CTCFailData[2].Byte4_Cnt_u08 "MICROSAR RTE" UBYTE NO_COMPU_METHOD 0 0 0 255 ECU_ADDRESS 0 READ_WRITE /end MEASUREMENT
/begin MEASUREMENT Rte_FaultLog_FaultLog.CTCFailData[2].Byte5_Cnt_u08 "MICROSAR RTE" UBYTE NO_COMPU_METHOD 0 0 0 255 ECU_ADDRESS 0 READ_WRITE /end MEASUREMENT
/begin MEASUREMENT Rte_FaultLog_FaultLog.CTCFailData[2].Byte6_Cnt_u08 "MICROSAR RTE" UBYTE NO_COMPU_METHOD 0 0 0 255 ECU_ADDRESS 0 READ_WRITE /end MEASUREMENT
/begin MEASUREMENT Rte_FaultLog_FaultLog.CTCFailData[2].Reserved1_Cnt_u08 "MICROSAR RTE" UBYTE NO_COMPU_METHOD 0 0 0 255 ECU_ADDRESS 0 READ_WRITE /end MEASUREMENT
/begin MEASUREMENT Rte_FaultLog_FaultLog.CTCFailData[2].Reserved2_Cnt_u08 "MICROSAR RTE" UBYTE NO_COMPU_METHOD 0 0 0 255 ECU_ADDRESS 0 READ_WRITE /end MEASUREMENT
/begin MEASUREMENT Rte_FaultLog_FaultLog.CTCFailData[30].Byte1_Cnt_u08 "MICROSAR RTE" UBYTE NO_COMPU_METHOD 0 0 0 255 ECU_ADDRESS 0 READ_WRITE /end MEASUREMENT
/begin MEASUREMENT Rte_FaultLog_FaultLog.CTCFailData[30].Byte2_Cnt_u08 "MICROSAR RTE" UBYTE NO_COMPU_METHOD 0 0 0 255 ECU_ADDRESS 0 READ_WRITE /end MEASUREMENT
/begin MEASUREMENT Rte_FaultLog_FaultLog.CTCFailData[30].Byte3_Cnt_u08 "MICROSAR RTE" UBYTE NO_COMPU_METHOD 0 0 0 255 ECU_ADDRESS 0 READ_WRITE /end MEASUREMENT
/begin MEASUREMENT Rte_FaultLog_FaultLog.CTCFailData[30].Byte4_Cnt_u08 "MICROSAR RTE" UBYTE NO_COMPU_METHOD 0 0 0 255 ECU_ADDRESS 0 READ_WRITE /end MEASUREMENT
/begin MEASUREMENT Rte_FaultLog_FaultLog.CTCFailData[30].Byte5_Cnt_u08 "MICROSAR RTE" UBYTE NO_COMPU_METHOD 0 0 0 255 ECU_ADDRESS 0 READ_WRITE /end MEASUREMENT
/begin MEASUREMENT Rte_FaultLog_FaultLog.CTCFailData[30].Byte6_Cnt_u08 "MICROSAR RTE" UBYTE NO_COMPU_METHOD 0 0 0 255 ECU_ADDRESS 0 READ_WRITE /end MEASUREMENT
/begin MEASUREMENT Rte_FaultLog_FaultLog.CTCFailData[30].Reserved1_Cnt_u08 "MICROSAR RTE" UBYTE NO_COMPU_METHOD 0 0 0 255 ECU_ADDRESS 0 READ_WRITE /end MEASUREMENT
/begin MEASUREMENT Rte_FaultLog_FaultLog.CTCFailData[30].Reserved2_Cnt_u08 "MICROSAR RTE" UBYTE NO_COMPU_METHOD 0 0 0 255 ECU_ADDRESS 0 READ_WRITE /end MEASUREMENT
/begin MEASUREMENT Rte_FaultLog_FaultLog.CTCFailData[31].Byte1_Cnt_u08 "MICROSAR RTE" UBYTE NO_COMPU_METHOD 0 0 0 255 ECU_ADDRESS 0 READ_WRITE /end MEASUREMENT
/begin MEASUREMENT Rte_FaultLog_FaultLog.CTCFailData[31].Byte2_Cnt_u08 "MICROSAR RTE" UBYTE NO_COMPU_METHOD 0 0 0 255 ECU_ADDRESS 0 READ_WRITE /end MEASUREMENT
/begin MEASUREMENT Rte_FaultLog_FaultLog.CTCFailData[31].Byte3_Cnt_u08 "MICROSAR RTE" UBYTE NO_COMPU_METHOD 0 0 0 255 ECU_ADDRESS 0 READ_WRITE /end MEASUREMENT
/begin MEASUREMENT Rte_FaultLog_FaultLog.CTCFailData[31].Byte4_Cnt_u08 "MICROSAR RTE" UBYTE NO_COMPU_METHOD 0 0 0 255 ECU_ADDRESS 0 READ_WRITE /end MEASUREMENT
/begin MEASUREMENT Rte_FaultLog_FaultLog.CTCFailData[31].Byte5_Cnt_u08 "MICROSAR RTE" UBYTE NO_COMPU_METHOD 0 0 0 255 ECU_ADDRESS 0 READ_WRITE /end MEASUREMENT
/begin MEASUREMENT Rte_FaultLog_FaultLog.CTCFailData[31].Byte6_Cnt_u08 "MICROSAR RTE" UBYTE NO_COMPU_METHOD 0 0 0 255 ECU_ADDRESS 0 READ_WRITE /end MEASUREMENT
/begin MEASUREMENT Rte_FaultLog_FaultLog.CTCFailData[31].Reserved1_Cnt_u08 "MICROSAR RTE" UBYTE NO_COMPU_METHOD 0 0 0 255 ECU_ADDRESS 0 READ_WRITE /end MEASUREMENT
/begin MEASUREMENT Rte_FaultLog_FaultLog.CTCFailData[31].Reserved2_Cnt_u08 "MICROSAR RTE" UBYTE NO_COMPU_METHOD 0 0 0 255 ECU_ADDRESS 0 READ_WRITE /end MEASUREMENT
/begin MEASUREMENT Rte_FaultLog_FaultLog.CTCFailData[32].Byte1_Cnt_u08 "MICROSAR RTE" UBYTE NO_COMPU_METHOD 0 0 0 255 ECU_ADDRESS 0 READ_WRITE /end MEASUREMENT
/begin MEASUREMENT Rte_ModeMachine_StaMd11_SystemState11_Mode "MICROSAR RTE" UBYTE RTE_CM_ENUM_StaMd_Mode 0 0 0 255 ECU_ADDRESS 0 /end MEASUREMENT
/begin MEASUREMENT Rte_ModeMachine_StaMd6_SystemState6_Mode "MICROSAR RTE" UBYTE RTE_CM_ENUM_StaMd_Mode 0 0 0 255 ECU_ADDRESS 0 /end MEASUREMENT
/begin GROUP CDDInterface9.ExpectedOnTimeC.Cnt_u32 "MICROSAR RTE" /begin SUB_GROUP /end SUB_GROUP /begin FUNCTION_LIST /end FUNCTION_LIST /begin REF_CHARACTERISTIC /end REF_CHARACTERISTIC /begin REF_MEASUREMENT Rte_CDDInterface9_ExpectedOnTimeC_Cnt_u32 /end REF_MEASUREMENT /end GROUP
/begin GROUP CDDInterface9.IgnCnt.Cnt_u16 "MICROSAR RTE" /begin SUB_GROUP /end SUB_GROUP /begin FUNCTION_LIST /end FUNCTION_LIST /begin REF_CHARACTERISTIC /end REF_CHARACTERISTIC /begin REF_MEASUREMENT Rte_CDDInterface9_IgnCnt_Cnt_u16 /end REF_MEASUREMENT /end GROUP
/begin GROUP CDDInterface9.LRPRPhaseadvanceCaptured.Cnt_s16 "MICROSAR RTE" /begin SUB_GROUP /end SUB_GROUP /begin FUNCTION_LIST /end FUNCTION_LIST /begin REF_CHARACTERISTIC /end REF_CHARACTERISTIC /begin REF_MEASUREMENT Rte_CDDInterface9_LRPRPhaseadvanceCaptured_Cnt_s16 /end REF_MEASUREMENT /end GROUP
/begin GROUP CDDInterface9.MEC.Cnt_enum "MICROSAR RTE" /begin SUB_GROUP /end SUB_GROUP /begin FUNCTION_LIST /end FUNCTION_LIST /begin REF_CHARACTERISTIC /end REF_CHARACTERISTIC /end GROUP
/begin GROUP CDDInterface9.MECTemp.Cnt_u08 "MICROSAR RTE" /begin SUB_GROUP /end SUB_GROUP /begin FUNCTION_LIST /end FUNCTION_LIST /begin REF_CHARACTERISTIC /end REF_CHARACTERISTIC /begin REF_MEASUREMENT Rte_CDDInterface9_MECTemp_Cnt_u08 /end REF_MEASUREMENT /end GROUP
/begin GROUP CDDInterface9.MechMtrPos1.Rev_f32 "MICROSAR RTE" /begin SUB_GROUP /end SUB_GROUP /begin FUNCTION_LIST /end FUNCTION_LIST /begin REF_CHARACTERISTIC /end REF_CHARACTERISTIC /begin REF_MEASUREMENT Rte_CDDInterface9_MechMtrPos1_Rev_f32 /end REF_MEASUREMENT /end GROUP
/begin GROUP CDDInterface9.MechMtrPos1Timestamp.USec_u32 "MICROSAR RTE" /begin SUB_GROUP /end SUB_GROUP /begin FUNCTION_LIST /end FUNCTION_LIST /begin REF_CHARACTERISTIC /end REF_CHARACTERISTIC /begin REF_MEASUREMENT Rte_CDDInterface9_MechMtrPos1Timestamp_USec_u32 /end REF_MEASUREMENT /end GROUP
/begin GROUP CDDInterface9.MechMtrPos2Timestamp.USec_u32 "MICROSAR RTE" /begin SUB_GROUP /end SUB_GROUP /begin FUNCTION_LIST /end FUNCTION_LIST /begin REF_CHARACTERISTIC /end REF_CHARACTERISTIC /begin REF_MEASUREMENT Rte_CDDInterface9_MechMtrPos2Timestamp_USec_u32 /end REF_MEASUREMENT /end GROUP
/begin GROUP CDDInterface9.ModIdxFinal.Uls_f32 "MICROSAR RTE" /begin SUB_GROUP /end SUB_GROUP /begin FUNCTION_LIST /end FUNCTION_LIST /begin REF_CHARACTERISTIC /end REF_CHARACTERISTIC /begin REF_MEASUREMENT Rte_CDDInterface9_ModIdxFinal_Uls_f32 /end REF_MEASUREMENT /end GROUP
/begin GROUP CDDInterface9.MtrCurrDax.Amp_f32 "MICROSAR RTE" /begin SUB_GROUP /end SUB_GROUP /begin FUNCTION_LIST /end FUNCTION_LIST /begin REF_CHARACTERISTIC /end REF_CHARACTERISTIC /begin REF_MEASUREMENT Rte_CDDInterface9_MtrCurrDax_Amp_f32 /end REF_MEASUREMENT /end GROUP
/begin GROUP CDDInterface9.MtrCurrK1.Amp_f32 "MICROSAR RTE" /begin SUB_GROUP /end SUB_GROUP /begin FUNCTION_LIST /end FUNCTION_LIST /begin REF_CHARACTERISTIC /end REF_CHARACTERISTIC /begin REF_MEASUREMENT Rte_CDDInterface9_MtrCurrK1_Amp_f32 /end REF_MEASUREMENT /end GROUP
/begin GROUP CDDInterface9.MtrCurrK2.Amp_f32 "MICROSAR RTE" /begin SUB_GROUP /end SUB_GROUP /begin FUNCTION_LIST /end FUNCTION_LIST /begin REF_CHARACTERISTIC /end REF_CHARACTERISTIC /begin REF_MEASUREMENT Rte_CDDInterface9_MtrCurrK2_Amp_f32 /end REF_MEASUREMENT /end GROUP
/begin GROUP CDDInterface9.MtrCurrQax.Amp_f32 "MICROSAR RTE" /begin SUB_GROUP /end SUB_GROUP /begin FUNCTION_LIST /end FUNCTION_LIST /begin REF_CHARACTERISTIC /end REF_CHARACTERISTIC /begin REF_MEASUREMENT Rte_CDDInterface9_MtrCurrQax_Amp_f32 /end REF_MEASUREMENT /end GROUP
/begin GROUP CDDInterface9.MtrCurrQaxFinalRef.Amp_f32 "MICROSAR RTE" /begin SUB_GROUP /end SUB_GROUP /begin FUNCTION_LIST /end FUNCTION_LIST /begin REF_CHARACTERISTIC /end REF_CHARACTERISTIC /begin REF_MEASUREMENT Rte_CDDInterface9_MtrCurrQaxFinalRef_Amp_f32 /end REF_MEASUREMENT /end GROUP
/begin GROUP CDDInterface9.MtrVoltDax.Volt_f32 "MICROSAR RTE" /begin SUB_GROUP /end SUB_GROUP /begin FUNCTION_LIST /end FUNCTION_LIST /begin REF_CHARACTERISTIC /end REF_CHARACTERISTIC /begin REF_MEASUREMENT Rte_CDDInterface9_MtrVoltDax_Volt_f32 /end REF_MEASUREMENT /end GROUP
/begin GROUP CDDInterface9.MtrVoltQax.Volt_f32 "MICROSAR RTE" /begin SUB_GROUP /end SUB_GROUP /begin FUNCTION_LIST /end FUNCTION_LIST /begin REF_CHARACTERISTIC /end REF_CHARACTERISTIC /begin REF_MEASUREMENT Rte_CDDInterface9_MtrVoltQax_Volt_f32 /end REF_MEASUREMENT /end GROUP
/begin GROUP CDDInterface9.RxMtrPosParityAccum.Cnt_u16 "MICROSAR RTE" /begin SUB_GROUP /end SUB_GROUP /begin FUNCTION_LIST /end FUNCTION_LIST /begin REF_CHARACTERISTIC /end REF_CHARACTERISTIC /begin REF_MEASUREMENT Rte_CDDInterface9_RxMtrPosParityAccum_Cnt_u16 /end REF_MEASUREMENT /end GROUP
/begin GROUP CDDInterface9.SenderPorts "MICROSAR RTE"
 /begin SUB_GROUP CDDInterface9.ADCMtrCurr1.Volts_f32 CDDInterface9.ADCMtrCurr2.Volts_f32 CDDInterface9.CorrMtrCurrPosition.Rev_f32 CDDInterface9.CorrMtrPosElec.Rev_f32 CDDInterface9.CorrectedElecMtrPos.Rev_u0p16 CDDInterface9.CumMechMtrPos.Rev_f32 CDDInterface9.Die1RxError.Cnt_u16 CDDInterface9.Die1RxMtrPos.Cnt_u16 CDDInterface9.Die1RxRevCtr.Cnt_u16 CDDInterface9.Die1UnderVoltgFltAccum.Cnt_u16 CDDInterface9.Die2RxError.Cnt_u16 CDDInterface9.Die2RxMtrPos.Cnt_u16 CDDInterface9.Die2RxRevCtr.Cnt_u16 CDDInterface9.ExpectedOnTimeA.Cnt_u32 CDDInterface9.ExpectedOnTimeB.Cnt_u32 CDDInterface9.ExpectedOnTimeC.Cnt_u32 CDDInterface9.IgnCnt.Cnt_u16 CDDInterface9.LRPRPhaseadvanceCaptured.Cnt_s16 CDDInterface9.MEC.Cnt_enum CDDInterface9.MECTemp.Cnt_u08 CDDInterface9.MechMtrPos1.Rev_f32 CDDInterface9.MechMtrPos1Timestamp.USec_u32 CDDInterface9.MechMtrPos2Timestamp.USec_u32 CDDInterface9.ModIdxFinal.Uls_f32 CDDInterface9.MtrCurrDax.Amp_f32 CDDInterface9.MtrCurrK1.Amp_f32 CDDInterface9.MtrCurrK2.Amp_f32 CDDInterface9.MtrCurrQax.Amp_f32 CDDInterface9.MtrCurrQaxFinalRef.Amp_f32 CDDInterface9.MtrVoltDax.Volt_f32 CDDInterface9.MtrVoltQax.Volt_f32 CDDInterface9.RxMtrPosParityAccum.Cnt_u16 CDDInterface9.SysCCorrMtrPosElec.Rev_f32 CDDInterface9.SysCVSwitchADC.Cnt_u16 CDDInterface9.UncorrMechMtrPos1.Rev_u0p16 /end SUB_GROUP
 /begin FUNCTION_LIST /end FUNCTION_LIST
 /begin REF_CHARACTERISTIC /end REF_CHARACTERISTIC
 /begin REF_MEASUREMENT /end REF_MEASUREMENT
/end GROUP
/begin GROUP CDDInterface9.SysCCorrMtrPosElec.Rev_f32 "MICROSAR RTE" /begin SUB_GROUP /end SUB_GROUP /begin FUNCTION_LIST /end FUNCTION_LIST /begin REF_CHARACTERISTIC /end REF_CHARACTERISTIC /begin REF_MEASUREMENT Rte_CDDInterface9_SysCCorrMtrPosElec_Rev_f32 /end REF_MEASUREMENT /end GROUP
/begin GROUP CDDInterface9.SysCVSwitchADC.Cnt_u16 "MICROSAR RTE" /begin SUB_GROUP /end SUB_GROUP /begin FUNCTION_LIST /end FUNCTION_LIST /begin REF_CHARACTERISTIC /end REF_CHARACTERISTIC /begin REF_MEASUREMENT Rte_CDDInterface9_SysCVSwitchADC_Cnt_u16 /end REF_MEASUREMENT /end GROUP
/begin GROUP CDDInterface9.UncorrMechMtrPos1.Rev_u0p16 "MICROSAR RTE" /begin SUB_GROUP /end SUB_GROUP /begin FUNCTION_LIST /end FUNCTION_LIST /begin REF_CHARACTERISTIC /end REF_CHARACTERISTIC /begin REF_MEASUREMENT Rte_CDDInterface9_UncorrMechMtrPos1_Rev_u0p16 /end REF_MEASUREMENT /end GROUP
/begin GROUP CmMtrCurr "MICROSAR RTE"
 /begin SUB_GROUP CmMtrCurr.ModeRequirePorts CmMtrCurr.PerInstanceMemories CmMtrCurr.ReceiverPorts CmMtrCurr.SenderPorts /end SUB_GROUP
 /begin FUNCTION_LIST /end FUNCTION_LIST
 /begin REF_CHARACTERISTIC /end REF_CHARACTERISTIC
 /begin REF_MEASUREMENT /end REF_MEASUREMENT
/end GROUP
/begin GROUP CmMtrCurr.ADCMtrCurr1.Volts_f32 "MICROSAR RTE" /begin SUB_GROUP /end SUB_GROUP /begin FUNCTION_LIST /end FUNCTION_LIST /begin REF_CHARACTERISTIC /end REF_CHARACTERISTIC /end GROUP
/begin GROUP CmMtrCurr.ADCMtrCurr2.Volts_f32 "MICROSAR RTE" /begin SUB_GROUP /end SUB_GROUP /begin FUNCTION_LIST /end FUNCTION_LIST /begin REF_CHARACTERISTIC /end REF_CHARACTERISTIC /end GROUP
/begin GROUP CmMtrCurr.ComOffset.Cnt_u16 "MICROSAR RTE" /begin SUB_GROUP /end SUB_GROUP /begin FUNCTION_LIST /end FUNCTION_LIST /begin REF_CHARACTERISTIC /end REF_CHARACTERISTIC /end GROUP
/begin GROUP CmMtrCurr.CorrMtrCurrPosition.Rev_f32 "MICROSAR RTE" /begin SUB_GROUP /end SUB_GROUP /begin FUNCTION_LIST /end FUNCTION_LIST /begin REF_CHARACTERISTIC /end REF_CHARACTERISTIC /end GROUP
/begin GROUP CmMtrCurr.CurrTempOffset "MICROSAR RTE" /begin SUB_GROUP /end SUB_GROUP /begin FUNCTION_LIST /end FUNCTION_LIST /begin REF_CHARACTERISTIC /end REF_CHARACTERISTIC
 /begin REF_MEASUREMENT Rte_CmMtrCurr_CurrTempOffset.CurrOffsetY1_Volts_s4p11 Rte_CmMtrCurr_CurrTempOffset.CurrOffsetY2_Volts_s4p11 Rte_CmMtrCurr_CurrTempOffset.CurrTempOffsetX_DegC_s10p5 /end REF_MEASUREMENT
/end GROUP
/begin GROUP CmMtrCurr.CurrentGainSvc.Cnt_lgc "MICROSAR RTE" /begin SUB_GROUP /end SUB_GROUP /begin FUNCTION_LIST /end FUNCTION_LIST /begin REF_CHARACTERISTIC /end REF_CHARACTERISTIC /begin REF_MEASUREMENT Rte_CmMtrCurr_CurrentGainSvc_Cnt_lgc /end REF_MEASUREMENT /end GROUP
/begin GROUP CmMtrCurr.FiltCntrlTemp.DegC_f32 "MICROSAR RTE" /begin SUB_GROUP /end SUB_GROUP /begin FUNCTION_LIST /end FUNCTION_LIST /begin REF_CHARACTERISTIC /end REF_CHARACTERISTIC /begin REF_MEASUREMENT Rte_CtrlTemp_FiltMeasTemp_DegC_f32 /end REF_MEASUREMENT /end GROUP
/begin GROUP CmMtrCurr.MEC.Cnt_enum "MICROSAR RTE" /begin SUB_GROUP /end SUB_GROUP /begin FUNCTION_LIST /end FUNCTION_LIST /begin REF_CHARACTERISTIC /end REF_CHARACTERISTIC /end GROUP
/begin GROUP CmMtrCurr.ModeRequirePorts "MICROSAR RTE" /begin SUB_GROUP CmMtrCurr.SystemState.Mode /end SUB_GROUP /begin FUNCTION_LIST /end FUNCTION_LIST /begin REF_CHARACTERISTIC /end REF_CHARACTERISTIC /begin REF_MEASUREMENT /end REF_MEASUREMENT /end GROUP
/begin GROUP CmMtrCurr.MtrCurr1TempOffset.Volt_f32 "MICROSAR RTE" /begin SUB_GROUP /end SUB_GROUP /begin FUNCTION_LIST /end FUNCTION_LIST /begin REF_CHARACTERISTIC /end REF_CHARACTERISTIC /end GROUP
/begin GROUP CmMtrCurr.MtrCurr2TempOffset.Volt_f32 "MICROSAR RTE" /begin SUB_GROUP /end SUB_GROUP /begin FUNCTION_LIST /end FUNCTION_LIST /begin REF_CHARACTERISTIC /end REF_CHARACTERISTIC /end GROUP
/begin GROUP CmMtrCurr.MtrCurrAngle.Rev_f32 "MICROSAR RTE" /begin SUB_GROUP /end SUB_GROUP /begin FUNCTION_LIST /end FUNCTION_LIST /begin REF_CHARACTERISTIC /end REF_CHARACTERISTIC /begin REF_MEASUREMENT Rte_CurrCmd_MtrCurrAngle_Rev_f32 /end REF_MEASUREMENT /end GROUP
/begin GROUP CmMtrCurr.MtrCurrK1.Amp_f32 "MICROSAR RTE" /begin SUB_GROUP /end SUB_GROUP /begin FUNCTION_LIST /end FUNCTION_LIST /begin REF_CHARACTERISTIC /end REF_CHARACTERISTIC /begin REF_MEASUREMENT Rte_CDDInterface9_MtrCurrK1_Amp_f32 /end REF_MEASUREMENT /end GROUP
/begin GROUP CmMtrCurr.MtrCurrK2.Amp_f32 "MICROSAR RTE" /begin SUB_GROUP /end SUB_GROUP /begin FUNCTION_LIST /end FUNCTION_LIST /begin REF_CHARACTERISTIC /end REF_CHARACTERISTIC /begin REF_MEASUREMENT Rte_CDDInterface9_MtrCurrK2_Amp_f32 /end REF_MEASUREMENT /end GROUP
/begin GROUP CmMtrCurr.MtrVel.MtrRadpS_f32 "MICROSAR RTE" /begin SUB_GROUP /end SUB_GROUP /begin FUNCTION_LIST /end FUNCTION_LIST /begin REF_CHARACTERISTIC /end REF_CHARACTERISTIC /end GROUP
/begin GROUP CmMtrCurr.PerInstanceMemories "MICROSAR RTE" /begin SUB_GROUP CmMtrCurr.CurrTempOffset CmMtrCurr.ShCurrCal /end SUB_GROUP /begin FUNCTION_LIST /end FUNCTION_LIST /begin REF_CHARACTERISTIC /end REF_CHARACTERISTIC /begin REF_MEASUREMENT /end REF_MEASUREMENT /end GROUP
/begin GROUP CmMtrCurr.ReceiverPorts "MICROSAR RTE"
 /begin SUB_GROUP CmMtrCurr.ADCMtrCurr1.Volts_f32 CmMtrCurr.ADCMtrCurr2.Volts_f32 CmMtrCurr.CorrMtrCurrPosition.Rev_f32 CmMtrCurr.FiltCntrlTemp.DegC_f32 CmMtrCurr.MEC.Cnt_enum CmMtrCurr.MtrCurrAngle.Rev_f32 CmMtrCurr.MtrCurrK1.Amp_f32 CmMtrCurr.MtrCurrK2.Amp_f32 CmMtrCurr.MtrVel.MtrRadpS_f32 CmMtrCurr.SrlComSvcDft.Cnt_b32 CmMtrCurr.Vecu.Volt_f32 CmMtrCurr.VehSpd.Kph_f32 CmMtrCurr.VhSpdValid.Cnt_lgc /end SUB_GROUP
 /begin FUNCTION_LIST /end FUNCTION_LIST
 /begin REF_CHARACTERISTIC /end REF_CHARACTERISTIC
 /begin REF_MEASUREMENT /end REF_MEASUREMENT
/end GROUP
/begin GROUP CmMtrCurr.SenderPorts "MICROSAR RTE"
 /begin SUB_GROUP CmMtrCurr.ComOffset.Cnt_u16 CmMtrCurr.CurrentGainSvc.Cnt_lgc CmMtrCurr.MtrCurr1TempOffset.Volt_f32 CmMtrCurr.MtrCurr2TempOffset.Volt_f32 /end SUB_GROUP
 /begin FUNCTION_LIST /end FUNCTION_LIST
 /begin REF_CHARACTERISTIC /end REF_CHARACTERISTIC
 /begin REF_MEASUREMENT /end REF_MEASUREMENT
/end GROUP
/begin GROUP CmMtrCurr.ShCurrCal "MICROSAR RTE" /begin SUB_GROUP /end SUB_GROUP /begin FUNCTION_LIST /end FUNCTION_LIST /begin REF_CHARACTERISTIC /end REF_CHARACTERISTIC
 /begin REF_MEASUREMENT Rte_CmMtrCurr_ShCurrCal.EOLMtrCurr1OffsetDiff_Volts_f32 Rte_CmMtrCurr_ShCurrCal.EOLMtrCurr1OffsetLo_Volts_f32 Rte_CmMtrCurr_ShCurrCal.EOLMtrCurr2OffsetDiff_Volts_f32 Rte_CmMtrCurr_ShCurrCal.EOLMtrCurr2OffsetLo_Volts_f32 Rte_CmMtrCurr_ShCurrCal.EOLMtrCurrVcalCmd_VoltCnts_f32 Rte_CmMtrCurr_ShCurrCal.EOLPhscurr1Gain_AmpspVolt_f32 Rte_CmMtrCurr_ShCurrCal.EOLPhscurr2Gain_AmpspVolt_f32 /end REF_MEASUREMENT
/end GROUP
/begin GROUP CmMtrCurr.SrlComSvcDft.Cnt_b32 "MICROSAR RTE" /begin SUB_GROUP /end SUB_GROUP /begin FUNCTION_LIST /end FUNCTION_LIST /begin REF_CHARACTERISTIC /end REF_CHARACTERISTIC /end GROUP
/begin GROUP CmMtrCurr.SystemState.Mode "MICROSAR RTE" /begin SUB_GROUP /end SUB_GROUP /begin FUNCTION_LIST /end FUNCTION_LIST /begin REF_CHARACTERISTIC /end REF_CHARACTERISTIC /begin REF_MEASUREMENT Rte_ModeMachine_StaMd11_SystemState11_Mode /end REF_MEASUREMENT /end GROUP
/begin GROUP CmMtrCurr.Vecu.Volt_f32 "MICROSAR RTE" /begin SUB_GROUP /end SUB_GROUP /begin FUNCTION_LIST /end FUNCTION_LIST /begin REF_CHARACTERISTIC /end REF_CHARACTERISTIC /end GROUP
/begin GROUP CmMtrCurr.VehSpd.Kph_f32 "MICROSAR RTE" /begin SUB_GROUP /end SUB_GROUP /begin FUNCTION_LIST /end FUNCTION_LIST /begin REF_CHARACTERISTIC /end REF_CHARACTERISTIC /end GROUP
/begin GROUP CmMtrCurr.VhSpdValid.Cnt_lgc "MICROSAR RTE" /begin SUB_GROUP /end SUB_GROUP /begin FUNCTION_LIST /end FUNCTION_LIST /begin REF_CHARACTERISTIC /end REF_CHARACTERISTIC /end GROUP
/begin GROUP ComplErr "MICROSAR RTE" /begin SUB_GROUP ComplErr.ReceiverPorts ComplErr.SenderPorts /end SUB_GROUP /begin FUNCTION_LIST /end FUNCTION_LIST /begin REF_CHARACTERISTIC /end REF_CHARACTERISTIC /begin REF_MEASUREMENT /end REF_MEASUREMENT /end GROUP
/begin GROUP ComplErr.ComplErr.HwDeg_f32 "MICROSAR RTE" /begin SUB_GROUP /end SUB_GROUP /begin FUNCTION_LIST /end FUNCTION_LIST /begin REF_CHARACTERISTIC /end REF_CHARACTERISTIC /end GROUP
/begin GROUP ComplErr.ReceiverPorts "MICROSAR RTE" /begin SUB_GROUP ComplErr.TorqueCmdCRF.MtrNm_f32 /end SUB_GROUP /begin FUNCTION_LIST /end FUNCTION_LIST /begin REF_CHARACTERISTIC /end REF_CHARACTERISTIC /begin REF_MEASUREMENT /end REF_MEASUREMENT /end GROUP
/begin GROUP ComplErr.SenderPorts "MICROSAR RTE" /begin SUB_GROUP ComplErr.ComplErr.HwDeg_f32 /end SUB_GROUP /begin FUNCTION_LIST /end FUNCTION_LIST /begin REF_CHARACTERISTIC /end REF_CHARACTERISTIC /begin REF_MEASUREMENT /end REF_MEASUREMENT /end GROUP
/begin GROUP ComplErr.TorqueCmdCRF.MtrNm_f32 "MICROSAR RTE" /begin SUB_GROUP /end SUB_GROUP /begin FUNCTION_LIST /end FUNCTION_LIST /begin REF_CHARACTERISTIC /end REF_CHARACTERISTIC /end GROUP
/begin GROUP CtrlTemp "MICROSAR RTE" /begin SUB_GROUP CtrlTemp.ReceiverPorts CtrlTemp.SenderPorts /end SUB_GROUP /begin FUNCTION_LIST /end FUNCTION_LIST /begin REF_CHARACTERISTIC /end REF_CHARACTERISTIC /begin REF_MEASUREMENT /end REF_MEASUREMENT /end GROUP
/begin GROUP CtrlTemp.AmbTemp.DegC_f32 "MICROSAR RTE" /begin SUB_GROUP /end SUB_GROUP /begin FUNCTION_LIST /end FUNCTION_LIST /begin REF_CHARACTERISTIC /end REF_CHARACTERISTIC /begin REF_MEASUREMENT Rte_CtrlTemp_AmbTemp_DegC_f32 /end REF_MEASUREMENT /end GROUP
/begin GROUP CtrlTemp.DiagStsTempRdPrf.Cnt_lgc "MICROSAR RTE" /begin SUB_GROUP /end SUB_GROUP /begin FUNCTION_LIST /end FUNCTION_LIST /begin REF_CHARACTERISTIC /end REF_CHARACTERISTIC /begin REF_MEASUREMENT Rte_DiagMgr10_DiagStsDefTemp_Cnt_lgc /end REF_MEASUREMENT /end GROUP
/begin GROUP CtrlTemp.FiltMeasTemp.DegC_f32 "MICROSAR RTE" /begin SUB_GROUP /end SUB_GROUP /begin FUNCTION_LIST /end FUNCTION_LIST /begin REF_CHARACTERISTIC /end REF_CHARACTERISTIC /begin REF_MEASUREMENT Rte_CtrlTemp_FiltMeasTemp_DegC_f32 /end REF_MEASUREMENT /end GROUP
/begin GROUP CtrlTemp.ReceiverPorts "MICROSAR RTE"
 /begin SUB_GROUP CtrlTemp.AmbTemp.DegC_f32 CtrlTemp.DiagStsTempRdPrf.Cnt_lgc CtrlTemp.TemperatureADC.Volt_f32 /end SUB_GROUP
 /begin FUNCTION_LIST /end FUNCTION_LIST
 /begin REF_CHARACTERISTIC /end REF_CHARACTERISTIC
 /begin REF_MEASUREMENT /end REF_MEASUREMENT
/end GROUP
/begin GROUP CtrlTemp.SenderPorts "MICROSAR RTE" /begin SUB_GROUP CtrlTemp.FiltMeasTemp.DegC_f32 /end SUB_GROUP /begin FUNCTION_LIST /end FUNCTION_LIST /begin REF_CHARACTERISTIC /end REF_CHARACTERISTIC /begin REF_MEASUREMENT /end REF_MEASUREMENT /end GROUP
/begin GROUP CtrlTemp.TemperatureADC.Volt_f32 "MICROSAR RTE" /begin SUB_GROUP /end SUB_GROUP /begin FUNCTION_LIST /end FUNCTION_LIST /begin REF_CHARACTERISTIC /end REF_CHARACTERISTIC /begin REF_MEASUREMENT Rte_IoHwAb10_TemperatureADC_Volt_f32 /end REF_MEASUREMENT /end GROUP
/begin GROUP CurrCmd "MICROSAR RTE" /begin SUB_GROUP CurrCmd.ReceiverPorts CurrCmd.SenderPorts /end SUB_GROUP /begin FUNCTION_LIST /end FUNCTION_LIST /begin REF_CHARACTERISTIC /end REF_CHARACTERISTIC /begin REF_MEASUREMENT /end REF_MEASUREMENT /end GROUP
/begin GROUP CurrCmd.CurrentGainSvc.Cnt_lgc "MICROSAR RTE" /begin SUB_GROUP /end SUB_GROUP /begin FUNCTION_LIST /end FUNCTION_LIST /begin REF_CHARACTERISTIC /end REF_CHARACTERISTIC /begin REF_MEASUREMENT Rte_CmMtrCurr_CurrentGainSvc_Cnt_lgc /end REF_MEASUREMENT /end GROUP
/begin GROUP CurrCmd.DualEcuMotCtrlMtgnEna.Cnt_lgc "MICROSAR RTE" /begin SUB_GROUP /end SUB_GROUP /begin FUNCTION_LIST /end FUNCTION_LIST /begin REF_CHARACTERISTIC /end REF_CHARACTERISTIC /begin REF_MEASUREMENT Rte_CurrCmd_DualEcuMotCtrlMtgnEna_Cnt_lgc /end REF_MEASUREMENT /end GROUP
/begin GROUP CurrCmd.EstKe.VpRadpS_f32 "MICROSAR RTE" /begin SUB_GROUP /end SUB_GROUP /begin FUNCTION_LIST /end FUNCTION_LIST /begin REF_CHARACTERISTIC /end REF_CHARACTERISTIC /begin REF_MEASUREMENT Rte_CurrParamComp_EstKe_VpRadpS_f32 /end REF_MEASUREMENT /end GROUP
/begin GROUP CurrCmd.EstLd.Henry_f32 "MICROSAR RTE" /begin SUB_GROUP /end SUB_GROUP /begin FUNCTION_LIST /end FUNCTION_LIST /begin REF_CHARACTERISTIC /end REF_CHARACTERISTIC /begin REF_MEASUREMENT Rte_CurrParamComp_EstLd_Henry_f32 /end REF_MEASUREMENT /end GROUP
/begin GROUP CurrCmd.EstLq.Henry_f32 "MICROSAR RTE" /begin SUB_GROUP /end SUB_GROUP /begin FUNCTION_LIST /end FUNCTION_LIST /begin REF_CHARACTERISTIC /end REF_CHARACTERISTIC /begin REF_MEASUREMENT Rte_CurrParamComp_EstLq_Henry_f32 /end REF_MEASUREMENT /end GROUP
/begin GROUP CurrCmd.EstR.Ohm_f32 "MICROSAR RTE" /begin SUB_GROUP /end SUB_GROUP /begin FUNCTION_LIST /end FUNCTION_LIST /begin REF_CHARACTERISTIC /end REF_CHARACTERISTIC /begin REF_MEASUREMENT Rte_CurrParamComp_EstR_Ohm_f32 /end REF_MEASUREMENT /end GROUP
/begin GROUP CurrCmd.IvtrLoaMtgtnEn.Cnt_lgc "MICROSAR RTE" /begin SUB_GROUP /end SUB_GROUP /begin FUNCTION_LIST /end FUNCTION_LIST /begin REF_CHARACTERISTIC /end REF_CHARACTERISTIC /end GROUP
/begin GROUP CurrCmd.MRFMtrVel.MtrRadpS_f32 "MICROSAR RTE" /begin SUB_GROUP /end SUB_GROUP /begin FUNCTION_LIST /end FUNCTION_LIST /begin REF_CHARACTERISTIC /end REF_CHARACTERISTIC /end GROUP
/begin GROUP CurrCmd.MRFTrqCmdScl.MtrNm_f32 "MICROSAR RTE" /begin SUB_GROUP /end SUB_GROUP /begin FUNCTION_LIST /end FUNCTION_LIST /begin REF_CHARACTERISTIC /end REF_CHARACTERISTIC /begin REF_MEASUREMENT Rte_TrqCmdScl_MRFMtrTrqCmdScl_MtrNm_f32 /end REF_MEASUREMENT /end GROUP
/begin GROUP CurrCmd.MotCurrLoaMtgtnEn.Cnt_lgc "MICROSAR RTE" /begin SUB_GROUP /end SUB_GROUP /begin FUNCTION_LIST /end FUNCTION_LIST /begin REF_CHARACTERISTIC /end REF_CHARACTERISTIC /end GROUP
/begin GROUP CurrCmd.MtrCurrAngle.Rev_f32 "MICROSAR RTE" /begin SUB_GROUP /end SUB_GROUP /begin FUNCTION_LIST /end FUNCTION_LIST /begin REF_CHARACTERISTIC /end REF_CHARACTERISTIC /begin REF_MEASUREMENT Rte_CurrCmd_MtrCurrAngle_Rev_f32 /end REF_MEASUREMENT /end GROUP
/begin GROUP CurrCmd.MtrCurrDaxRef.Amp_f32 "MICROSAR RTE" /begin SUB_GROUP /end SUB_GROUP /begin FUNCTION_LIST /end FUNCTION_LIST /begin REF_CHARACTERISTIC /end REF_CHARACTERISTIC /begin REF_MEASUREMENT Rte_CurrCmd_MtrCurrDaxRef_Amp_f32 /end REF_MEASUREMENT /end GROUP
/begin GROUP CurrCmd.MtrCurrQaxRef.Amp_f32 "MICROSAR RTE" /begin SUB_GROUP /end SUB_GROUP /begin FUNCTION_LIST /end FUNCTION_LIST /begin REF_CHARACTERISTIC /end REF_CHARACTERISTIC /begin REF_MEASUREMENT Rte_CurrCmd_MtrCurrQaxRef_Amp_f32 /end REF_MEASUREMENT /end GROUP
/begin GROUP CurrCmd.MtrQuad.Cnt_u08 "MICROSAR RTE" /begin SUB_GROUP /end SUB_GROUP /begin FUNCTION_LIST /end FUNCTION_LIST /begin REF_CHARACTERISTIC /end REF_CHARACTERISTIC /begin REF_MEASUREMENT Rte_QuadDet_MtrQuad_Cnt_u08 /end REF_MEASUREMENT /end GROUP
/begin GROUP CurrCmd.MtrVoltDaxFFStatic.Volt_f32 "MICROSAR RTE" /begin SUB_GROUP /end SUB_GROUP /begin FUNCTION_LIST /end FUNCTION_LIST /begin REF_CHARACTERISTIC /end REF_CHARACTERISTIC /begin REF_MEASUREMENT Rte_CurrCmd_MtrVoltDaxFFStatic_Volt_f32 /end REF_MEASUREMENT /end GROUP
/begin GROUP CurrCmd.MtrVoltQaxFFStatic.Volt_f32 "MICROSAR RTE" /begin SUB_GROUP /end SUB_GROUP /begin FUNCTION_LIST /end FUNCTION_LIST /begin REF_CHARACTERISTIC /end REF_CHARACTERISTIC /begin REF_MEASUREMENT Rte_CurrCmd_MtrVoltQaxFFStatic_Volt_f32 /end REF_MEASUREMENT /end GROUP
/begin GROUP CurrCmd.ReceiverPorts "MICROSAR RTE"
 /begin SUB_GROUP CurrCmd.CurrentGainSvc.Cnt_lgc CurrCmd.DualEcuMotCtrlMtgnEna.Cnt_lgc CurrCmd.EstKe.VpRadpS_f32 CurrCmd.EstLd.Henry_f32 CurrCmd.EstLq.Henry_f32 CurrCmd.EstR.Ohm_f32 CurrCmd.IvtrLoaMtgtnEn.Cnt_lgc CurrCmd.MRFMtrVel.MtrRadpS_f32 CurrCmd.MRFTrqCmdScl.MtrNm_f32 CurrCmd.MotCurrLoaMtgtnEn.Cnt_lgc CurrCmd.MtrQuad.Cnt_u08 CurrCmd.Vecu.Volt_f32 CurrCmd.VehSpd.Kph_f32 /end SUB_GROUP
 /begin FUNCTION_LIST /end FUNCTION_LIST
 /begin REF_CHARACTERISTIC /end REF_CHARACTERISTIC
 /begin REF_MEASUREMENT /end REF_MEASUREMENT
/end GROUP
/begin GROUP CurrCmd.SenderPorts "MICROSAR RTE"
 /begin SUB_GROUP CurrCmd.MtrCurrAngle.Rev_f32 CurrCmd.MtrCurrDaxRef.Amp_f32 CurrCmd.MtrCurrQaxRef.Amp_f32 CurrCmd.MtrVoltDaxFFStatic.Volt_f32 CurrCmd.MtrVoltQaxFFStatic.Volt_f32 /end SUB_GROUP
 /begin FUNCTION_LIST /end FUNCTION_LIST
 /begin REF_CHARACTERISTIC /end REF_CHARACTERISTIC
 /begin REF_MEASUREMENT /end REF_MEASUREMENT
/end GROUP
/begin GROUP CurrCmd.Vecu.Volt_f32 "MICROSAR RTE" /begin SUB_GROUP /end SUB_GROUP /begin FUNCTION_LIST /end FUNCTION_LIST /begin REF_CHARACTERISTIC /end REF_CHARACTERISTIC /end GROUP
/begin GROUP CurrCmd.VehSpd.Kph_f32 "MICROSAR RTE" /begin SUB_GROUP /end SUB_GROUP /begin FUNCTION_LIST /end FUNCTION_LIST /begin REF_CHARACTERISTIC /end REF_CHARACTERISTIC /end GROUP
/begin GROUP CurrParamComp "MICROSAR RTE"
 /begin SUB_GROUP CurrParamComp.PerInstanceMemories CurrParamComp.ReceiverPorts CurrParamComp.SenderPorts /end SUB_GROUP
 /begin FUNCTION_LIST /end FUNCTION_LIST
 /begin REF_CHARACTERISTIC /end REF_CHARACTERISTIC
 /begin REF_MEASUREMENT /end REF_MEASUREMENT
/end GROUP
/begin GROUP CurrParamComp.CuTempEst.DegC_f32 "MICROSAR RTE" /begin SUB_GROUP /end SUB_GROUP /begin FUNCTION_LIST /end FUNCTION_LIST /begin REF_CHARACTERISTIC /end REF_CHARACTERISTIC /begin REF_MEASUREMENT Rte_MtrTempEst_CuTempEst_DegC_f32 /end REF_MEASUREMENT /end GROUP
/begin GROUP CurrParamComp.EOLNomMtrParam "MICROSAR RTE" /begin SUB_GROUP /end SUB_GROUP /begin FUNCTION_LIST /end FUNCTION_LIST /begin REF_CHARACTERISTIC /end REF_CHARACTERISTIC
 /begin REF_MEASUREMENT Rte_CurrParamComp_EOLNomMtrParam.NomKe_VpRadpS_f32 Rte_CurrParamComp_EOLNomMtrParam.NomRmtr_Ohm_f32 /end REF_MEASUREMENT
/end GROUP
/begin GROUP CurrParamComp.EstKe.VpRadpS_f32 "MICROSAR RTE" /begin SUB_GROUP /end SUB_GROUP /begin FUNCTION_LIST /end FUNCTION_LIST /begin REF_CHARACTERISTIC /end REF_CHARACTERISTIC /begin REF_MEASUREMENT Rte_CurrParamComp_EstKe_VpRadpS_f32 /end REF_MEASUREMENT /end GROUP
/begin GROUP CurrParamComp.EstLd.Henry_f32 "MICROSAR RTE" /begin SUB_GROUP /end SUB_GROUP /begin FUNCTION_LIST /end FUNCTION_LIST /begin REF_CHARACTERISTIC /end REF_CHARACTERISTIC /begin REF_MEASUREMENT Rte_CurrParamComp_EstLd_Henry_f32 /end REF_MEASUREMENT /end GROUP
/begin GROUP CurrParamComp.EstLq.Henry_f32 "MICROSAR RTE" /begin SUB_GROUP /end SUB_GROUP /begin FUNCTION_LIST /end FUNCTION_LIST /begin REF_CHARACTERISTIC /end REF_CHARACTERISTIC /begin REF_MEASUREMENT Rte_CurrParamComp_EstLq_Henry_f32 /end REF_MEASUREMENT /end GROUP
/begin GROUP CurrParamComp.EstR.Ohm_f32 "MICROSAR RTE" /begin SUB_GROUP /end SUB_GROUP /begin FUNCTION_LIST /end FUNCTION_LIST /begin REF_CHARACTERISTIC /end REF_CHARACTERISTIC /begin REF_MEASUREMENT Rte_CurrParamComp_EstR_Ohm_f32 /end REF_MEASUREMENT /end GROUP
/begin GROUP CurrParamComp.MagTempEst.DegC_f32 "MICROSAR RTE" /begin SUB_GROUP /end SUB_GROUP /begin FUNCTION_LIST /end FUNCTION_LIST /begin REF_CHARACTERISTIC /end REF_CHARACTERISTIC /begin REF_MEASUREMENT Rte_MtrTempEst_MagTempEst_DegC_f32 /end REF_MEASUREMENT /end GROUP
/begin GROUP CurrParamComp.MtrCurrDaxRef.Amp_f32 "MICROSAR RTE" /begin SUB_GROUP /end SUB_GROUP /begin FUNCTION_LIST /end FUNCTION_LIST /begin REF_CHARACTERISTIC /end REF_CHARACTERISTIC /begin REF_MEASUREMENT Rte_CurrCmd_MtrCurrDaxRef_Amp_f32 /end REF_MEASUREMENT /end GROUP
/begin GROUP CurrParamComp.MtrCurrQaxRef.Amp_f32 "MICROSAR RTE" /begin SUB_GROUP /end SUB_GROUP /begin FUNCTION_LIST /end FUNCTION_LIST /begin REF_CHARACTERISTIC /end REF_CHARACTERISTIC /begin REF_MEASUREMENT Rte_CurrCmd_MtrCurrQaxRef_Amp_f32 /end REF_MEASUREMENT /end GROUP
/begin GROUP CurrParamComp.PerInstanceMemories "MICROSAR RTE" /begin SUB_GROUP CurrParamComp.EOLNomMtrParam /end SUB_GROUP /begin FUNCTION_LIST /end FUNCTION_LIST /begin REF_CHARACTERISTIC /end REF_CHARACTERISTIC /begin REF_MEASUREMENT /end REF_MEASUREMENT /end GROUP
/begin GROUP CurrParamComp.ReceiverPorts "MICROSAR RTE"
 /begin SUB_GROUP CurrParamComp.CuTempEst.DegC_f32 CurrParamComp.MagTempEst.DegC_f32 CurrParamComp.MtrCurrDaxRef.Amp_f32 CurrParamComp.MtrCurrQaxRef.Amp_f32 CurrParamComp.SiTempEst.DegC_f32 /end SUB_GROUP
 /begin FUNCTION_LIST /end FUNCTION_LIST
 /begin REF_CHARACTERISTIC /end REF_CHARACTERISTIC
 /begin REF_MEASUREMENT /end REF_MEASUREMENT
/end GROUP
/begin GROUP CurrParamComp.SenderPorts "MICROSAR RTE"
 /begin SUB_GROUP CurrParamComp.EstKe.VpRadpS_f32 CurrParamComp.EstLd.Henry_f32 CurrParamComp.EstLq.Henry_f32 CurrParamComp.EstR.Ohm_f32 /end SUB_GROUP
 /begin FUNCTION_LIST /end FUNCTION_LIST
 /begin REF_CHARACTERISTIC /end REF_CHARACTERISTIC
 /begin REF_MEASUREMENT /end REF_MEASUREMENT
/end GROUP
/begin GROUP CurrParamComp.SiTempEst.DegC_f32 "MICROSAR RTE" /begin SUB_GROUP /end SUB_GROUP /begin FUNCTION_LIST /end FUNCTION_LIST /begin REF_CHARACTERISTIC /end REF_CHARACTERISTIC /begin REF_MEASUREMENT Rte_MtrTempEst_SiTempEst_DegC_f32 /end REF_MEASUREMENT /end GROUP
/begin GROUP CustBattDiag "MICROSAR RTE" /begin SUB_GROUP CustBattDiag.ModeRequirePorts CustBattDiag.ReceiverPorts /end SUB_GROUP /begin FUNCTION_LIST /end FUNCTION_LIST /begin REF_CHARACTERISTIC /end REF_CHARACTERISTIC /begin REF_MEASUREMENT /end REF_MEASUREMENT /end GROUP
/begin GROUP CustBattDiag.Batt.Volt_f32 "MICROSAR RTE" /begin SUB_GROUP /end SUB_GROUP /begin FUNCTION_LIST /end FUNCTION_LIST /begin REF_CHARACTERISTIC /end REF_CHARACTERISTIC /end GROUP
/begin GROUP CustBattDiag.CTerm.Cnt_lgc "MICROSAR RTE" /begin SUB_GROUP /end SUB_GROUP /begin FUNCTION_LIST /end FUNCTION_LIST /begin REF_CHARACTERISTIC /end REF_CHARACTERISTIC /begin REF_MEASUREMENT Rte_VehPwrMd_CTermActive_Cnt_lgc /end REF_MEASUREMENT /end GROUP
/begin GROUP CustBattDiag.DmdDelestDa.Cnt_u08 "MICROSAR RTE" /begin SUB_GROUP /end SUB_GROUP /begin FUNCTION_LIST /end FUNCTION_LIST /begin REF_CHARACTERISTIC /end REF_CHARACTERISTIC /begin REF_MEASUREMENT Rte_SrlComInput_DmdDelestDaSts_Cnt_u08 /end REF_MEASUREMENT /end GROUP
/begin GROUP CustBattDiag.EngOn.Cnt_lgc "MICROSAR RTE" /begin SUB_GROUP /end SUB_GROUP /begin FUNCTION_LIST /end FUNCTION_LIST /begin REF_CHARACTERISTIC /end REF_CHARACTERISTIC /begin REF_MEASUREMENT Rte_SrlComInput_EngOn_Cnt_lgc /end REF_MEASUREMENT /end GROUP
/begin GROUP CustBattDiag.EtatMT.Cnt_u08 "MICROSAR RTE" /begin SUB_GROUP /end SUB_GROUP /begin FUNCTION_LIST /end FUNCTION_LIST /begin REF_CHARACTERISTIC /end REF_CHARACTERISTIC /begin REF_MEASUREMENT Rte_SrlComInput_EtatMTRaw_Cnt_u08 /end REF_MEASUREMENT /end GROUP
/begin GROUP CustBattDiag.ModeRequirePorts "MICROSAR RTE" /begin SUB_GROUP CustBattDiag.SystemState.Mode /end SUB_GROUP /begin FUNCTION_LIST /end FUNCTION_LIST /begin REF_CHARACTERISTIC /end REF_CHARACTERISTIC /begin REF_MEASUREMENT /end REF_MEASUREMENT /end GROUP
/begin GROUP CustBattDiag.ReceiverPorts "MICROSAR RTE"
 /begin SUB_GROUP CustBattDiag.Batt.Volt_f32 CustBattDiag.CTerm.Cnt_lgc CustBattDiag.DmdDelestDa.Cnt_u08 CustBattDiag.EngOn.Cnt_lgc CustBattDiag.EtatMT.Cnt_u08 CustBattDiag.SttdSelected.Cnt_lgc CustBattDiag.ValidEngineStatus.Cnt_lgc CustBattDiag.VehicleSpeed.Kph_f32 CustBattDiag.VehicleSpeedValid.Cnt_lgc /end SUB_GROUP
 /begin FUNCTION_LIST /end FUNCTION_LIST
 /begin REF_CHARACTERISTIC /end REF_CHARACTERISTIC
 /begin REF_MEASUREMENT /end REF_MEASUREMENT
/end GROUP
/begin GROUP CustBattDiag.SttdSelected.Cnt_lgc "MICROSAR RTE" /begin SUB_GROUP /end SUB_GROUP /begin FUNCTION_LIST /end FUNCTION_LIST /begin REF_CHARACTERISTIC /end REF_CHARACTERISTIC /end GROUP
/begin GROUP CustBattDiag.SystemState.Mode "MICROSAR RTE" /begin SUB_GROUP /end SUB_GROUP /begin FUNCTION_LIST /end FUNCTION_LIST /begin REF_CHARACTERISTIC /end REF_CHARACTERISTIC /end GROUP
/begin GROUP CustBattDiag.ValidEngineStatus.Cnt_lgc "MICROSAR RTE" /begin SUB_GROUP /end SUB_GROUP /begin FUNCTION_LIST /end FUNCTION_LIST /begin REF_CHARACTERISTIC /end REF_CHARACTERISTIC /begin REF_MEASUREMENT Rte_SrlComInput_ValidEngineStatus_Cnt_lgc /end REF_MEASUREMENT /end GROUP
/begin GROUP CustBattDiag.VehicleSpeed.Kph_f32 "MICROSAR RTE" /begin SUB_GROUP /end SUB_GROUP /begin FUNCTION_LIST /end FUNCTION_LIST /begin REF_CHARACTERISTIC /end REF_CHARACTERISTIC /end GROUP
/begin GROUP CustBattDiag.VehicleSpeedValid.Cnt_lgc "MICROSAR RTE" /begin SUB_GROUP /end SUB_GROUP /begin FUNCTION_LIST /end FUNCTION_LIST /begin REF_CHARACTERISTIC /end REF_CHARACTERISTIC /end GROUP
/begin GROUP Damping "MICROSAR RTE" /begin SUB_GROUP Damping.ReceiverPorts Damping.SenderPorts /end SUB_GROUP /begin FUNCTION_LIST /end FUNCTION_LIST /begin REF_CHARACTERISTIC /end REF_CHARACTERISTIC /begin REF_MEASUREMENT /end REF_MEASUREMENT /end GROUP
/begin GROUP Damping.AssistCmd.MtrNm_f32 "MICROSAR RTE" /begin SUB_GROUP /end SUB_GROUP /begin FUNCTION_LIST /end FUNCTION_LIST /begin REF_CHARACTERISTIC /end REF_CHARACTERISTIC /end GROUP
/begin GROUP Damping.AssistMechTempEst.DegC_f32 "MICROSAR RTE" /begin SUB_GROUP /end SUB_GROUP /begin FUNCTION_LIST /end FUNCTION_LIST /begin REF_CHARACTERISTIC /end REF_CHARACTERISTIC /end GROUP
/begin GROUP Damping.CustomDamp.MtrNm_f32 "MICROSAR RTE" /begin SUB_GROUP /end SUB_GROUP /begin FUNCTION_LIST /end FUNCTION_LIST /begin REF_CHARACTERISTIC /end REF_CHARACTERISTIC /begin REF_MEASUREMENT Rte_Damping_CustomDamp_MtrNm_f32 /end REF_MEASUREMENT /end GROUP
/begin GROUP Damping.DampingCmd.MtrNm_f32 "MICROSAR RTE" /begin SUB_GROUP /end SUB_GROUP /begin FUNCTION_LIST /end FUNCTION_LIST /begin REF_CHARACTERISTIC /end REF_CHARACTERISTIC /begin REF_MEASUREMENT Rte_Damping_DampingCmd_MtrNm_f32 /end REF_MEASUREMENT /end GROUP
/begin GROUP Damping.DampingDDFactor.Uls_f32 "MICROSAR RTE" /begin SUB_GROUP /end SUB_GROUP /begin FUNCTION_LIST /end FUNCTION_LIST /begin REF_CHARACTERISTIC /end REF_CHARACTERISTIC /begin REF_MEASUREMENT Rte_Damping_DampingDDFactor_Uls_f32 /end REF_MEASUREMENT /end GROUP
/begin GROUP Damping.DefeatDampingSvc.Cnt_lgc "MICROSAR RTE" /begin SUB_GROUP /end SUB_GROUP /begin FUNCTION_LIST /end FUNCTION_LIST /begin REF_CHARACTERISTIC /end REF_CHARACTERISTIC /end GROUP
/begin GROUP Damping.HwTorque.HwNm_f32 "MICROSAR RTE" /begin SUB_GROUP /end SUB_GROUP /begin FUNCTION_LIST /end FUNCTION_LIST /begin REF_CHARACTERISTIC /end REF_CHARACTERISTIC /end GROUP
/begin GROUP Damping.MotorVelCRF.MtrRadpS_f32 "MICROSAR RTE" /begin SUB_GROUP /end SUB_GROUP /begin FUNCTION_LIST /end FUNCTION_LIST /begin REF_CHARACTERISTIC /end REF_CHARACTERISTIC /begin REF_MEASUREMENT Rte_MtrVel_MotorVelCRF_MtrRadpS_f32 /end REF_MEASUREMENT /end GROUP
/begin GROUP Damping.ReceiverPorts "MICROSAR RTE"
 /begin SUB_GROUP Damping.AssistCmd.MtrNm_f32 Damping.AssistMechTempEst.DegC_f32 Damping.CustomDamp.MtrNm_f32 Damping.DampingDDFactor.Uls_f32 Damping.DefeatDampingSvc.Cnt_lgc Damping.HwTorque.HwNm_f32 Damping.MotorVelCRF.MtrRadpS_f32 Damping.VehicleSpeed.Kph_f32 /end SUB_GROUP
 /begin FUNCTION_LIST /end FUNCTION_LIST
 /begin REF_CHARACTERISTIC /end REF_CHARACTERISTIC
 /begin REF_MEASUREMENT /end REF_MEASUREMENT
/end GROUP
/begin GROUP Damping.SenderPorts "MICROSAR RTE" /begin SUB_GROUP Damping.DampingCmd.MtrNm_f32 /end SUB_GROUP /begin FUNCTION_LIST /end FUNCTION_LIST /begin REF_CHARACTERISTIC /end REF_CHARACTERISTIC /begin REF_MEASUREMENT /end REF_MEASUREMENT /end GROUP
/begin GROUP Damping.VehicleSpeed.Kph_f32 "MICROSAR RTE" /begin SUB_GROUP /end SUB_GROUP /begin FUNCTION_LIST /end FUNCTION_LIST /begin REF_CHARACTERISTIC /end REF_CHARACTERISTIC /end GROUP
/begin GROUP DampingFirewall "MICROSAR RTE"
 /begin SUB_GROUP DampingFirewall.ModeRequirePorts DampingFirewall.ReceiverPorts DampingFirewall.SenderPorts /end SUB_GROUP
 /begin FUNCTION_LIST /end FUNCTION_LIST
 /begin REF_CHARACTERISTIC /end REF_CHARACTERISTIC
 /begin REF_MEASUREMENT /end REF_MEASUREMENT
/end GROUP
/begin GROUP DampingFirewall.AsstFirewallActive.Uls_f32 "MICROSAR RTE" /begin SUB_GROUP /end SUB_GROUP /begin FUNCTION_LIST /end FUNCTION_LIST /begin REF_CHARACTERISTIC /end REF_CHARACTERISTIC /end GROUP
/begin GROUP DampingFirewall.BaseAssistCmd.MtrNm_f32 "MICROSAR RTE" /begin SUB_GROUP /end SUB_GROUP /begin FUNCTION_LIST /end FUNCTION_LIST /begin REF_CHARACTERISTIC /end REF_CHARACTERISTIC /end GROUP
/begin GROUP DampingFirewall.CombinedDamping.MtrNm_f32 "MICROSAR RTE" /begin SUB_GROUP /end SUB_GROUP /begin FUNCTION_LIST /end FUNCTION_LIST /begin REF_CHARACTERISTIC /end REF_CHARACTERISTIC /end GROUP
/begin GROUP DampingFirewall.DampingCmd.MtrNm_f32 "MICROSAR RTE" /begin SUB_GROUP /end SUB_GROUP /begin FUNCTION_LIST /end FUNCTION_LIST /begin REF_CHARACTERISTIC /end REF_CHARACTERISTIC /begin REF_MEASUREMENT Rte_PSADSG_PsaDampgCmd_MtrNm_f32 /end REF_MEASUREMENT /end GROUP
/begin GROUP DampingFirewall.Defeat_Damping_Svc.Cnt_lgc "MICROSAR RTE" /begin SUB_GROUP /end SUB_GROUP /begin FUNCTION_LIST /end FUNCTION_LIST /begin REF_CHARACTERISTIC /end REF_CHARACTERISTIC /end GROUP
/begin GROUP DampingFirewall.FreqDepDmpSrlComSvcDft.Cnt_lgc "MICROSAR RTE" /begin SUB_GROUP /end SUB_GROUP /begin FUNCTION_LIST /end FUNCTION_LIST /begin REF_CHARACTERISTIC /end REF_CHARACTERISTIC /end GROUP
/begin GROUP DampingFirewall.HwTorque.HwNm_f32 "MICROSAR RTE" /begin SUB_GROUP /end SUB_GROUP /begin FUNCTION_LIST /end FUNCTION_LIST /begin REF_CHARACTERISTIC /end REF_CHARACTERISTIC /end GROUP
/begin GROUP DampingFirewall.InertiaComp.MtrNm_f32 "MICROSAR RTE" /begin SUB_GROUP /end SUB_GROUP /begin FUNCTION_LIST /end FUNCTION_LIST /begin REF_CHARACTERISTIC /end REF_CHARACTERISTIC /begin REF_MEASUREMENT Rte_FrqDepDmpnInrtCmp_FrqDepDmpnInrtCmp_MtrNm_f32 /end REF_MEASUREMENT /end GROUP
/begin GROUP DampingFirewall.MEC_Counter.Cnt_enum "MICROSAR RTE" /begin SUB_GROUP /end SUB_GROUP /begin FUNCTION_LIST /end FUNCTION_LIST /begin REF_CHARACTERISTIC /end REF_CHARACTERISTIC /end GROUP
/begin GROUP DampingFirewall.ModeRequirePorts "MICROSAR RTE" /begin SUB_GROUP DampingFirewall.SystemState.Mode /end SUB_GROUP /begin FUNCTION_LIST /end FUNCTION_LIST /begin REF_CHARACTERISTIC /end REF_CHARACTERISTIC /begin REF_MEASUREMENT /end REF_MEASUREMENT /end GROUP
/begin GROUP DampingFirewall.MtrVelCRF.MtrRadpS_f32 "MICROSAR RTE" /begin SUB_GROUP /end SUB_GROUP /begin FUNCTION_LIST /end FUNCTION_LIST /begin REF_CHARACTERISTIC /end REF_CHARACTERISTIC /begin REF_MEASUREMENT Rte_MtrVel_MotorVelCRF_MtrRadpS_f32 /end REF_MEASUREMENT /end GROUP
/begin GROUP DampingFirewall.ReceiverPorts "MICROSAR RTE"
 /begin SUB_GROUP DampingFirewall.AsstFirewallActive.Uls_f32 DampingFirewall.BaseAssistCmd.MtrNm_f32 DampingFirewall.DampingCmd.MtrNm_f32 DampingFirewall.Defeat_Damping_Svc.Cnt_lgc DampingFirewall.FreqDepDmpSrlComSvcDft.Cnt_lgc DampingFirewall.HwTorque.HwNm_f32 DampingFirewall.InertiaComp.MtrNm_f32 DampingFirewall.MEC_Counter.Cnt_enum DampingFirewall.MtrVelCRF.MtrRadpS_f32 DampingFirewall.VehicleLonAccel.KphpS_f32 DampingFirewall.VehicleSpeed.Kph_f32 DampingFirewall.WIRCmdAmpBlnd.MtrNm_f32 /end SUB_GROUP
 /begin FUNCTION_LIST /end FUNCTION_LIST
 /begin REF_CHARACTERISTIC /end REF_CHARACTERISTIC
 /begin REF_MEASUREMENT /end REF_MEASUREMENT
/end GROUP
/begin GROUP DampingFirewall.SenderPorts "MICROSAR RTE" /begin SUB_GROUP DampingFirewall.CombinedDamping.MtrNm_f32 /end SUB_GROUP /begin FUNCTION_LIST /end FUNCTION_LIST /begin REF_CHARACTERISTIC /end REF_CHARACTERISTIC /begin REF_MEASUREMENT /end REF_MEASUREMENT /end GROUP
/begin GROUP DampingFirewall.SystemState.Mode "MICROSAR RTE" /begin SUB_GROUP /end SUB_GROUP /begin FUNCTION_LIST /end FUNCTION_LIST /begin REF_CHARACTERISTIC /end REF_CHARACTERISTIC /end GROUP
/begin GROUP DampingFirewall.VehicleLonAccel.KphpS_f32 "MICROSAR RTE" /begin SUB_GROUP /end SUB_GROUP /begin FUNCTION_LIST /end FUNCTION_LIST /begin REF_CHARACTERISTIC /end REF_CHARACTERISTIC /begin REF_MEASUREMENT Rte_SignlCondn_Vehicle_LonAccel_KphpS_f32 /end REF_MEASUREMENT /end GROUP
/begin GROUP DampingFirewall.VehicleSpeed.Kph_f32 "MICROSAR RTE" /begin SUB_GROUP /end SUB_GROUP /begin FUNCTION_LIST /end FUNCTION_LIST /begin REF_CHARACTERISTIC /end REF_CHARACTERISTIC /end GROUP
/begin GROUP DampingFirewall.WIRCmdAmpBlnd.MtrNm_f32 "MICROSAR RTE" /begin SUB_GROUP /end SUB_GROUP /begin FUNCTION_LIST /end FUNCTION_LIST /begin REF_CHARACTERISTIC /end REF_CHARACTERISTIC /begin REF_MEASUREMENT Rte_DampingFirewall_WIRCmdAmpBlnd_MtrNm_f32 /end REF_MEASUREMENT /end GROUP
/begin GROUP DemIf "MICROSAR RTE"
 /begin SUB_GROUP DemIf.ModeRequirePorts DemIf.ReceiverPorts DemIf.SenderPorts /end SUB_GROUP
 /begin FUNCTION_LIST /end FUNCTION_LIST
 /begin REF_CHARACTERISTIC /end REF_CHARACTERISTIC
 /begin REF_MEASUREMENT /end REF_MEASUREMENT
/end GROUP
/begin GROUP DemIf.BatteryVoltage.Volt_f32 "MICROSAR RTE" /begin SUB_GROUP /end SUB_GROUP /begin FUNCTION_LIST /end FUNCTION_LIST /begin REF_CHARACTERISTIC /end REF_CHARACTERISTIC /end GROUP
/begin GROUP DemIf.BusOff.Cnt_lgc "MICROSAR RTE" /begin SUB_GROUP /end SUB_GROUP /begin FUNCTION_LIST /end FUNCTION_LIST /begin REF_CHARACTERISTIC /end REF_CHARACTERISTIC /begin REF_MEASUREMENT Rte_SrlComDriver_BusOff_Cnt_lgc /end REF_MEASUREMENT /end GROUP
/begin GROUP DemIf.CTCFailed.Cnt_lgc "MICROSAR RTE" /begin SUB_GROUP /end SUB_GROUP /begin FUNCTION_LIST /end FUNCTION_LIST /begin REF_CHARACTERISTIC /end REF_CHARACTERISTIC /begin REF_MEASUREMENT Rte_DemIf_CTCFailed_Cnt_lgc /end REF_MEASUREMENT /end GROUP
/begin GROUP DemIf.CTerm.Cnt_lgc "MICROSAR RTE" /begin SUB_GROUP /end SUB_GROUP /begin FUNCTION_LIST /end FUNCTION_LIST /begin REF_CHARACTERISTIC /end REF_CHARACTERISTIC /begin REF_MEASUREMENT Rte_VehPwrMd_CTermActive_Cnt_lgc /end REF_MEASUREMENT /end GROUP
/begin GROUP DemIf.ElectronicIntegration.Cnt_lgc "MICROSAR RTE" /begin SUB_GROUP /end SUB_GROUP /begin FUNCTION_LIST /end FUNCTION_LIST /begin REF_CHARACTERISTIC /end REF_CHARACTERISTIC /begin REF_MEASUREMENT Rte_SrlComInput_ElectronicIntegration_Cnt_lgc /end REF_MEASUREMENT /end GROUP
/begin GROUP DemIf.EtatMt.Cnt_u08 "MICROSAR RTE" /begin SUB_GROUP /end SUB_GROUP /begin FUNCTION_LIST /end FUNCTION_LIST /begin REF_CHARACTERISTIC /end REF_CHARACTERISTIC /begin REF_MEASUREMENT Rte_SrlComInput_EtatMTRaw_Cnt_u08 /end REF_MEASUREMENT /end GROUP
/begin GROUP DemIf.ModeRequirePorts "MICROSAR RTE" /begin SUB_GROUP DemIf.SystemState.Mode /end SUB_GROUP /begin FUNCTION_LIST /end FUNCTION_LIST /begin REF_CHARACTERISTIC /end REF_CHARACTERISTIC /begin REF_MEASUREMENT /end REF_MEASUREMENT /end GROUP
/begin GROUP DemIf.ReceiverPorts "MICROSAR RTE"
 /begin SUB_GROUP DemIf.BatteryVoltage.Volt_f32 DemIf.BusOff.Cnt_lgc DemIf.CTerm.Cnt_lgc DemIf.ElectronicIntegration.Cnt_lgc DemIf.EtatMt.Cnt_u08 /end SUB_GROUP
 /begin FUNCTION_LIST /end FUNCTION_LIST
 /begin REF_CHARACTERISTIC /end REF_CHARACTERISTIC
 /begin REF_MEASUREMENT /end REF_MEASUREMENT
/end GROUP
/begin GROUP DemIf.SenderPorts "MICROSAR RTE" /begin SUB_GROUP DemIf.CTCFailed.Cnt_lgc /end SUB_GROUP /begin FUNCTION_LIST /end FUNCTION_LIST /begin REF_CHARACTERISTIC /end REF_CHARACTERISTIC /begin REF_MEASUREMENT /end REF_MEASUREMENT /end GROUP
/begin GROUP DemIf.SystemState.Mode "MICROSAR RTE" /begin SUB_GROUP /end SUB_GROUP /begin FUNCTION_LIST /end FUNCTION_LIST /begin REF_CHARACTERISTIC /end REF_CHARACTERISTIC /begin REF_MEASUREMENT Rte_ModeMachine_StaMd6_SystemState6_Mode /end REF_MEASUREMENT /end GROUP
/begin GROUP DiagMgr10 "MICROSAR RTE"
 /begin SUB_GROUP DiagMgr10.ModeRequirePorts DiagMgr10.ReceiverPorts DiagMgr10.SenderPorts /end SUB_GROUP
 /begin FUNCTION_LIST /end FUNCTION_LIST
 /begin REF_CHARACTERISTIC /end REF_CHARACTERISTIC
 /begin REF_MEASUREMENT /end REF_MEASUREMENT
/end GROUP
/begin GROUP DiagMgr10.DiagNoofActiveInverter.Cnt_u08 "MICROSAR RTE" /begin SUB_GROUP /end SUB_GROUP /begin FUNCTION_LIST /end FUNCTION_LIST /begin REF_CHARACTERISTIC /end REF_CHARACTERISTIC /begin REF_MEASUREMENT Rte_DiagMgr10_DiagNoofActiveInverter_Cnt_u08 /end REF_MEASUREMENT /end GROUP
/begin GROUP DiagMgr10.DiagRampRate.XpmS_f32 "MICROSAR RTE" /begin SUB_GROUP /end SUB_GROUP /begin FUNCTION_LIST /end FUNCTION_LIST /begin REF_CHARACTERISTIC /end REF_CHARACTERISTIC /begin REF_MEASUREMENT Rte_DiagMgr10_DiagRampRate_XpmS_f32 /end REF_MEASUREMENT /end GROUP
/begin GROUP DiagMgr10.DiagRampValue.Uls_f32 "MICROSAR RTE" /begin SUB_GROUP /end SUB_GROUP /begin FUNCTION_LIST /end FUNCTION_LIST /begin REF_CHARACTERISTIC /end REF_CHARACTERISTIC /begin REF_MEASUREMENT Rte_DiagMgr10_DiagRampValue_Uls_f32 /end REF_MEASUREMENT /end GROUP
/begin GROUP DiagMgr10.DiagRmpToZeroActive.Cnt_lgc "MICROSAR RTE" /begin SUB_GROUP /end SUB_GROUP /begin FUNCTION_LIST /end FUNCTION_LIST /begin REF_CHARACTERISTIC /end REF_CHARACTERISTIC /begin REF_MEASUREMENT Rte_DiagMgr10_DiagRmpToZeroActive_Cnt_lgc /end REF_MEASUREMENT /end GROUP
/begin GROUP DiagMgr10.DiagStsCtrldDisRmpPres.Cnt_lgc "MICROSAR RTE" /begin SUB_GROUP /end SUB_GROUP /begin FUNCTION_LIST /end FUNCTION_LIST /begin REF_CHARACTERISTIC /end REF_CHARACTERISTIC /begin REF_MEASUREMENT Rte_DiagMgr10_DiagStsCtrldDisRmpPres_Cnt_lgc /end REF_MEASUREMENT /end GROUP
/begin GROUP DiagMgr10.DiagStsDefTemp.Cnt_lgc "MICROSAR RTE" /begin SUB_GROUP /end SUB_GROUP /begin FUNCTION_LIST /end FUNCTION_LIST /begin REF_CHARACTERISTIC /end REF_CHARACTERISTIC /begin REF_MEASUREMENT Rte_DiagMgr10_DiagStsDefTemp_Cnt_lgc /end REF_MEASUREMENT /end GROUP
/begin GROUP DiagMgr10.DiagStsDefVehSpd.Cnt_lgc "MICROSAR RTE" /begin SUB_GROUP /end SUB_GROUP /begin FUNCTION_LIST /end FUNCTION_LIST /begin REF_CHARACTERISTIC /end REF_CHARACTERISTIC /begin REF_MEASUREMENT Rte_DiagMgr10_DiagStsDefVehSpd_Cnt_lgc /end REF_MEASUREMENT /end GROUP
/begin GROUP DiagMgr10.DiagStsHWASbSystmFltPres.Cnt_lgc "MICROSAR RTE" /begin SUB_GROUP /end SUB_GROUP /begin FUNCTION_LIST /end FUNCTION_LIST /begin REF_CHARACTERISTIC /end REF_CHARACTERISTIC /end GROUP
/begin GROUP DiagMgr10.DiagStsInverter1Inactive.Cnt_lgc "MICROSAR RTE" /begin SUB_GROUP /end SUB_GROUP /begin FUNCTION_LIST /end FUNCTION_LIST /begin REF_CHARACTERISTIC /end REF_CHARACTERISTIC /begin REF_MEASUREMENT Rte_DiagMgr10_DiagStsInverter1Inactive_Cnt_lgc /end REF_MEASUREMENT /end GROUP
/begin GROUP DiagMgr10.DiagStsInverter2Inactive.Cnt_lgc "MICROSAR RTE" /begin SUB_GROUP /end SUB_GROUP /begin FUNCTION_LIST /end FUNCTION_LIST /begin REF_CHARACTERISTIC /end REF_CHARACTERISTIC /begin REF_MEASUREMENT Rte_DiagMgr10_DiagStsInverter2Inactive_Cnt_lgc /end REF_MEASUREMENT /end GROUP
/begin GROUP DiagMgr10.DiagStsNonRecRmpToZeroFltPres.Cnt_lgc "MICROSAR RTE" /begin SUB_GROUP /end SUB_GROUP /begin FUNCTION_LIST /end FUNCTION_LIST /begin REF_CHARACTERISTIC /end REF_CHARACTERISTIC /begin REF_MEASUREMENT Rte_DiagMgr10_DiagStsNonRecRmpToZeroFltPres_Cnt_lgc /end REF_MEASUREMENT /end GROUP
/begin GROUP DiagMgr10.DiagStsRecRmpToZeroFltPres.Cnt_lgc "MICROSAR RTE" /begin SUB_GROUP /end SUB_GROUP /begin FUNCTION_LIST /end FUNCTION_LIST /begin REF_CHARACTERISTIC /end REF_CHARACTERISTIC /begin REF_MEASUREMENT Rte_DiagMgr10_DiagStsRecRmpToZeroFltPres_Cnt_lgc /end REF_MEASUREMENT /end GROUP
/begin GROUP DiagMgr10.DiagStsScomHWANotValid.Cnt_lgc "MICROSAR RTE" /begin SUB_GROUP /end SUB_GROUP /begin FUNCTION_LIST /end FUNCTION_LIST /begin REF_CHARACTERISTIC /end REF_CHARACTERISTIC /begin REF_MEASUREMENT Rte_DiagMgr10_DiagStsScomHWANotValid_Cnt_lgc /end REF_MEASUREMENT /end GROUP
/begin GROUP DiagMgr10.DiagStsWIRDisable.Cnt_lgc "MICROSAR RTE" /begin SUB_GROUP /end SUB_GROUP /begin FUNCTION_LIST /end FUNCTION_LIST /begin REF_CHARACTERISTIC /end REF_CHARACTERISTIC /begin REF_MEASUREMENT Rte_DiagMgr10_DiagStsWIRDisable_Cnt_lgc /end REF_MEASUREMENT /end GROUP
/begin GROUP DiagMgr10.HwTrq.HwNm_f32 "MICROSAR RTE" /begin SUB_GROUP /end SUB_GROUP /begin FUNCTION_LIST /end FUNCTION_LIST /begin REF_CHARACTERISTIC /end REF_CHARACTERISTIC /end GROUP
/begin GROUP DiagMgr10.IgnCnt.Cnt_u16 "MICROSAR RTE" /begin SUB_GROUP /end SUB_GROUP /begin FUNCTION_LIST /end FUNCTION_LIST /begin REF_CHARACTERISTIC /end REF_CHARACTERISTIC /begin REF_MEASUREMENT Rte_CDDInterface9_IgnCnt_Cnt_u16 /end REF_MEASUREMENT /end GROUP
/begin GROUP DiagMgr10.MEC.Cnt_enum "MICROSAR RTE" /begin SUB_GROUP /end SUB_GROUP /begin FUNCTION_LIST /end FUNCTION_LIST /begin REF_CHARACTERISTIC /end REF_CHARACTERISTIC /end GROUP
/begin GROUP DiagMgr10.MfgDiagInhibit.Cnt_lgc "MICROSAR RTE" /begin SUB_GROUP /end SUB_GROUP /begin FUNCTION_LIST /end FUNCTION_LIST /begin REF_CHARACTERISTIC /end REF_CHARACTERISTIC /end GROUP
/begin GROUP DiagMgr10.ModeRequirePorts "MICROSAR RTE" /begin SUB_GROUP DiagMgr10.SystemState.Mode /end SUB_GROUP /begin FUNCTION_LIST /end FUNCTION_LIST /begin REF_CHARACTERISTIC /end REF_CHARACTERISTIC /begin REF_MEASUREMENT /end REF_MEASUREMENT /end GROUP
/begin GROUP DiagMgr10.MtrTrq.MtrNm_f32 "MICROSAR RTE" /begin SUB_GROUP /end SUB_GROUP /begin FUNCTION_LIST /end FUNCTION_LIST /begin REF_CHARACTERISTIC /end REF_CHARACTERISTIC /begin REF_MEASUREMENT Rte_TranlDampg_MRFMtrTrqCmd_MtrNm_f32 /end REF_MEASUREMENT /end GROUP
/begin GROUP DiagMgr10.ReceiverPorts "MICROSAR RTE"
 /begin SUB_GROUP DiagMgr10.HwTrq.HwNm_f32 DiagMgr10.IgnCnt.Cnt_u16 DiagMgr10.MEC.Cnt_enum DiagMgr10.MfgDiagInhibit.Cnt_lgc DiagMgr10.MtrTrq.MtrNm_f32 DiagMgr10.VehSpd.Kph_f32 /end SUB_GROUP
 /begin FUNCTION_LIST /end FUNCTION_LIST
 /begin REF_CHARACTERISTIC /end REF_CHARACTERISTIC
 /begin REF_MEASUREMENT /end REF_MEASUREMENT
/end GROUP
/begin GROUP DiagMgr10.SenderPorts "MICROSAR RTE"
 /begin SUB_GROUP DiagMgr10.DiagNoofActiveInverter.Cnt_u08 DiagMgr10.DiagRampRate.XpmS_f32 DiagMgr10.DiagRampValue.Uls_f32 DiagMgr10.DiagRmpToZeroActive.Cnt_lgc DiagMgr10.DiagStsCtrldDisRmpPres.Cnt_lgc DiagMgr10.DiagStsDefTemp.Cnt_lgc DiagMgr10.DiagStsDefVehSpd.Cnt_lgc DiagMgr10.DiagStsHWASbSystmFltPres.Cnt_lgc DiagMgr10.DiagStsInverter1Inactive.Cnt_lgc DiagMgr10.DiagStsInverter2Inactive.Cnt_lgc DiagMgr10.DiagStsNonRecRmpToZeroFltPres.Cnt_lgc DiagMgr10.DiagStsRecRmpToZeroFltPres.Cnt_lgc DiagMgr10.DiagStsScomHWANotValid.Cnt_lgc DiagMgr10.DiagStsWIRDisable.Cnt_lgc /end SUB_GROUP
 /begin FUNCTION_LIST /end FUNCTION_LIST
 /begin REF_CHARACTERISTIC /end REF_CHARACTERISTIC
 /begin REF_MEASUREMENT /end REF_MEASUREMENT
/end GROUP
/begin GROUP DiagMgr10.SystemState.Mode "MICROSAR RTE" /begin SUB_GROUP /end SUB_GROUP /begin FUNCTION_LIST /end FUNCTION_LIST /begin REF_CHARACTERISTIC /end REF_CHARACTERISTIC /end GROUP
/begin GROUP DiagMgr10.VehSpd.Kph_f32 "MICROSAR RTE" /begin SUB_GROUP /end SUB_GROUP /begin FUNCTION_LIST /end FUNCTION_LIST /begin REF_CHARACTERISTIC /end REF_CHARACTERISTIC /end GROUP
/begin GROUP DiagMgr11 "MICROSAR RTE" /begin SUB_GROUP DiagMgr11.ModeRequirePorts DiagMgr11.ReceiverPorts /end SUB_GROUP /begin FUNCTION_LIST /end FUNCTION_LIST /begin REF_CHARACTERISTIC /end REF_CHARACTERISTIC /begin REF_MEASUREMENT /end REF_MEASUREMENT /end GROUP
/begin GROUP DiagMgr11.HwTrq.HwNm_f32 "MICROSAR RTE" /begin SUB_GROUP /end SUB_GROUP /begin FUNCTION_LIST /end FUNCTION_LIST /begin REF_CHARACTERISTIC /end REF_CHARACTERISTIC /end GROUP
/begin GROUP DiagMgr11.IgnCnt.Cnt_u16 "MICROSAR RTE" /begin SUB_GROUP /end SUB_GROUP /begin FUNCTION_LIST /end FUNCTION_LIST /begin REF_CHARACTERISTIC /end REF_CHARACTERISTIC /begin REF_MEASUREMENT Rte_CDDInterface9_IgnCnt_Cnt_u16 /end REF_MEASUREMENT /end GROUP
/begin GROUP DiagMgr11.MEC.Cnt_enum "MICROSAR RTE" /begin SUB_GROUP /end SUB_GROUP /begin FUNCTION_LIST /end FUNCTION_LIST /begin REF_CHARACTERISTIC /end REF_CHARACTERISTIC /end GROUP
/begin GROUP DiagMgr11.MfgDiagInhibit.Cnt_lgc "MICROSAR RTE" /begin SUB_GROUP /end SUB_GROUP /begin FUNCTION_LIST /end FUNCTION_LIST /begin REF_CHARACTERISTIC /end REF_CHARACTERISTIC /end GROUP
/begin GROUP DiagMgr11.ModeRequirePorts "MICROSAR RTE" /begin SUB_GROUP DiagMgr11.SystemState.Mode /end SUB_GROUP /begin FUNCTION_LIST /end FUNCTION_LIST /begin REF_CHARACTERISTIC /end REF_CHARACTERISTIC /begin REF_MEASUREMENT /end REF_MEASUREMENT /end GROUP
/begin GROUP DiagMgr11.MtrTrq.MtrNm_f32 "MICROSAR RTE" /begin SUB_GROUP /end SUB_GROUP /begin FUNCTION_LIST /end FUNCTION_LIST /begin REF_CHARACTERISTIC /end REF_CHARACTERISTIC /begin REF_MEASUREMENT Rte_TranlDampg_MRFMtrTrqCmd_MtrNm_f32 /end REF_MEASUREMENT /end GROUP
/begin GROUP DiagMgr11.ReceiverPorts "MICROSAR RTE"
 /begin SUB_GROUP DiagMgr11.HwTrq.HwNm_f32 DiagMgr11.IgnCnt.Cnt_u16 DiagMgr11.MEC.Cnt_enum DiagMgr11.MfgDiagInhibit.Cnt_lgc DiagMgr11.MtrTrq.MtrNm_f32 DiagMgr11.VehSpd.Kph_f32 /end SUB_GROUP
 /begin FUNCTION_LIST /end FUNCTION_LIST
 /begin REF_CHARACTERISTIC /end REF_CHARACTERISTIC
 /begin REF_MEASUREMENT /end REF_MEASUREMENT
/end GROUP
/begin GROUP DiagMgr11.SystemState.Mode "MICROSAR RTE" /begin SUB_GROUP /end SUB_GROUP /begin FUNCTION_LIST /end FUNCTION_LIST /begin REF_CHARACTERISTIC /end REF_CHARACTERISTIC /begin REF_MEASUREMENT Rte_ModeMachine_StaMd11_SystemState11_Mode /end REF_MEASUREMENT /end GROUP
/begin GROUP DiagMgr11.VehSpd.Kph_f32 "MICROSAR RTE" /begin SUB_GROUP /end SUB_GROUP /begin FUNCTION_LIST /end FUNCTION_LIST /begin REF_CHARACTERISTIC /end REF_CHARACTERISTIC /end GROUP
/begin GROUP DiagMgr6 "MICROSAR RTE" /begin SUB_GROUP DiagMgr6.ModeRequirePorts DiagMgr6.ReceiverPorts /end SUB_GROUP /begin FUNCTION_LIST /end FUNCTION_LIST /begin REF_CHARACTERISTIC /end REF_CHARACTERISTIC /begin REF_MEASUREMENT /end REF_MEASUREMENT /end GROUP
/begin GROUP DiagMgr6.HwTrq.HwNm_f32 "MICROSAR RTE" /begin SUB_GROUP /end SUB_GROUP /begin FUNCTION_LIST /end FUNCTION_LIST /begin REF_CHARACTERISTIC /end REF_CHARACTERISTIC /end GROUP
/begin GROUP DiagMgr6.IgnCnt.Cnt_u16 "MICROSAR RTE" /begin SUB_GROUP /end SUB_GROUP /begin FUNCTION_LIST /end FUNCTION_LIST /begin REF_CHARACTERISTIC /end REF_CHARACTERISTIC /begin REF_MEASUREMENT Rte_CDDInterface9_IgnCnt_Cnt_u16 /end REF_MEASUREMENT /end GROUP
/begin GROUP DiagMgr6.MEC.Cnt_enum "MICROSAR RTE" /begin SUB_GROUP /end SUB_GROUP /begin FUNCTION_LIST /end FUNCTION_LIST /begin REF_CHARACTERISTIC /end REF_CHARACTERISTIC /end GROUP
/begin GROUP DiagMgr6.MfgDiagInhibit.Cnt_lgc "MICROSAR RTE" /begin SUB_GROUP /end SUB_GROUP /begin FUNCTION_LIST /end FUNCTION_LIST /begin REF_CHARACTERISTIC /end REF_CHARACTERISTIC /end GROUP
/begin GROUP DiagMgr6.ModeRequirePorts "MICROSAR RTE" /begin SUB_GROUP DiagMgr6.SystemState.Mode /end SUB_GROUP /begin FUNCTION_LIST /end FUNCTION_LIST /begin REF_CHARACTERISTIC /end REF_CHARACTERISTIC /begin REF_MEASUREMENT /end REF_MEASUREMENT /end GROUP
/begin GROUP DiagMgr6.MtrTrq.MtrNm_f32 "MICROSAR RTE" /begin SUB_GROUP /end SUB_GROUP /begin FUNCTION_LIST /end FUNCTION_LIST /begin REF_CHARACTERISTIC /end REF_CHARACTERISTIC /begin REF_MEASUREMENT Rte_TranlDampg_MRFMtrTrqCmd_MtrNm_f32 /end REF_MEASUREMENT /end GROUP
/begin GROUP DiagMgr6.ReceiverPorts "MICROSAR RTE"
 /begin SUB_GROUP DiagMgr6.HwTrq.HwNm_f32 DiagMgr6.IgnCnt.Cnt_u16 DiagMgr6.MEC.Cnt_enum DiagMgr6.MfgDiagInhibit.Cnt_lgc DiagMgr6.MtrTrq.MtrNm_f32 DiagMgr6.VehSpd.Kph_f32 /end SUB_GROUP
 /begin FUNCTION_LIST /end FUNCTION_LIST
 /begin REF_CHARACTERISTIC /end REF_CHARACTERISTIC
 /begin REF_MEASUREMENT /end REF_MEASUREMENT
/end GROUP
/begin GROUP DiagMgr6.SystemState.Mode "MICROSAR RTE" /begin SUB_GROUP /end SUB_GROUP /begin FUNCTION_LIST /end FUNCTION_LIST /begin REF_CHARACTERISTIC /end REF_CHARACTERISTIC /begin REF_MEASUREMENT Rte_ModeMachine_StaMd6_SystemState6_Mode /end REF_MEASUREMENT /end GROUP
/begin GROUP DiagMgr6.VehSpd.Kph_f32 "MICROSAR RTE" /begin SUB_GROUP /end SUB_GROUP /begin FUNCTION_LIST /end FUNCTION_LIST /begin REF_CHARACTERISTIC /end REF_CHARACTERISTIC /end GROUP
/begin GROUP DiagMgr9 "MICROSAR RTE" /begin SUB_GROUP DiagMgr9.ModeRequirePorts DiagMgr9.ReceiverPorts /end SUB_GROUP /begin FUNCTION_LIST /end FUNCTION_LIST /begin REF_CHARACTERISTIC /end REF_CHARACTERISTIC /begin REF_MEASUREMENT /end REF_MEASUREMENT /end GROUP
/begin GROUP DiagMgr9.HwTrq.HwNm_f32 "MICROSAR RTE" /begin SUB_GROUP /end SUB_GROUP /begin FUNCTION_LIST /end FUNCTION_LIST /begin REF_CHARACTERISTIC /end REF_CHARACTERISTIC /end GROUP
/begin GROUP DiagMgr9.IgnCnt.Cnt_u16 "MICROSAR RTE" /begin SUB_GROUP /end SUB_GROUP /begin FUNCTION_LIST /end FUNCTION_LIST /begin REF_CHARACTERISTIC /end REF_CHARACTERISTIC /begin REF_MEASUREMENT Rte_CDDInterface9_IgnCnt_Cnt_u16 /end REF_MEASUREMENT /end GROUP
/begin GROUP DiagMgr9.MEC.Cnt_enum "MICROSAR RTE" /begin SUB_GROUP /end SUB_GROUP /begin FUNCTION_LIST /end FUNCTION_LIST /begin REF_CHARACTERISTIC /end REF_CHARACTERISTIC /end GROUP
/begin GROUP DiagMgr9.MfgDiagInhibit.Cnt_lgc "MICROSAR RTE" /begin SUB_GROUP /end SUB_GROUP /begin FUNCTION_LIST /end FUNCTION_LIST /begin REF_CHARACTERISTIC /end REF_CHARACTERISTIC /end GROUP
/begin GROUP DiagMgr9.ModeRequirePorts "MICROSAR RTE" /begin SUB_GROUP DiagMgr9.SystemState.Mode /end SUB_GROUP /begin FUNCTION_LIST /end FUNCTION_LIST /begin REF_CHARACTERISTIC /end REF_CHARACTERISTIC /begin REF_MEASUREMENT /end REF_MEASUREMENT /end GROUP
/begin GROUP DiagMgr9.MtrTrq.MtrNm_f32 "MICROSAR RTE" /begin SUB_GROUP /end SUB_GROUP /begin FUNCTION_LIST /end FUNCTION_LIST /begin REF_CHARACTERISTIC /end REF_CHARACTERISTIC /begin REF_MEASUREMENT Rte_TranlDampg_MRFMtrTrqCmd_MtrNm_f32 /end REF_MEASUREMENT /end GROUP
/begin GROUP DiagMgr9.ReceiverPorts "MICROSAR RTE"
 /begin SUB_GROUP DiagMgr9.HwTrq.HwNm_f32 DiagMgr9.IgnCnt.Cnt_u16 DiagMgr9.MEC.Cnt_enum DiagMgr9.MfgDiagInhibit.Cnt_lgc DiagMgr9.MtrTrq.MtrNm_f32 DiagMgr9.VehSpd.Kph_f32 /end SUB_GROUP
 /begin FUNCTION_LIST /end FUNCTION_LIST
 /begin REF_CHARACTERISTIC /end REF_CHARACTERISTIC
 /begin REF_MEASUREMENT /end REF_MEASUREMENT
/end GROUP
/begin GROUP DiagMgr9.SystemState.Mode "MICROSAR RTE" /begin SUB_GROUP /end SUB_GROUP /begin FUNCTION_LIST /end FUNCTION_LIST /begin REF_CHARACTERISTIC /end REF_CHARACTERISTIC /end GROUP
/begin GROUP DiagMgr9.VehSpd.Kph_f32 "MICROSAR RTE" /begin SUB_GROUP /end SUB_GROUP /begin FUNCTION_LIST /end FUNCTION_LIST /begin REF_CHARACTERISTIC /end REF_CHARACTERISTIC /end GROUP
/begin GROUP DiagSvc "MICROSAR RTE" /begin SUB_GROUP DiagSvc.ModeRequirePorts DiagSvc.ReceiverPorts /end SUB_GROUP /begin FUNCTION_LIST /end FUNCTION_LIST /begin REF_CHARACTERISTIC /end REF_CHARACTERISTIC /begin REF_MEASUREMENT /end REF_MEASUREMENT /end GROUP
/begin GROUP DiagSvc.BatteryVoltage.Volt_f32 "MICROSAR RTE" /begin SUB_GROUP /end SUB_GROUP /begin FUNCTION_LIST /end FUNCTION_LIST /begin REF_CHARACTERISTIC /end REF_CHARACTERISTIC /end GROUP
/begin GROUP DiagSvc.ECUTemperature.DegC_f32 "MICROSAR RTE" /begin SUB_GROUP /end SUB_GROUP /begin FUNCTION_LIST /end FUNCTION_LIST /begin REF_CHARACTERISTIC /end REF_CHARACTERISTIC /begin REF_MEASUREMENT Rte_CtrlTemp_FiltMeasTemp_DegC_f32 /end REF_MEASUREMENT /end GROUP
/begin GROUP DiagSvc.EngineState.Cnt_u08 "MICROSAR RTE" /begin SUB_GROUP /end SUB_GROUP /begin FUNCTION_LIST /end FUNCTION_LIST /begin REF_CHARACTERISTIC /end REF_CHARACTERISTIC /begin REF_MEASUREMENT Rte_SrlComInput_EtatMTRaw_Cnt_u08 /end REF_MEASUREMENT /end GROUP
/begin GROUP DiagSvc.FinalTorqueCommand.MtrNm_f32 "MICROSAR RTE" /begin SUB_GROUP /end SUB_GROUP /begin FUNCTION_LIST /end FUNCTION_LIST /begin REF_CHARACTERISTIC /end REF_CHARACTERISTIC /begin REF_MEASUREMENT Rte_PwrLmtFuncCr_MRFMtrTrqCmd_MtrNm_f32 /end REF_MEASUREMENT /end GROUP
/begin GROUP DiagSvc.HandwheelAngle.HwDeg_f32 "MICROSAR RTE" /begin SUB_GROUP /end SUB_GROUP /begin FUNCTION_LIST /end FUNCTION_LIST /begin REF_CHARACTERISTIC /end REF_CHARACTERISTIC /end GROUP
/begin GROUP DiagSvc.HandwheelAuthority.Uls_f32 "MICROSAR RTE" /begin SUB_GROUP /end SUB_GROUP /begin FUNCTION_LIST /end FUNCTION_LIST /begin REF_CHARACTERISTIC /end REF_CHARACTERISTIC /end GROUP
/begin GROUP DiagSvc.HandwheelTorque.HwNm_f32 "MICROSAR RTE" /begin SUB_GROUP /end SUB_GROUP /begin FUNCTION_LIST /end FUNCTION_LIST /begin REF_CHARACTERISTIC /end REF_CHARACTERISTIC /end GROUP
/begin GROUP DiagSvc.HandwheelVelocity.HwRadpS_f32 "MICROSAR RTE" /begin SUB_GROUP /end SUB_GROUP /begin FUNCTION_LIST /end FUNCTION_LIST /begin REF_CHARACTERISTIC /end REF_CHARACTERISTIC /end GROUP
/begin GROUP DiagSvc.Mileage.Cnt_u32 "MICROSAR RTE" /begin SUB_GROUP /end SUB_GROUP /begin FUNCTION_LIST /end FUNCTION_LIST /begin REF_CHARACTERISTIC /end REF_CHARACTERISTIC /begin REF_MEASUREMENT Rte_SrlComDriver_Kilometrage_Cnt_u32 /end REF_MEASUREMENT /end GROUP
/begin GROUP DiagSvc.ModeRequirePorts "MICROSAR RTE" /begin SUB_GROUP DiagSvc.SystemState.Mode /end SUB_GROUP /begin FUNCTION_LIST /end FUNCTION_LIST /begin REF_CHARACTERISTIC /end REF_CHARACTERISTIC /begin REF_MEASUREMENT /end REF_MEASUREMENT /end GROUP
/begin GROUP DiagSvc.ReceiverPorts "MICROSAR RTE"
 /begin SUB_GROUP DiagSvc.BatteryVoltage.Volt_f32 DiagSvc.ECUTemperature.DegC_f32 DiagSvc.EngineState.Cnt_u08 DiagSvc.FinalTorqueCommand.MtrNm_f32 DiagSvc.HandwheelAngle.HwDeg_f32 DiagSvc.HandwheelAuthority.Uls_f32 DiagSvc.HandwheelTorque.HwNm_f32 DiagSvc.HandwheelVelocity.HwRadpS_f32 DiagSvc.Mileage.Cnt_u32 DiagSvc.SrlComVehSpd.Kph_f32 DiagSvc.VehicleSpeedValid.Cnt_lgc /end SUB_GROUP
 /begin FUNCTION_LIST /end FUNCTION_LIST
 /begin REF_CHARACTERISTIC /end REF_CHARACTERISTIC
 /begin REF_MEASUREMENT /end REF_MEASUREMENT
/end GROUP
/begin GROUP DiagSvc.SrlComVehSpd.Kph_f32 "MICROSAR RTE" /begin SUB_GROUP /end SUB_GROUP /begin FUNCTION_LIST /end FUNCTION_LIST /begin REF_CHARACTERISTIC /end REF_CHARACTERISTIC /begin REF_MEASUREMENT Rte_SrlComInput_SrlComVehSpd_Kph_f32 /end REF_MEASUREMENT /end GROUP
/begin GROUP DiagSvc.SystemState.Mode "MICROSAR RTE" /begin SUB_GROUP /end SUB_GROUP /begin FUNCTION_LIST /end FUNCTION_LIST /begin REF_CHARACTERISTIC /end REF_CHARACTERISTIC /end GROUP
/begin GROUP DiagSvc.VehicleSpeedValid.Cnt_lgc "MICROSAR RTE" /begin SUB_GROUP /end SUB_GROUP /begin FUNCTION_LIST /end FUNCTION_LIST /begin REF_CHARACTERISTIC /end REF_CHARACTERISTIC /end GROUP
/begin GROUP DigMSB "MICROSAR RTE"
 /begin SUB_GROUP DigMSB.PerInstanceMemories DigMSB.ReceiverPorts DigMSB.SenderPorts /end SUB_GROUP
 /begin FUNCTION_LIST /end FUNCTION_LIST
 /begin REF_CHARACTERISTIC /end REF_CHARACTERISTIC
 /begin REF_MEASUREMENT /end REF_MEASUREMENT
/end GROUP
/begin GROUP DigMSB.AlignedCumMechMtrPosCRF.Deg_f32 "MICROSAR RTE" /begin SUB_GROUP /end SUB_GROUP /begin FUNCTION_LIST /end FUNCTION_LIST /begin REF_CHARACTERISTIC /end REF_CHARACTERISTIC /end GROUP
/begin GROUP DigMSB.AlignedCumMechMtrPosMRF.Deg_f32 "MICROSAR RTE" /begin SUB_GROUP /end SUB_GROUP /begin FUNCTION_LIST /end FUNCTION_LIST /begin REF_CHARACTERISTIC /end REF_CHARACTERISTIC /begin REF_MEASUREMENT Rte_DigMSB_AlignedCumMechMtrPosMRF_Deg_f32 /end REF_MEASUREMENT /end GROUP
/begin GROUP DigMSB.AlignedCumMechMtrPosStatus.Cnt_u08 "MICROSAR RTE" /begin SUB_GROUP /end SUB_GROUP /begin FUNCTION_LIST /end FUNCTION_LIST /begin REF_CHARACTERISTIC /end REF_CHARACTERISTIC /end GROUP
/begin GROUP DigMSB.AssistAssemblyPolarity.Cnt_s08 "MICROSAR RTE" /begin SUB_GROUP /end SUB_GROUP /begin FUNCTION_LIST /end FUNCTION_LIST /begin REF_CHARACTERISTIC /end REF_CHARACTERISTIC /end GROUP
/begin GROUP DigMSB.CorrectedElecMtrPos.Rev_u0p16 "MICROSAR RTE" /begin SUB_GROUP /end SUB_GROUP /begin FUNCTION_LIST /end FUNCTION_LIST /begin REF_CHARACTERISTIC /end REF_CHARACTERISTIC /end GROUP
/begin GROUP DigMSB.CumMechMtrPos.Rev_f32 "MICROSAR RTE" /begin SUB_GROUP /end SUB_GROUP /begin FUNCTION_LIST /end FUNCTION_LIST /begin REF_CHARACTERISTIC /end REF_CHARACTERISTIC /end GROUP
/begin GROUP DigMSB.CumMechMtrPosCRF.Deg_f32 "MICROSAR RTE" /begin SUB_GROUP /end SUB_GROUP /begin FUNCTION_LIST /end FUNCTION_LIST /begin REF_CHARACTERISTIC /end REF_CHARACTERISTIC /end GROUP
/begin GROUP DigMSB.CumMechMtrPosMRF.Deg_f32 "MICROSAR RTE" /begin SUB_GROUP /end SUB_GROUP /begin FUNCTION_LIST /end FUNCTION_LIST /begin REF_CHARACTERISTIC /end REF_CHARACTERISTIC /begin REF_MEASUREMENT Rte_DigMSB_CumMechMtrPosMRF_Deg_f32 /end REF_MEASUREMENT /end GROUP
/begin GROUP DigMSB.CumMechMtrPosStatus.Cnt_u08 "MICROSAR RTE" /begin SUB_GROUP /end SUB_GROUP /begin FUNCTION_LIST /end FUNCTION_LIST /begin REF_CHARACTERISTIC /end REF_CHARACTERISTIC /begin REF_MEASUREMENT Rte_DigMSB_CumMechMtrPosStatus_Cnt_u08 /end REF_MEASUREMENT /end GROUP
/begin GROUP DigMSB.Die1RxError.Cnt_u16 "MICROSAR RTE" /begin SUB_GROUP /end SUB_GROUP /begin FUNCTION_LIST /end FUNCTION_LIST /begin REF_CHARACTERISTIC /end REF_CHARACTERISTIC /end GROUP
/begin GROUP DigMSB.Die1RxMtrPos.Cnt_u16 "MICROSAR RTE" /begin SUB_GROUP /end SUB_GROUP /begin FUNCTION_LIST /end FUNCTION_LIST /begin REF_CHARACTERISTIC /end REF_CHARACTERISTIC /end GROUP
/begin GROUP DigMSB.Die1RxRevCtr.Cnt_u16 "MICROSAR RTE" /begin SUB_GROUP /end SUB_GROUP /begin FUNCTION_LIST /end FUNCTION_LIST /begin REF_CHARACTERISTIC /end REF_CHARACTERISTIC /end GROUP
/begin GROUP DigMSB.Die1UnderVoltgFltAccum.Cnt_u16 "MICROSAR RTE" /begin SUB_GROUP /end SUB_GROUP /begin FUNCTION_LIST /end FUNCTION_LIST /begin REF_CHARACTERISTIC /end REF_CHARACTERISTIC /end GROUP
/begin GROUP DigMSB.Die2RxError.Cnt_u16 "MICROSAR RTE" /begin SUB_GROUP /end SUB_GROUP /begin FUNCTION_LIST /end FUNCTION_LIST /begin REF_CHARACTERISTIC /end REF_CHARACTERISTIC /end GROUP
/begin GROUP DigMSB.Die2RxMtrPos.Cnt_u16 "MICROSAR RTE" /begin SUB_GROUP /end SUB_GROUP /begin FUNCTION_LIST /end FUNCTION_LIST /begin REF_CHARACTERISTIC /end REF_CHARACTERISTIC /end GROUP
/begin GROUP DigMSB.Die2RxRevCtr.Cnt_u16 "MICROSAR RTE" /begin SUB_GROUP /end SUB_GROUP /begin FUNCTION_LIST /end FUNCTION_LIST /begin REF_CHARACTERISTIC /end REF_CHARACTERISTIC /end GROUP
/begin GROUP DigMSB.DigMSBEOLData "MICROSAR RTE" /begin SUB_GROUP /end SUB_GROUP /begin FUNCTION_LIST /end FUNCTION_LIST /begin REF_CHARACTERISTIC /end REF_CHARACTERISTIC
 /begin REF_MEASUREMENT Rte_DigMSB_DigMSBEOLData.CRC_Cnt_u16 Rte_DigMSB_DigMSBEOLData.MtrPos1HarCompTbl_Rev_s2p13 Rte_DigMSB_DigMSBEOLData.MtrPos2HarCompTbl_Rev_s2p13 Rte_DigMSB_DigMSBEOLData.MtrPosBEMFRedundant_Rev_u0p16 Rte_DigMSB_DigMSBEOLData.MtrPosBEMF_Rev_u0p16 /end REF_MEASUREMENT
/end GROUP
/begin GROUP DigMSB.MechMtrPos2.Rev_u0p16 "MICROSAR RTE" /begin SUB_GROUP /end SUB_GROUP /begin FUNCTION_LIST /end FUNCTION_LIST /begin REF_CHARACTERISTIC /end REF_CHARACTERISTIC /begin REF_MEASUREMENT Rte_DigMSB_MechMtrPos2_Rev_u0p16 /end REF_MEASUREMENT /end GROUP
/begin GROUP DigMSB.MtrPosPolarity.Cnt_s08 "MICROSAR RTE" /begin SUB_GROUP /end SUB_GROUP /begin FUNCTION_LIST /end FUNCTION_LIST /begin REF_CHARACTERISTIC /end REF_CHARACTERISTIC /end GROUP
/begin GROUP DigMSB.PerInstanceMemories "MICROSAR RTE" /begin SUB_GROUP DigMSB.DigMSBEOLData /end SUB_GROUP /begin FUNCTION_LIST /end FUNCTION_LIST /begin REF_CHARACTERISTIC /end REF_CHARACTERISTIC /begin REF_MEASUREMENT /end REF_MEASUREMENT /end GROUP
/begin GROUP DigMSB.ReceiverPorts "MICROSAR RTE"
 /begin SUB_GROUP DigMSB.AssistAssemblyPolarity.Cnt_s08 DigMSB.CorrectedElecMtrPos.Rev_u0p16 DigMSB.CumMechMtrPos.Rev_f32 DigMSB.Die1RxError.Cnt_u16 DigMSB.Die1RxMtrPos.Cnt_u16 DigMSB.Die1RxRevCtr.Cnt_u16 DigMSB.Die1UnderVoltgFltAccum.Cnt_u16 DigMSB.Die2RxError.Cnt_u16 DigMSB.Die2RxMtrPos.Cnt_u16 DigMSB.Die2RxRevCtr.Cnt_u16 DigMSB.MtrPosPolarity.Cnt_s08 DigMSB.RxMtrPosParityAccum.Cnt_u16 DigMSB.TurnsCounterSelected.Cnt_lgc DigMSB.UncorrMechMtrPos1.Rev_u0p16 /end SUB_GROUP
 /begin FUNCTION_LIST /end FUNCTION_LIST
 /begin REF_CHARACTERISTIC /end REF_CHARACTERISTIC
 /begin REF_MEASUREMENT /end REF_MEASUREMENT
/end GROUP
/begin GROUP DigMSB.RxMtrPosParityAccum.Cnt_u16 "MICROSAR RTE" /begin SUB_GROUP /end SUB_GROUP /begin FUNCTION_LIST /end FUNCTION_LIST /begin REF_CHARACTERISTIC /end REF_CHARACTERISTIC /begin REF_MEASUREMENT Rte_CDDInterface9_RxMtrPosParityAccum_Cnt_u16 /end REF_MEASUREMENT /end GROUP
/begin GROUP DigMSB.SenderPorts "MICROSAR RTE"
 /begin SUB_GROUP DigMSB.AlignedCumMechMtrPosCRF.Deg_f32 DigMSB.AlignedCumMechMtrPosMRF.Deg_f32 DigMSB.AlignedCumMechMtrPosStatus.Cnt_u08 DigMSB.CumMechMtrPosCRF.Deg_f32 DigMSB.CumMechMtrPosMRF.Deg_f32 DigMSB.CumMechMtrPosStatus.Cnt_u08 DigMSB.MechMtrPos2.Rev_u0p16 DigMSB.SysCCumMechMtrPosMRF.Deg_f32 /end SUB_GROUP
 /begin FUNCTION_LIST /end FUNCTION_LIST
 /begin REF_CHARACTERISTIC /end REF_CHARACTERISTIC
 /begin REF_MEASUREMENT /end REF_MEASUREMENT
/end GROUP
/begin GROUP DigMSB.SysCCumMechMtrPosMRF.Deg_f32 "MICROSAR RTE" /begin SUB_GROUP /end SUB_GROUP /begin FUNCTION_LIST /end FUNCTION_LIST /begin REF_CHARACTERISTIC /end REF_CHARACTERISTIC /begin REF_MEASUREMENT Rte_DigMSB_SysCCumMechMtrPosMRF_Deg_f32 /end REF_MEASUREMENT /end GROUP
/begin GROUP DigMSB.TurnsCounterSelected.Cnt_lgc "MICROSAR RTE" /begin SUB_GROUP /end SUB_GROUP /begin FUNCTION_LIST /end FUNCTION_LIST /begin REF_CHARACTERISTIC /end REF_CHARACTERISTIC /end GROUP
/begin GROUP DigMSB.UncorrMechMtrPos1.Rev_u0p16 "MICROSAR RTE" /begin SUB_GROUP /end SUB_GROUP /begin FUNCTION_LIST /end FUNCTION_LIST /begin REF_CHARACTERISTIC /end REF_CHARACTERISTIC /begin REF_MEASUREMENT Rte_CDDInterface9_UncorrMechMtrPos1_Rev_u0p16 /end REF_MEASUREMENT /end GROUP
/begin GROUP DigPhsReasDiag "MICROSAR RTE"
 /begin SUB_GROUP DigPhsReasDiag.ModeRequirePorts DigPhsReasDiag.ReceiverPorts /end SUB_GROUP
 /begin FUNCTION_LIST /end FUNCTION_LIST
 /begin REF_CHARACTERISTIC /end REF_CHARACTERISTIC
 /begin REF_MEASUREMENT /end REF_MEASUREMENT
/end GROUP
/begin GROUP DigPhsReasDiag.ExpectedOnTimeA.Cnt_u32 "MICROSAR RTE" /begin SUB_GROUP /end SUB_GROUP /begin FUNCTION_LIST /end FUNCTION_LIST /begin REF_CHARACTERISTIC /end REF_CHARACTERISTIC /end GROUP
/begin GROUP DigPhsReasDiag.ExpectedOnTimeB.Cnt_u32 "MICROSAR RTE" /begin SUB_GROUP /end SUB_GROUP /begin FUNCTION_LIST /end FUNCTION_LIST /begin REF_CHARACTERISTIC /end REF_CHARACTERISTIC /end GROUP
/begin GROUP DigPhsReasDiag.ExpectedOnTimeC.Cnt_u32 "MICROSAR RTE" /begin SUB_GROUP /end SUB_GROUP /begin FUNCTION_LIST /end FUNCTION_LIST /begin REF_CHARACTERISTIC /end REF_CHARACTERISTIC /begin REF_MEASUREMENT Rte_CDDInterface9_ExpectedOnTimeC_Cnt_u32 /end REF_MEASUREMENT /end GROUP
/begin GROUP DigPhsReasDiag.GateDriveResetActive.Cnt_lgc "MICROSAR RTE" /begin SUB_GROUP /end SUB_GROUP /begin FUNCTION_LIST /end FUNCTION_LIST /begin REF_CHARACTERISTIC /end REF_CHARACTERISTIC /begin REF_MEASUREMENT Rte_MtrDrvDiag_GateDriveResetActive_Cnt_lgc /end REF_MEASUREMENT /end GROUP
/begin GROUP DigPhsReasDiag.LRPRCorrectedMtrPosCaptured.Rev_f32 "MICROSAR RTE" /begin SUB_GROUP /end SUB_GROUP /begin FUNCTION_LIST /end FUNCTION_LIST /begin REF_CHARACTERISTIC /end REF_CHARACTERISTIC /end GROUP
/begin GROUP DigPhsReasDiag.LRPRModulationIndexCaptured.Uls_f32 "MICROSAR RTE" /begin SUB_GROUP /end SUB_GROUP /begin FUNCTION_LIST /end FUNCTION_LIST /begin REF_CHARACTERISTIC /end REF_CHARACTERISTIC /begin REF_MEASUREMENT Rte_CDDInterface9_ModIdxFinal_Uls_f32 /end REF_MEASUREMENT /end GROUP
/begin GROUP DigPhsReasDiag.LRPRPhaseadvanceCaptured.Cnt_s16 "MICROSAR RTE" /begin SUB_GROUP /end SUB_GROUP /begin FUNCTION_LIST /end FUNCTION_LIST /begin REF_CHARACTERISTIC /end REF_CHARACTERISTIC /begin REF_MEASUREMENT Rte_CDDInterface9_LRPRPhaseadvanceCaptured_Cnt_s16 /end REF_MEASUREMENT /end GROUP
/begin GROUP DigPhsReasDiag.MeasuredOnTimeA.Cnt_u32 "MICROSAR RTE" /begin SUB_GROUP /end SUB_GROUP /begin FUNCTION_LIST /end FUNCTION_LIST /begin REF_CHARACTERISTIC /end REF_CHARACTERISTIC /begin REF_MEASUREMENT Rte_PhaseAbcFdbkMeas_MeasuredOnTimeA_Cnt_u32 /end REF_MEASUREMENT /end GROUP
/begin GROUP DigPhsReasDiag.MeasuredOnTimeB.Cnt_u32 "MICROSAR RTE" /begin SUB_GROUP /end SUB_GROUP /begin FUNCTION_LIST /end FUNCTION_LIST /begin REF_CHARACTERISTIC /end REF_CHARACTERISTIC /begin REF_MEASUREMENT Rte_PhaseAbcFdbkMeas_MeasuredOnTimeB_Cnt_u32 /end REF_MEASUREMENT /end GROUP
/begin GROUP DigPhsReasDiag.MeasuredOnTimeC.Cnt_u32 "MICROSAR RTE" /begin SUB_GROUP /end SUB_GROUP /begin FUNCTION_LIST /end FUNCTION_LIST /begin REF_CHARACTERISTIC /end REF_CHARACTERISTIC /begin REF_MEASUREMENT Rte_PhaseAbcFdbkMeas_MeasuredOnTimeC_Cnt_u32 /end REF_MEASUREMENT /end GROUP
/begin GROUP DigPhsReasDiag.ModeRequirePorts "MICROSAR RTE" /begin SUB_GROUP DigPhsReasDiag.SystemState.Mode /end SUB_GROUP /begin FUNCTION_LIST /end FUNCTION_LIST /begin REF_CHARACTERISTIC /end REF_CHARACTERISTIC /begin REF_MEASUREMENT /end REF_MEASUREMENT /end GROUP
/begin GROUP DigPhsReasDiag.MotorVelMRFUnfiltered.MtrRadpS_f32 "MICROSAR RTE" /begin SUB_GROUP /end SUB_GROUP /begin FUNCTION_LIST /end FUNCTION_LIST /begin REF_CHARACTERISTIC /end REF_CHARACTERISTIC /end GROUP
/begin GROUP DigPhsReasDiag.MtrElecMechPolarity.Cnt_s08 "MICROSAR RTE" /begin SUB_GROUP /end SUB_GROUP /begin FUNCTION_LIST /end FUNCTION_LIST /begin REF_CHARACTERISTIC /end REF_CHARACTERISTIC /end GROUP
/begin GROUP DigPhsReasDiag.PDActivateTest.Cnt_lgc "MICROSAR RTE" /begin SUB_GROUP /end SUB_GROUP /begin FUNCTION_LIST /end FUNCTION_LIST /begin REF_CHARACTERISTIC /end REF_CHARACTERISTIC /begin REF_MEASUREMENT Rte_DigPhsReasDiag_PDActivateTest_Cnt_lgc /end REF_MEASUREMENT /end GROUP
/begin GROUP DigPhsReasDiag.ReceiverPorts "MICROSAR RTE"
 /begin SUB_GROUP DigPhsReasDiag.ExpectedOnTimeA.Cnt_u32 DigPhsReasDiag.ExpectedOnTimeB.Cnt_u32 DigPhsReasDiag.ExpectedOnTimeC.Cnt_u32 DigPhsReasDiag.GateDriveResetActive.Cnt_lgc DigPhsReasDiag.LRPRCorrectedMtrPosCaptured.Rev_f32 DigPhsReasDiag.LRPRModulationIndexCaptured.Uls_f32 DigPhsReasDiag.LRPRPhaseadvanceCaptured.Cnt_s16 DigPhsReasDiag.MeasuredOnTimeA.Cnt_u32 DigPhsReasDiag.MeasuredOnTimeB.Cnt_u32 DigPhsReasDiag.MeasuredOnTimeC.Cnt_u32 DigPhsReasDiag.MotorVelMRFUnfiltered.MtrRadpS_f32 DigPhsReasDiag.MtrElecMechPolarity.Cnt_s08 DigPhsReasDiag.PDActivateTest.Cnt_lgc /end SUB_GROUP
 /begin FUNCTION_LIST /end FUNCTION_LIST
 /begin REF_CHARACTERISTIC /end REF_CHARACTERISTIC
 /begin REF_MEASUREMENT /end REF_MEASUREMENT
/end GROUP
/begin GROUP DigPhsReasDiag.SystemState.Mode "MICROSAR RTE" /begin SUB_GROUP /end SUB_GROUP /begin FUNCTION_LIST /end FUNCTION_LIST /begin REF_CHARACTERISTIC /end REF_CHARACTERISTIC /end GROUP
/begin GROUP EOTActuatorMng "MICROSAR RTE" /begin SUB_GROUP EOTActuatorMng.ReceiverPorts EOTActuatorMng.SenderPorts /end SUB_GROUP /begin FUNCTION_LIST /end FUNCTION_LIST /begin REF_CHARACTERISTIC /end REF_CHARACTERISTIC /begin REF_MEASUREMENT /end REF_MEASUREMENT /end GROUP
/begin GROUP EOTActuatorMng.AssistEOTDamping.MtrNm_f32 "MICROSAR RTE" /begin SUB_GROUP /end SUB_GROUP /begin FUNCTION_LIST /end FUNCTION_LIST /begin REF_CHARACTERISTIC /end REF_CHARACTERISTIC /begin REF_MEASUREMENT Rte_EOTActuatorMng_AssistEOTDamping_MtrNm_f32 /end REF_MEASUREMENT /end GROUP
/begin GROUP EOTActuatorMng.AssistEOTGain.Uls_f32 "MICROSAR RTE" /begin SUB_GROUP /end SUB_GROUP /begin FUNCTION_LIST /end FUNCTION_LIST /begin REF_CHARACTERISTIC /end REF_CHARACTERISTIC /begin REF_MEASUREMENT Rte_EOTActuatorMng_AssistEOTGain_Uls_f32 /end REF_MEASUREMENT /end GROUP
/begin GROUP EOTActuatorMng.AssistEOTLimit.MtrNm_f32 "MICROSAR RTE" /begin SUB_GROUP /end SUB_GROUP /begin FUNCTION_LIST /end FUNCTION_LIST /begin REF_CHARACTERISTIC /end REF_CHARACTERISTIC /begin REF_MEASUREMENT Rte_EOTActuatorMng_AssistEOTLimit_MtrNm_f32 /end REF_MEASUREMENT /end GROUP
/begin GROUP EOTActuatorMng.CcwEOT.HwDeg_f32 "MICROSAR RTE" /begin SUB_GROUP /end SUB_GROUP /begin FUNCTION_LIST /end FUNCTION_LIST /begin REF_CHARACTERISTIC /end REF_CHARACTERISTIC /begin REF_MEASUREMENT Rte_LrnEOT_CCWPosition_HwDeg_f32 /end REF_MEASUREMENT /end GROUP
/begin GROUP EOTActuatorMng.CcwFound.Cnt_lgc "MICROSAR RTE" /begin SUB_GROUP /end SUB_GROUP /begin FUNCTION_LIST /end FUNCTION_LIST /begin REF_CHARACTERISTIC /end REF_CHARACTERISTIC /begin REF_MEASUREMENT Rte_LrnEOT_CCWFound_Cnt_lgc /end REF_MEASUREMENT /end GROUP
/begin GROUP EOTActuatorMng.CwEOT.HwDeg_f32 "MICROSAR RTE" /begin SUB_GROUP /end SUB_GROUP /begin FUNCTION_LIST /end FUNCTION_LIST /begin REF_CHARACTERISTIC /end REF_CHARACTERISTIC /begin REF_MEASUREMENT Rte_LrnEOT_CWPosition_HwDeg_f32 /end REF_MEASUREMENT /end GROUP
/begin GROUP EOTActuatorMng.CwFound.Cnt_lgc "MICROSAR RTE" /begin SUB_GROUP /end SUB_GROUP /begin FUNCTION_LIST /end FUNCTION_LIST /begin REF_CHARACTERISTIC /end REF_CHARACTERISTIC /begin REF_MEASUREMENT Rte_LrnEOT_CWFound_Cnt_lgc /end REF_MEASUREMENT /end GROUP
/begin GROUP EOTActuatorMng.EOTDisable.Cnt_lgc "MICROSAR RTE" /begin SUB_GROUP /end SUB_GROUP /begin FUNCTION_LIST /end FUNCTION_LIST /begin REF_CHARACTERISTIC /end REF_CHARACTERISTIC /end GROUP
/begin GROUP EOTActuatorMng.HandWheelAuth.Uls_f32 "MICROSAR RTE" /begin SUB_GROUP /end SUB_GROUP /begin FUNCTION_LIST /end FUNCTION_LIST /begin REF_CHARACTERISTIC /end REF_CHARACTERISTIC /end GROUP
/begin GROUP EOTActuatorMng.HandWheelPos.HwDeg_f32 "MICROSAR RTE" /begin SUB_GROUP /end SUB_GROUP /begin FUNCTION_LIST /end FUNCTION_LIST /begin REF_CHARACTERISTIC /end REF_CHARACTERISTIC /end GROUP
/begin GROUP EOTActuatorMng.HwTorque.HwNm_f32 "MICROSAR RTE" /begin SUB_GROUP /end SUB_GROUP /begin FUNCTION_LIST /end FUNCTION_LIST /begin REF_CHARACTERISTIC /end REF_CHARACTERISTIC /end GROUP
/begin GROUP EOTActuatorMng.MotorVel.MtrRadpS_f32 "MICROSAR RTE" /begin SUB_GROUP /end SUB_GROUP /begin FUNCTION_LIST /end FUNCTION_LIST /begin REF_CHARACTERISTIC /end REF_CHARACTERISTIC /begin REF_MEASUREMENT Rte_MtrVel_MotorVelCRF_MtrRadpS_f32 /end REF_MEASUREMENT /end GROUP
/begin GROUP EOTActuatorMng.PreLimitTorque.MtrNm_f32 "MICROSAR RTE" /begin SUB_GROUP /end SUB_GROUP /begin FUNCTION_LIST /end FUNCTION_LIST /begin REF_CHARACTERISTIC /end REF_CHARACTERISTIC /end GROUP
/begin GROUP EOTActuatorMng.ReceiverPorts "MICROSAR RTE"
 /begin SUB_GROUP EOTActuatorMng.CcwEOT.HwDeg_f32 EOTActuatorMng.CcwFound.Cnt_lgc EOTActuatorMng.CwEOT.HwDeg_f32 EOTActuatorMng.CwFound.Cnt_lgc EOTActuatorMng.EOTDisable.Cnt_lgc EOTActuatorMng.HandWheelAuth.Uls_f32 EOTActuatorMng.HandWheelPos.HwDeg_f32 EOTActuatorMng.HwTorque.HwNm_f32 EOTActuatorMng.MotorVel.MtrRadpS_f32 EOTActuatorMng.PreLimitTorque.MtrNm_f32 EOTActuatorMng.VehicleSpeed.Kph_f32 /end SUB_GROUP
 /begin FUNCTION_LIST /end FUNCTION_LIST
 /begin REF_CHARACTERISTIC /end REF_CHARACTERISTIC
 /begin REF_MEASUREMENT /end REF_MEASUREMENT
/end GROUP
/begin GROUP EOTActuatorMng.SenderPorts "MICROSAR RTE"
 /begin SUB_GROUP EOTActuatorMng.AssistEOTDamping.MtrNm_f32 EOTActuatorMng.AssistEOTGain.Uls_f32 EOTActuatorMng.AssistEOTLimit.MtrNm_f32 /end SUB_GROUP
 /begin FUNCTION_LIST /end FUNCTION_LIST
 /begin REF_CHARACTERISTIC /end REF_CHARACTERISTIC
 /begin REF_MEASUREMENT /end REF_MEASUREMENT
/end GROUP
/begin GROUP EOTActuatorMng.VehicleSpeed.Kph_f32 "MICROSAR RTE" /begin SUB_GROUP /end SUB_GROUP /begin FUNCTION_LIST /end FUNCTION_LIST /begin REF_CHARACTERISTIC /end REF_CHARACTERISTIC /end GROUP
/begin GROUP ElePwr "MICROSAR RTE" /begin SUB_GROUP ElePwr.ReceiverPorts ElePwr.SenderPorts /end SUB_GROUP /begin FUNCTION_LIST /end FUNCTION_LIST /begin REF_CHARACTERISTIC /end REF_CHARACTERISTIC /begin REF_MEASUREMENT /end REF_MEASUREMENT /end GROUP
/begin GROUP ElePwr.ElectricPower.Watt_f32 "MICROSAR RTE" /begin SUB_GROUP /end SUB_GROUP /begin FUNCTION_LIST /end FUNCTION_LIST /begin REF_CHARACTERISTIC /end REF_CHARACTERISTIC /begin REF_MEASUREMENT Rte_ElePwr_ElectricPower_Watt_f32 /end REF_MEASUREMENT /end GROUP
/begin GROUP ElePwr.MtrCurrDax.Amp_f32 "MICROSAR RTE" /begin SUB_GROUP /end SUB_GROUP /begin FUNCTION_LIST /end FUNCTION_LIST /begin REF_CHARACTERISTIC /end REF_CHARACTERISTIC /begin REF_MEASUREMENT Rte_CDDInterface9_MtrCurrDax_Amp_f32 /end REF_MEASUREMENT /end GROUP
/begin GROUP ElePwr.MtrCurrQax.Amp_f32 "MICROSAR RTE" /begin SUB_GROUP /end SUB_GROUP /begin FUNCTION_LIST /end FUNCTION_LIST /begin REF_CHARACTERISTIC /end REF_CHARACTERISTIC /begin REF_MEASUREMENT Rte_CDDInterface9_MtrCurrQax_Amp_f32 /end REF_MEASUREMENT /end GROUP
/begin GROUP ElePwr.MtrVoltDax.Volt_f32 "MICROSAR RTE" /begin SUB_GROUP /end SUB_GROUP /begin FUNCTION_LIST /end FUNCTION_LIST /begin REF_CHARACTERISTIC /end REF_CHARACTERISTIC /begin REF_MEASUREMENT Rte_CDDInterface9_MtrVoltDax_Volt_f32 /end REF_MEASUREMENT /end GROUP
/begin GROUP ElePwr.MtrVoltQax.Volt_f32 "MICROSAR RTE" /begin SUB_GROUP /end SUB_GROUP /begin FUNCTION_LIST /end FUNCTION_LIST /begin REF_CHARACTERISTIC /end REF_CHARACTERISTIC /begin REF_MEASUREMENT Rte_CDDInterface9_MtrVoltQax_Volt_f32 /end REF_MEASUREMENT /end GROUP
/begin GROUP ElePwr.ReceiverPorts "MICROSAR RTE"
 /begin SUB_GROUP ElePwr.MtrCurrDax.Amp_f32 ElePwr.MtrCurrQax.Amp_f32 ElePwr.MtrVoltDax.Volt_f32 ElePwr.MtrVoltQax.Volt_f32 ElePwr.Vecu.Volt_f32 /end SUB_GROUP
 /begin FUNCTION_LIST /end FUNCTION_LIST
 /begin REF_CHARACTERISTIC /end REF_CHARACTERISTIC
 /begin REF_MEASUREMENT /end REF_MEASUREMENT
/end GROUP
/begin GROUP ElePwr.SenderPorts "MICROSAR RTE" /begin SUB_GROUP ElePwr.ElectricPower.Watt_f32 ElePwr.SupplyCurrent.Amp_f32 /end SUB_GROUP /begin FUNCTION_LIST /end FUNCTION_LIST /begin REF_CHARACTERISTIC /end REF_CHARACTERISTIC /begin REF_MEASUREMENT /end REF_MEASUREMENT /end GROUP
/begin GROUP ElePwr.SupplyCurrent.Amp_f32 "MICROSAR RTE" /begin SUB_GROUP /end SUB_GROUP /begin FUNCTION_LIST /end FUNCTION_LIST /begin REF_CHARACTERISTIC /end REF_CHARACTERISTIC /begin REF_MEASUREMENT Rte_ElePwr_SupplyCurrent_Amp_f32 /end REF_MEASUREMENT /end GROUP
/begin GROUP ElePwr.Vecu.Volt_f32 "MICROSAR RTE" /begin SUB_GROUP /end SUB_GROUP /begin FUNCTION_LIST /end FUNCTION_LIST /begin REF_CHARACTERISTIC /end REF_CHARACTERISTIC /end GROUP
/begin GROUP EtDmpFw "MICROSAR RTE" /begin SUB_GROUP EtDmpFw.ReceiverPorts EtDmpFw.SenderPorts /end SUB_GROUP /begin FUNCTION_LIST /end FUNCTION_LIST /begin REF_CHARACTERISTIC /end REF_CHARACTERISTIC /begin REF_MEASUREMENT /end REF_MEASUREMENT /end GROUP
/begin GROUP EtDmpFw.AssistEOTDamping.MtrNm_f32 "MICROSAR RTE" /begin SUB_GROUP /end SUB_GROUP /begin FUNCTION_LIST /end FUNCTION_LIST /begin REF_CHARACTERISTIC /end REF_CHARACTERISTIC /begin REF_MEASUREMENT Rte_EOTActuatorMng_AssistEOTDamping_MtrNm_f32 /end REF_MEASUREMENT /end GROUP
/begin GROUP EtDmpFw.CRFMtrVel.MtrRadpS_f32 "MICROSAR RTE" /begin SUB_GROUP /end SUB_GROUP /begin FUNCTION_LIST /end FUNCTION_LIST /begin REF_CHARACTERISTIC /end REF_CHARACTERISTIC /begin REF_MEASUREMENT Rte_MtrVel_MotorVelCRF_MtrRadpS_f32 /end REF_MEASUREMENT /end GROUP
/begin GROUP EtDmpFw.EOTDampingLtd.MtrNm_f32 "MICROSAR RTE" /begin SUB_GROUP /end SUB_GROUP /begin FUNCTION_LIST /end FUNCTION_LIST /begin REF_CHARACTERISTIC /end REF_CHARACTERISTIC /end GROUP
/begin GROUP EtDmpFw.EOTDisable.Cnt_lgc "MICROSAR RTE" /begin SUB_GROUP /end SUB_GROUP /begin FUNCTION_LIST /end FUNCTION_LIST /begin REF_CHARACTERISTIC /end REF_CHARACTERISTIC /end GROUP
/begin GROUP EtDmpFw.HandwheelAuthority.Uls_f32 "MICROSAR RTE" /begin SUB_GROUP /end SUB_GROUP /begin FUNCTION_LIST /end FUNCTION_LIST /begin REF_CHARACTERISTIC /end REF_CHARACTERISTIC /end GROUP
/begin GROUP EtDmpFw.HandwheelPosition.HwDeg_f32 "MICROSAR RTE" /begin SUB_GROUP /end SUB_GROUP /begin FUNCTION_LIST /end FUNCTION_LIST /begin REF_CHARACTERISTIC /end REF_CHARACTERISTIC /end GROUP
/begin GROUP EtDmpFw.MEC_Counter.Cnt_enum "MICROSAR RTE" /begin SUB_GROUP /end SUB_GROUP /begin FUNCTION_LIST /end FUNCTION_LIST /begin REF_CHARACTERISTIC /end REF_CHARACTERISTIC /end GROUP
/begin GROUP EtDmpFw.ReceiverPorts "MICROSAR RTE"
 /begin SUB_GROUP EtDmpFw.AssistEOTDamping.MtrNm_f32 EtDmpFw.CRFMtrVel.MtrRadpS_f32 EtDmpFw.EOTDisable.Cnt_lgc EtDmpFw.HandwheelAuthority.Uls_f32 EtDmpFw.HandwheelPosition.HwDeg_f32 EtDmpFw.MEC_Counter.Cnt_enum EtDmpFw.Vehicle_Speed.Kph_f32 /end SUB_GROUP
 /begin FUNCTION_LIST /end FUNCTION_LIST
 /begin REF_CHARACTERISTIC /end REF_CHARACTERISTIC
 /begin REF_MEASUREMENT /end REF_MEASUREMENT
/end GROUP
/begin GROUP EtDmpFw.SenderPorts "MICROSAR RTE" /begin SUB_GROUP EtDmpFw.EOTDampingLtd.MtrNm_f32 /end SUB_GROUP /begin FUNCTION_LIST /end FUNCTION_LIST /begin REF_CHARACTERISTIC /end REF_CHARACTERISTIC /begin REF_MEASUREMENT /end REF_MEASUREMENT /end GROUP
/begin GROUP EtDmpFw.Vehicle_Speed.Kph_f32 "MICROSAR RTE" /begin SUB_GROUP /end SUB_GROUP /begin FUNCTION_LIST /end FUNCTION_LIST /begin REF_CHARACTERISTIC /end REF_CHARACTERISTIC /end GROUP
/begin GROUP FaultLog "MICROSAR RTE"
 /begin SUB_GROUP FaultLog.ModeRequirePorts FaultLog.PerInstanceMemories FaultLog.ReceiverPorts /end SUB_GROUP
 /begin FUNCTION_LIST /end FUNCTION_LIST
 /begin REF_CHARACTERISTIC /end REF_CHARACTERISTIC
 /begin REF_MEASUREMENT /end REF_MEASUREMENT
/end GROUP
/begin GROUP FaultLog.BSIDataMissing.Cnt_lgc "MICROSAR RTE" /begin SUB_GROUP /end SUB_GROUP /begin FUNCTION_LIST /end FUNCTION_LIST /begin REF_CHARACTERISTIC /end REF_CHARACTERISTIC /begin REF_MEASUREMENT Rte_SrlComInput_BSIDataMissing_Cnt_lgc /end REF_MEASUREMENT /end GROUP
/begin GROUP FaultLog.BatteryVoltage.Volt_f32 "MICROSAR RTE" /begin SUB_GROUP /end SUB_GROUP /begin FUNCTION_LIST /end FUNCTION_LIST /begin REF_CHARACTERISTIC /end REF_CHARACTERISTIC /end GROUP
/begin GROUP FaultLog.CMMDataMissing.Cnt_lgc "MICROSAR RTE" /begin SUB_GROUP /end SUB_GROUP /begin FUNCTION_LIST /end FUNCTION_LIST /begin REF_CHARACTERISTIC /end REF_CHARACTERISTIC /begin REF_MEASUREMENT Rte_SrlComInput_CMMDataMissing_Cnt_lgc /end REF_MEASUREMENT /end GROUP
/begin GROUP FaultLog.CompteurTemporelVehicule.Cnt_u32 "MICROSAR RTE" /begin SUB_GROUP /end SUB_GROUP /begin FUNCTION_LIST /end FUNCTION_LIST /begin REF_CHARACTERISTIC /end REF_CHARACTERISTIC /begin REF_MEASUREMENT Rte_SrlComInput_CompteurTemporelVehiculeRaw_Cnt_u32 /end REF_MEASUREMENT /end GROUP
/begin GROUP FaultLog.ComputerRazGCT.Cnt_u08 "MICROSAR RTE" /begin SUB_GROUP /end SUB_GROUP /begin FUNCTION_LIST /end FUNCTION_LIST /begin REF_CHARACTERISTIC /end REF_CHARACTERISTIC /begin REF_MEASUREMENT Rte_SrlComInput_ComputerRazGCTRaw_Cnt_u08 /end REF_MEASUREMENT /end GROUP
/begin GROUP FaultLog.CtrlTemp.DegC_f32 "MICROSAR RTE" /begin SUB_GROUP /end SUB_GROUP /begin FUNCTION_LIST /end FUNCTION_LIST /begin REF_CHARACTERISTIC /end REF_CHARACTERISTIC /begin REF_MEASUREMENT Rte_CtrlTemp_FiltMeasTemp_DegC_f32 /end REF_MEASUREMENT /end GROUP
/begin GROUP FaultLog.EngineState.Cnt_u08 "MICROSAR RTE" /begin SUB_GROUP /end SUB_GROUP /begin FUNCTION_LIST /end FUNCTION_LIST /begin REF_CHARACTERISTIC /end REF_CHARACTERISTIC /begin REF_MEASUREMENT Rte_SrlComInput_EtatMTRaw_Cnt_u08 /end REF_MEASUREMENT /end GROUP
/begin GROUP FaultLog.EtatPrincipSev.Cnt_u08 "MICROSAR RTE" /begin SUB_GROUP /end SUB_GROUP /begin FUNCTION_LIST /end FUNCTION_LIST /begin REF_CHARACTERISTIC /end REF_CHARACTERISTIC /begin REF_MEASUREMENT Rte_SrlComInput_EtatPrincipSev_Cnt_u08 /end REF_MEASUREMENT /end GROUP
/begin GROUP FaultLog.EtatReseauElec.Cnt_u08 "MICROSAR RTE" /begin SUB_GROUP /end SUB_GROUP /begin FUNCTION_LIST /end FUNCTION_LIST /begin REF_CHARACTERISTIC /end REF_CHARACTERISTIC /begin REF_MEASUREMENT Rte_SrlComInput_EtatReseauElec_Cnt_u08 /end REF_MEASUREMENT /end GROUP
/begin GROUP FaultLog.FaultLog "MICROSAR RTE" /begin SUB_GROUP /end SUB_GROUP /begin FUNCTION_LIST /end FUNCTION_LIST /begin REF_CHARACTERISTIC /end REF_CHARACTERISTIC
 /begin REF_MEASUREMENT Rte_FaultLog_FaultLog.CTCFailData[0].Byte1_Cnt_u08 Rte_FaultLog_FaultLog.CTCFailData[0].Byte2_Cnt_u08 Rte_FaultLog_FaultLog.CTCFailData[0].Byte3_Cnt_u08 Rte_FaultLog_FaultLog.CTCFailData[0].Byte4_Cnt_u08 Rte_FaultLog_FaultLog.CTCFailData[0].Byte5_Cnt_u08 Rte_FaultLog_FaultLog.CTCFailData[0].Byte6_Cnt_u08 Rte_FaultLog_FaultLog.CTCFailData[0].Reserved1_Cnt_u08 Rte_FaultLog_FaultLog.CTCFailData[0].Reserved2_Cnt_u08 Rte_FaultLog_FaultLog.CTCFailData[10].Byte1_Cnt_u08 Rte_FaultLog_FaultLog.CTCFailData[10].Byte2_Cnt_u08 Rte_FaultLog_FaultLog.CTCFailData[10].Byte3_Cnt_u08 Rte_FaultLog_FaultLog.CTCFailData[10].Byte4_Cnt_u08 Rte_FaultLog_FaultLog.CTCFailData[10].Byte5_Cnt_u08 Rte_FaultLog_FaultLog.CTCFailData[10].Byte6_Cnt_u08 Rte_FaultLog_FaultLog.CTCFailData[10].Reserved1_Cnt_u08 Rte_FaultLog_FaultLog.CTCFailData[10].Reserved2_Cnt_u08 Rte_FaultLog_FaultLog.CTCFailData[11].Byte1_Cnt_u08 Rte_FaultLog_FaultLog.CTCFailData[11].Byte2_Cnt_u08 Rte_FaultLog_FaultLog.CTCFailData[11].Byte3_Cnt_u08 Rte_FaultLog_FaultLog.CTCFailData[11].Byte4_Cnt_u08 Rte_FaultLog_FaultLog.CTCFailData[11].Byte5_Cnt_u08 Rte_FaultLog_FaultLog.CTCFailData[11].Byte6_Cnt_u08 Rte_FaultLog_FaultLog.CTCFailData[11].Reserved1_Cnt_u08 Rte_FaultLog_FaultLog.CTCFailData[11].Reserved2_Cnt_u08 Rte_FaultLog_FaultLog.CTCFailData[12].Byte1_Cnt_u08 Rte_FaultLog_FaultLog.CTCFailData[12].Byte2_Cnt_u08 Rte_FaultLog_FaultLog.CTCFailData[12].Byte3_Cnt_u08 Rte_FaultLog_FaultLog.CTCFailData[12].Byte4_Cnt_u08 Rte_FaultLog_FaultLog.CTCFailData[12].Byte5_Cnt_u08 Rte_FaultLog_FaultLog.CTCFailData[12].Byte6_Cnt_u08 Rte_FaultLog_FaultLog.CTCFailData[12].Reserved1_Cnt_u08 Rte_FaultLog_FaultLog.CTCFailData[12].Reserved2_Cnt_u08 Rte_FaultLog_FaultLog.CTCFailData[13].Byte1_Cnt_u08 Rte_FaultLog_FaultLog.CTCFailData[13].Byte2_Cnt_u08 Rte_FaultLog_FaultLog.CTCFailData[13].Byte3_Cnt_u08 Rte_FaultLog_FaultLog.CTCFailData[13].Byte4_Cnt_u08 Rte_FaultLog_FaultLog.CTCFailData[13].Byte5_Cnt_u08 Rte_FaultLog_FaultLog.CTCFailData[13].Byte6_Cnt_u08 Rte_FaultLog_FaultLog.CTCFailData[13].Reserved1_Cnt_u08 Rte_FaultLog_FaultLog.CTCFailData[13].Reserved2_Cnt_u08 Rte_FaultLog_FaultLog.CTCFailData[14].Byte1_Cnt_u08 Rte_FaultLog_FaultLog.CTCFailData[14].Byte2_Cnt_u08 Rte_FaultLog_FaultLog.CTCFailData[14].Byte3_Cnt_u08 Rte_FaultLog_FaultLog.CTCFailData[14].Byte4_Cnt_u08 Rte_FaultLog_FaultLog.CTCFailData[14].Byte5_Cnt_u08 Rte_FaultLog_FaultLog.CTCFailData[14].Byte6_Cnt_u08 Rte_FaultLog_FaultLog.CTCFailData[14].Reserved1_Cnt_u08 Rte_FaultLog_FaultLog.CTCFailData[14].Reserved2_Cnt_u08 Rte_FaultLog_FaultLog.CTCFailData[15].Byte1_Cnt_u08 Rte_FaultLog_FaultLog.CTCFailData[15].Byte2_Cnt_u08 Rte_FaultLog_FaultLog.CTCFailData[15].Byte3_Cnt_u08 Rte_FaultLog_FaultLog.CTCFailData[15].Byte4_Cnt_u08 Rte_FaultLog_FaultLog.CTCFailData[15].Byte5_Cnt_u08 Rte_FaultLog_FaultLog.CTCFailData[15].Byte6_Cnt_u08 Rte_FaultLog_FaultLog.CTCFailData[15].Reserved1_Cnt_u08 Rte_FaultLog_FaultLog.CTCFailData[15].Reserved2_Cnt_u08 Rte_FaultLog_FaultLog.CTCFailData[16].Byte1_Cnt_u08 Rte_FaultLog_FaultLog.CTCFailData[16].Byte2_Cnt_u08 Rte_FaultLog_FaultLog.CTCFailData[16].Byte3_Cnt_u08 Rte_FaultLog_FaultLog.CTCFailData[16].Byte4_Cnt_u08 Rte_FaultLog_FaultLog.CTCFailData[16].Byte5_Cnt_u08 Rte_FaultLog_FaultLog.CTCFailData[16].Byte6_Cnt_u08 Rte_FaultLog_FaultLog.CTCFailData[16].Reserved1_Cnt_u08 Rte_FaultLog_FaultLog.CTCFailData[16].Reserved2_Cnt_u08 Rte_FaultLog_FaultLog.CTCFailData[17].Byte1_Cnt_u08 Rte_FaultLog_FaultLog.CTCFailData[17].Byte2_Cnt_u08 Rte_FaultLog_FaultLog.CTCFailData[17].Byte3_Cnt_u08 Rte_FaultLog_FaultLog.CTCFailData[17].Byte4_Cnt_u08 Rte_FaultLog_FaultLog.CTCFailData[17].Byte5_Cnt_u08 Rte_FaultLog_FaultLog.CTCFailData[17].Byte6_Cnt_u08 Rte_FaultLog_FaultLog.CTCFailData[17].Reserved1_Cnt_u08 Rte_FaultLog_FaultLog.CTCFailData[17].Reserved2_Cnt_u08 Rte_FaultLog_FaultLog.CTCFailData[18].Byte1_Cnt_u08 Rte_FaultLog_FaultLog.CTCFailData[18].Byte2_Cnt_u08 Rte_FaultLog_FaultLog.CTCFailData[18].Byte3_Cnt_u08 Rte_FaultLog_FaultLog.CTCFailData[18].Byte4_Cnt_u08 Rte_FaultLog_FaultLog.CTCFailData[18].Byte5_Cnt_u08 Rte_FaultLog_FaultLog.CTCFailData[18].Byte6_Cnt_u08 Rte_FaultLog_FaultLog.CTCFailData[18].Reserved1_Cnt_u08 Rte_FaultLog_FaultLog.CTCFailData[18].Reserved2_Cnt_u08 Rte_FaultLog_FaultLog.CTCFailData[19].Byte1_Cnt_u08 Rte_FaultLog_FaultLog.CTCFailData[19].Byte2_Cnt_u08 Rte_FaultLog_FaultLog.CTCFailData[19].Byte3_Cnt_u08 Rte_FaultLog_FaultLog.CTCFailData[19].Byte4_Cnt_u08 Rte_FaultLog_FaultLog.CTCFailData[19].Byte5_Cnt_u08 Rte_FaultLog_FaultLog.CTCFailData[19].Byte6_Cnt_u08 Rte_FaultLog_FaultLog.CTCFailData[19].Reserved1_Cnt_u08 Rte_FaultLog_FaultLog.CTCFailData[19].Reserved2_Cnt_u08 Rte_FaultLog_FaultLog.CTCFailData[1].Byte1_Cnt_u08 Rte_FaultLog_FaultLog.CTCFailData[1].Byte2_Cnt_u08 Rte_FaultLog_FaultLog.CTCFailData[1].Byte3_Cnt_u08 Rte_FaultLog_FaultLog.CTCFailData[1].Byte4_Cnt_u08 Rte_FaultLog_FaultLog.CTCFailData[1].Byte5_Cnt_u08 Rte_FaultLog_FaultLog.CTCFailData[1].Byte6_Cnt_u08 Rte_FaultLog_FaultLog.CTCFailData[1].Reserved1_Cnt_u08 Rte_FaultLog_FaultLog.CTCFailData[1].Reserved2_Cnt_u08 Rte_FaultLog_FaultLog.CTCFailData[20].Byte1_Cnt_u08 Rte_FaultLog_FaultLog.CTCFailData[20].Byte2_Cnt_u08 Rte_FaultLog_FaultLog.CTCFailData[20].Byte3_Cnt_u08 Rte_FaultLog_FaultLog.CTCFailData[20].Byte4_Cnt_u08 Rte_FaultLog_FaultLog.CTCFailData[20].Byte5_Cnt_u08 Rte_FaultLog_FaultLog.CTCFailData[20].Byte6_Cnt_u08 Rte_FaultLog_FaultLog.CTCFailData[20].Reserved1_Cnt_u08 Rte_FaultLog_FaultLog.CTCFailData[20].Reserved2_Cnt_u08 Rte_FaultLog_FaultLog.CTCFailData[21].Byte1_Cnt_u08 Rte_FaultLog_FaultLog.CTCFailData[21].Byte2_Cnt_u08 Rte_FaultLog_FaultLog.CTCFailData[21].Byte3_Cnt_u08 Rte_FaultLog_FaultLog.CTCFailData[21].Byte4_Cnt_u08 Rte_FaultLog_FaultLog.CTCFailData[21].Byte5_Cnt_u08 Rte_FaultLog_FaultLog.CTCFailData[21].Byte6_Cnt_u08 Rte_FaultLog_FaultLog.CTCFailData[21].Reserved1_Cnt_u08 Rte_FaultLog_FaultLog.CTCFailData[21].Reserved2_Cnt_u08 Rte_FaultLog_FaultLog.CTCFailData[22].Byte1_Cnt_u08 Rte_FaultLog_FaultLog.CTCFailData[22].Byte2_Cnt_u08 Rte_FaultLog_FaultLog.CTCFailData[22].Byte3_Cnt_u08 Rte_FaultLog_FaultLog.CTCFailData[22].Byte4_Cnt_u08 Rte_FaultLog_FaultLog.CTCFailData[22].Byte5_Cnt_u08 Rte_FaultLog_FaultLog.CTCFailData[22].Byte6_Cnt_u08 Rte_FaultLog_FaultLog.CTCFailData[22].Reserved1_Cnt_u08 Rte_FaultLog_FaultLog.CTCFailData[22].Reserved2_Cnt_u08 Rte_FaultLog_FaultLog.CTCFailData[23].Byte1_Cnt_u08 Rte_FaultLog_FaultLog.CTCFailData[23].Byte2_Cnt_u08 Rte_FaultLog_FaultLog.CTCFailData[23].Byte3_Cnt_u08 Rte_FaultLog_FaultLog.CTCFailData[23].Byte4_Cnt_u08 Rte_FaultLog_FaultLog.CTCFailData[23].Byte5_Cnt_u08 Rte_FaultLog_FaultLog.CTCFailData[23].Byte6_Cnt_u08 Rte_FaultLog_FaultLog.CTCFailData[23].Reserved1_Cnt_u08 Rte_FaultLog_FaultLog.CTCFailData[23].Reserved2_Cnt_u08 Rte_FaultLog_FaultLog.CTCFailData[24].Byte1_Cnt_u08 Rte_FaultLog_FaultLog.CTCFailData[24].Byte2_Cnt_u08 Rte_FaultLog_FaultLog.CTCFailData[24].Byte3_Cnt_u08 Rte_FaultLog_FaultLog.CTCFailData[24].Byte4_Cnt_u08 Rte_FaultLog_FaultLog.CTCFailData[24].Byte5_Cnt_u08 Rte_FaultLog_FaultLog.CTCFailData[24].Byte6_Cnt_u08 Rte_FaultLog_FaultLog.CTCFailData[24].Reserved1_Cnt_u08 Rte_FaultLog_FaultLog.CTCFailData[24].Reserved2_Cnt_u08 Rte_FaultLog_FaultLog.CTCFailData[25].Byte1_Cnt_u08 Rte_FaultLog_FaultLog.CTCFailData[25].Byte2_Cnt_u08 Rte_FaultLog_FaultLog.CTCFailData[25].Byte3_Cnt_u08 Rte_FaultLog_FaultLog.CTCFailData[25].Byte4_Cnt_u08 Rte_FaultLog_FaultLog.CTCFailData[25].Byte5_Cnt_u08 Rte_FaultLog_FaultLog.CTCFailData[25].Byte6_Cnt_u08 Rte_FaultLog_FaultLog.CTCFailData[25].Reserved1_Cnt_u08 Rte_FaultLog_FaultLog.CTCFailData[25].Reserved2_Cnt_u08 Rte_FaultLog_FaultLog.CTCFailData[26].Byte1_Cnt_u08 Rte_FaultLog_FaultLog.CTCFailData[26].Byte2_Cnt_u08 Rte_FaultLog_FaultLog.CTCFailData[26].Byte3_Cnt_u08 Rte_FaultLog_FaultLog.CTCFailData[26].Byte4_Cnt_u08 Rte_FaultLog_FaultLog.CTCFailData[26].Byte5_Cnt_u08 Rte_FaultLog_FaultLog.CTCFailData[26].Byte6_Cnt_u08 Rte_FaultLog_FaultLog.CTCFailData[26].Reserved1_Cnt_u08 Rte_FaultLog_FaultLog.CTCFailData[26].Reserved2_Cnt_u08 Rte_FaultLog_FaultLog.CTCFailData[27].Byte1_Cnt_u08 Rte_FaultLog_FaultLog.CTCFailData[27].Byte2_Cnt_u08 Rte_FaultLog_FaultLog.CTCFailData[27].Byte3_Cnt_u08 Rte_FaultLog_FaultLog.CTCFailData[27].Byte4_Cnt_u08 Rte_FaultLog_FaultLog.CTCFailData[27].Byte5_Cnt_u08 Rte_FaultLog_FaultLog.CTCFailData[27].Byte6_Cnt_u08 Rte_FaultLog_FaultLog.CTCFailData[27].Reserved1_Cnt_u08 Rte_FaultLog_FaultLog.CTCFailData[27].Reserved2_Cnt_u08 Rte_FaultLog_FaultLog.CTCFailData[28].Byte1_Cnt_u08 Rte_FaultLog_FaultLog.CTCFailData[28].Byte2_Cnt_u08 Rte_FaultLog_FaultLog.CTCFailData[28].Byte3_Cnt_u08 Rte_FaultLog_FaultLog.CTCFailData[28].Byte4_Cnt_u08 Rte_FaultLog_FaultLog.CTCFailData[28].Byte5_Cnt_u08 Rte_FaultLog_FaultLog.CTCFailData[28].Byte6_Cnt_u08 Rte_FaultLog_FaultLog.CTCFailData[28].Reserved1_Cnt_u08 Rte_FaultLog_FaultLog.CTCFailData[28].Reserved2_Cnt_u08 Rte_FaultLog_FaultLog.CTCFailData[29].Byte1_Cnt_u08 Rte_FaultLog_FaultLog.CTCFailData[29].Byte2_Cnt_u08 Rte_FaultLog_FaultLog.CTCFailData[29].Byte3_Cnt_u08 Rte_FaultLog_FaultLog.CTCFailData[29].Byte4_Cnt_u08 Rte_FaultLog_FaultLog.CTCFailData[29].Byte5_Cnt_u08 Rte_FaultLog_FaultLog.CTCFailData[29].Byte6_Cnt_u08 Rte_FaultLog_FaultLog.CTCFailData[29].Reserved1_Cnt_u08 Rte_FaultLog_FaultLog.CTCFailData[29].Reserved2_Cnt_u08 Rte_FaultLog_FaultLog.CTCFailData[2].Byte1_Cnt_u08 Rte_FaultLog_FaultLog.CTCFailData[2].Byte2_Cnt_u08 Rte_FaultLog_FaultLog.CTCFailData[2].Byte3_Cnt_u08 Rte_FaultLog_FaultLog.CTCFailData[2].Byte4_Cnt_u08 Rte_FaultLog_FaultLog.CTCFailData[2].Byte5_Cnt_u08 Rte_FaultLog_FaultLog.CTCFailData[2].Byte6_Cnt_u08 Rte_FaultLog_FaultLog.CTCFailData[2].Reserved1_Cnt_u08 Rte_FaultLog_FaultLog.CTCFailData[2].Reserved2_Cnt_u08 Rte_FaultLog_FaultLog.CTCFailData[30].Byte1_Cnt_u08 Rte_FaultLog_FaultLog.CTCFailData[30].Byte2_Cnt_u08 Rte_FaultLog_FaultLog.CTCFailData[30].Byte3_Cnt_u08 Rte_FaultLog_FaultLog.CTCFailData[30].Byte4_Cnt_u08 Rte_FaultLog_FaultLog.CTCFailData[30].Byte5_Cnt_u08 Rte_FaultLog_FaultLog.CTCFailData[30].Byte6_Cnt_u08 Rte_FaultLog_FaultLog.CTCFailData[30].Reserved1_Cnt_u08 Rte_FaultLog_FaultLog.CTCFailData[30].Reserved2_Cnt_u08 Rte_FaultLog_FaultLog.CTCFailData[31].Byte1_Cnt_u08 Rte_FaultLog_FaultLog.CTCFailData[31].Byte2_Cnt_u08 Rte_FaultLog_FaultLog.CTCFailData[31].Byte3_Cnt_u08 Rte_FaultLog_FaultLog.CTCFailData[31].Byte4_Cnt_u08 Rte_FaultLog_FaultLog.CTCFailData[31].Byte5_Cnt_u08 Rte_FaultLog_FaultLog.CTCFailData[31].Byte6_Cnt_u08 Rte_FaultLog_FaultLog.CTCFailData[31].Reserved1_Cnt_u08 Rte_FaultLog_FaultLog.CTCFailData[31].Reserved2_Cnt_u08 Rte_FaultLog_FaultLog.CTCFailData[32].Byte1_Cnt_u08 /end REF_MEASUREMENT
/end GROUP
/begin GROUP FaultLog.MotorTorque.MtrNm_f32 "MICROSAR RTE" /begin REF_MEASUREMENT Rte_PwrLmtFuncCr_MRFMtrTrqCmd_MtrNm_f32 /end REF_MEASUREMENT /end GROUP
/begin GROUP FaultLog.SystemState.Mode "MICROSAR RTE" /begin REF_MEASUREMENT Rte_ModeMachine_StaMd6_SystemState6_Mode /end REF_MEASUREMENT /end GROUP
/begin GROUP FaultLog.VehicleSpeed.Kph_f32 "MICROSAR RTE" /begin REF_MEASUREMENT Rte_SrlComInput_SrlComVehSpd_Kph_f32 /end REF_MEASUREMENT /end GROUP
/begin GROUP FltInjection.MotorVelCRF.MtrRadpS_f32 "MICROSAR RTE" /begin REF_MEASUREMENT Rte_MtrVel_MotorVelCRF_MtrRadpS_f32 /end REF_MEASUREMENT /end GROUP
/begin GROUP FrqDepDmpnInrtCmp.CRFMotorVel.MtrRadpS_f32 "MICROSAR RTE" /begin REF_MEASUREMENT Rte_MtrVel_MotorVelCRF_MtrRadpS_f32 /end REF_MEASUREMENT /end GROUP
/begin GROUP FrqDepDmpnInrtCmp.FrqDepDmpnInrtCmp.MtrNm_f32 "MICROSAR RTE" /begin REF_MEASUREMENT Rte_FrqDepDmpnInrtCmp_FrqDepDmpnInrtCmp_MtrNm_f32 /end REF_MEASUREMENT /end GROUP
/begin GROUP FrqDepDmpnInrtCmp.VehicleLonAccel.KphpS_f32 "MICROSAR RTE" /begin REF_MEASUREMENT Rte_SignlCondn_Vehicle_LonAccel_KphpS_f32 /end REF_MEASUREMENT /end GROUP
/begin GROUP HiLoadStall.MtrVelCRF.MtrRadpS_f32 "MICROSAR RTE" /begin REF_MEASUREMENT Rte_MtrVel_MotorVelCRF_MtrRadpS_f32 /end REF_MEASUREMENT /end GROUP
/begin GROUP HwTqArbn.MEC_Counter.Cnt_u08 "MICROSAR RTE" /begin REF_MEASUREMENT Rte_CDDInterface9_MECTemp_Cnt_u08 /end REF_MEASUREMENT /end GROUP
/begin GROUP IoHwAb10.SysCVSwitchADC.Cnt_u16 "MICROSAR RTE" /begin REF_MEASUREMENT Rte_CDDInterface9_SysCVSwitchADC_Cnt_u16 /end REF_MEASUREMENT /end GROUP
/begin GROUP IoHwAb10.TemperatureADC.Volt_f32 "MICROSAR RTE" /begin REF_MEASUREMENT Rte_IoHwAb10_TemperatureADC_Volt_f32 /end REF_MEASUREMENT /end GROUP
/begin GROUP LmtCod.AssistEOTGain.Uls_f32 "MICROSAR RTE" /begin REF_MEASUREMENT Rte_EOTActuatorMng_AssistEOTGain_Uls_f32 /end REF_MEASUREMENT /end GROUP
/begin GROUP LmtCod.AssistEOTLimit.MtrNm_f32 "MICROSAR RTE" /begin REF_MEASUREMENT Rte_EOTActuatorMng_AssistEOTLimit_MtrNm_f32 /end REF_MEASUREMENT /end GROUP
/begin GROUP LoaMgr.DiagcStsIvtr1Inactv.Cnt_lgc "MICROSAR RTE" /begin REF_MEASUREMENT Rte_DiagMgr10_DiagStsInverter1Inactive_Cnt_lgc /end REF_MEASUREMENT /end GROUP
/begin GROUP LoaMgr.DiagcStsIvtr2Inactv.Cnt_lgc "MICROSAR RTE" /begin REF_MEASUREMENT Rte_DiagMgr10_DiagStsInverter2Inactive_Cnt_lgc /end REF_MEASUREMENT /end GROUP
/begin GROUP LrnEOT.CCWFound.Cnt_lgc "MICROSAR RTE" /begin REF_MEASUREMENT Rte_LrnEOT_CCWFound_Cnt_lgc /end REF_MEASUREMENT /end GROUP
/begin GROUP LrnEOT.CCWPosition.HwDeg_f32 "MICROSAR RTE" /begin REF_MEASUREMENT Rte_LrnEOT_CCWPosition_HwDeg_f32 /end REF_MEASUREMENT /end GROUP
/begin GROUP LrnEOT.CWFound.Cnt_lgc "MICROSAR RTE" /begin REF_MEASUREMENT Rte_LrnEOT_CWFound_Cnt_lgc /end REF_MEASUREMENT /end GROUP
/begin GROUP LrnEOT.CWPosition.HwDeg_f32 "MICROSAR RTE" /begin REF_MEASUREMENT Rte_LrnEOT_CWPosition_HwDeg_f32 /end REF_MEASUREMENT /end GROUP
/begin GROUP LrnEOT.MtrVelCRF.MtrRadpS_f32 "MICROSAR RTE" /begin REF_MEASUREMENT Rte_MtrVel_MotorVelCRF_MtrRadpS_f32 /end REF_MEASUREMENT /end GROUP
/begin GROUP MtrDrvDiag.GateDriveResetActive.Cnt_lgc "MICROSAR RTE" /begin REF_MEASUREMENT Rte_MtrDrvDiag_GateDriveResetActive_Cnt_lgc /end REF_MEASUREMENT /end GROUP
/begin GROUP MtrTempEst.CtrlTempFinal.DegC_f32 "MICROSAR RTE" /begin REF_MEASUREMENT Rte_CtrlTemp_FiltMeasTemp_DegC_f32 /end REF_MEASUREMENT /end GROUP
/begin GROUP MtrTempEst.CuTempEst.DegC_f32 "MICROSAR RTE" /begin REF_MEASUREMENT Rte_MtrTempEst_CuTempEst_DegC_f32 /end REF_MEASUREMENT /end GROUP
/begin GROUP MtrTempEst.MagTempEst.DegC_f32 "MICROSAR RTE" /begin REF_MEASUREMENT Rte_MtrTempEst_MagTempEst_DegC_f32 /end REF_MEASUREMENT /end GROUP
/begin GROUP MtrTempEst.SiTempEst.DegC_f32 "MICROSAR RTE" /begin REF_MEASUREMENT Rte_MtrTempEst_SiTempEst_DegC_f32 /end REF_MEASUREMENT /end GROUP
/begin GROUP MtrVel.MechMtrPos2.Rev_u0p16 "MICROSAR RTE" /begin REF_MEASUREMENT Rte_DigMSB_MechMtrPos2_Rev_u0p16 /end REF_MEASUREMENT /end GROUP
/begin GROUP MtrVel.MechMtrPos2Timestamp.USec_u32 "MICROSAR RTE" /begin REF_MEASUREMENT Rte_CDDInterface9_MechMtrPos2Timestamp_USec_u32 /end REF_MEASUREMENT /end GROUP
/begin GROUP MtrVel.MotorVelCRF.MtrRadpS_f32 "MICROSAR RTE" /begin REF_MEASUREMENT Rte_MtrVel_MotorVelCRF_MtrRadpS_f32 /end REF_MEASUREMENT /end GROUP
/begin GROUP MtrVel2.MechMtrPos1Timestamp.USec_u32 "MICROSAR RTE" /begin REF_MEASUREMENT Rte_CDDInterface9_MechMtrPos1Timestamp_USec_u32 /end REF_MEASUREMENT /end GROUP
/begin GROUP PSADSG.DampingCmd.MtrNm_f32 "MICROSAR RTE" /begin REF_MEASUREMENT Rte_Damping_DampingCmd_MtrNm_f32 /end REF_MEASUREMENT /end GROUP
/begin GROUP PSADSG.PsaDampgCmd.MtrNm_f32 "MICROSAR RTE" /begin REF_MEASUREMENT Rte_PSADSG_PsaDampgCmd_MtrNm_f32 /end REF_MEASUREMENT /end GROUP
/begin GROUP PSASH.FTermActv.Cnt_lgc "MICROSAR RTE" /begin REF_MEASUREMENT Rte_DiagMgr10_DiagRmpToZeroActive_Cnt_lgc /end REF_MEASUREMENT /end GROUP
/begin GROUP PeakCurrEst.MtrCurrDax.Amp_f32 "MICROSAR RTE" /begin REF_MEASUREMENT Rte_CDDInterface9_MtrCurrDax_Amp_f32 /end REF_MEASUREMENT /end GROUP
/begin GROUP PeakCurrEst.MtrCurrDaxRef.Amp_f32 "MICROSAR RTE" /begin REF_MEASUREMENT Rte_CurrCmd_MtrCurrDaxRef_Amp_f32 /end REF_MEASUREMENT /end GROUP
/begin GROUP PeakCurrEst.MtrCurrQax.Amp_f32 "MICROSAR RTE" /begin REF_MEASUREMENT Rte_CDDInterface9_MtrCurrQax_Amp_f32 /end REF_MEASUREMENT /end GROUP
/begin GROUP PeakCurrEst.MtrCurrQaxRef.Amp_f32 "MICROSAR RTE" /begin REF_MEASUREMENT Rte_CurrCmd_MtrCurrQaxRef_Amp_f32 /end REF_MEASUREMENT /end GROUP
/begin GROUP PhaseAbcFdbkMeas.MeasuredOnTimeA.Cnt_u32 "MICROSAR RTE" /begin REF_MEASUREMENT Rte_PhaseAbcFdbkMeas_MeasuredOnTimeA_Cnt_u32 /end REF_MEASUREMENT /end GROUP
/begin GROUP PhaseAbcFdbkMeas.MeasuredOnTimeB.Cnt_u32 "MICROSAR RTE" /begin REF_MEASUREMENT Rte_PhaseAbcFdbkMeas_MeasuredOnTimeB_Cnt_u32 /end REF_MEASUREMENT /end GROUP
/begin GROUP PhaseAbcFdbkMeas.MeasuredOnTimeC.Cnt_u32 "MICROSAR RTE" /begin REF_MEASUREMENT Rte_PhaseAbcFdbkMeas_MeasuredOnTimeC_Cnt_u32 /end REF_MEASUREMENT /end GROUP
/begin GROUP PosServo.MotorVelCRF.MtrRadpS_f32 "MICROSAR RTE" /begin REF_MEASUREMENT Rte_MtrVel_MotorVelCRF_MtrRadpS_f32 /end REF_MEASUREMENT /end GROUP
/begin GROUP PsaAgArbn.CumMechMtrPosStatus.Cnt_u08 "MICROSAR RTE" /begin REF_MEASUREMENT Rte_DigMSB_CumMechMtrPosStatus_Cnt_u08 /end REF_MEASUREMENT /end GROUP
/begin GROUP PsaAgArbn.MtrVelCRF.MtrRadpS_f32 "MICROSAR RTE" /begin REF_MEASUREMENT Rte_MtrVel_MotorVelCRF_MtrRadpS_f32 /end REF_MEASUREMENT /end GROUP
/begin GROUP PwrLmtFuncCr.CntDisMtrTrqCmdMRF.MtrNm_f32 "MICROSAR RTE" /begin REF_MEASUREMENT Rte_TranlDampg_MRFMtrTrqCmd_MtrNm_f32 /end REF_MEASUREMENT /end GROUP
/begin GROUP PwrLmtFuncCr.EstKe.VpRadpS_f32 "MICROSAR RTE" /begin REF_MEASUREMENT Rte_CurrParamComp_EstKe_VpRadpS_f32 /end REF_MEASUREMENT /end GROUP
/begin GROUP PwrLmtFuncCr.MRFMtrTrqCmd.MtrNm_f32 "MICROSAR RTE" /begin REF_MEASUREMENT Rte_PwrLmtFuncCr_MRFMtrTrqCmd_MtrNm_f32 /end REF_MEASUREMENT /end GROUP
/begin GROUP QuadDet.MRFCumMtrPos.Deg_f32 "MICROSAR RTE" /begin REF_MEASUREMENT Rte_DigMSB_CumMechMtrPosMRF_Deg_f32 /end REF_MEASUREMENT /end GROUP
/begin GROUP QuadDet.MRFMtrTrqCmdScl.MtrNm_f32 "MICROSAR RTE" /begin REF_MEASUREMENT Rte_TrqCmdScl_MRFMtrTrqCmdScl_MtrNm_f32 /end REF_MEASUREMENT /end GROUP
/begin GROUP QuadDet.MtrQuad.Cnt_u08 "MICROSAR RTE" /begin REF_MEASUREMENT Rte_QuadDet_MtrQuad_Cnt_u08 /end REF_MEASUREMENT /end GROUP
/begin GROUP RteErrata11.SystemState.Mode "MICROSAR RTE" /begin REF_MEASUREMENT Rte_ModeMachine_StaMd11_SystemState11_Mode /end REF_MEASUREMENT /end GROUP
/begin GROUP RteErrata6.SystemState.Mode "MICROSAR RTE" /begin REF_MEASUREMENT Rte_ModeMachine_StaMd6_SystemState6_Mode /end REF_MEASUREMENT /end GROUP
/begin GROUP SignlCondn.SrlComVehSpeed.Kph_f32 "MICROSAR RTE" /begin REF_MEASUREMENT Rte_SrlComInput_SrlComVehSpd_Kph_f32 /end REF_MEASUREMENT /end GROUP
/begin GROUP SignlCondn.Vehicle_LonAccel.KphpS_f32 "MICROSAR RTE" /begin REF_MEASUREMENT Rte_SignlCondn_Vehicle_LonAccel_KphpS_f32 /end REF_MEASUREMENT /end GROUP
/begin GROUP SrlComDriver.BusOff.Cnt_lgc "MICROSAR RTE" /begin REF_MEASUREMENT Rte_SrlComDriver_BusOff_Cnt_lgc /end REF_MEASUREMENT /end GROUP
/begin GROUP SrlComDriver.ElectronicIntegration.Cnt_lgc "MICROSAR RTE" /begin REF_MEASUREMENT Rte_SrlComInput_ElectronicIntegration_Cnt_lgc /end REF_MEASUREMENT /end GROUP
/begin GROUP SrlComDriver.Kilometrage.Cnt_u32 "MICROSAR RTE" /begin REF_MEASUREMENT Rte_SrlComDriver_Kilometrage_Cnt_u32 /end REF_MEASUREMENT /end GROUP
/begin GROUP SrlComDriver.SystemState.Mode "MICROSAR RTE" /begin REF_MEASUREMENT Rte_ModeMachine_StaMd6_SystemState6_Mode /end REF_MEASUREMENT /end GROUP
/begin GROUP SrlComInput.BSIDataMissing.Cnt_lgc "MICROSAR RTE" /begin REF_MEASUREMENT Rte_SrlComInput_BSIDataMissing_Cnt_lgc /end REF_MEASUREMENT /end GROUP
/begin GROUP SrlComInput.BusOff.Cnt_lgc "MICROSAR RTE" /begin REF_MEASUREMENT Rte_SrlComDriver_BusOff_Cnt_lgc /end REF_MEASUREMENT /end GROUP
/begin GROUP SrlComInput.CMMDataMissing.Cnt_lgc "MICROSAR RTE" /begin REF_MEASUREMENT Rte_SrlComInput_CMMDataMissing_Cnt_lgc /end REF_MEASUREMENT /end GROUP
/begin GROUP SrlComInput.CTermActive.Cnt_lgc "MICROSAR RTE" /begin REF_MEASUREMENT Rte_VehPwrMd_CTermActive_Cnt_lgc /end REF_MEASUREMENT /end GROUP
/begin GROUP SrlComInput.CompteurTemporelVehiculeRaw.Cnt_u32 "MICROSAR RTE" /begin REF_MEASUREMENT Rte_SrlComInput_CompteurTemporelVehiculeRaw_Cnt_u32 /end REF_MEASUREMENT /end GROUP
/begin GROUP SrlComInput.ComputerRazGCTRaw.Cnt_u08 "MICROSAR RTE" /begin REF_MEASUREMENT Rte_SrlComInput_ComputerRazGCTRaw_Cnt_u08 /end REF_MEASUREMENT /end GROUP
/begin GROUP SrlComInput.DefaultVehSpd.Cnt_lgc "MICROSAR RTE" /begin REF_MEASUREMENT Rte_DiagMgr10_DiagStsDefVehSpd_Cnt_lgc /end REF_MEASUREMENT /end GROUP
/begin GROUP SrlComInput.DmdDelestDaSts.Cnt_u08 "MICROSAR RTE" /begin REF_MEASUREMENT Rte_SrlComInput_DmdDelestDaSts_Cnt_u08 /end REF_MEASUREMENT /end GROUP
/begin GROUP SrlComInput.ElectronicIntegration.Cnt_lgc "MICROSAR RTE" /begin REF_MEASUREMENT Rte_SrlComInput_ElectronicIntegration_Cnt_lgc /end REF_MEASUREMENT /end GROUP
/begin GROUP SrlComInput.EngOn.Cnt_lgc "MICROSAR RTE" /begin REF_MEASUREMENT Rte_SrlComInput_EngOn_Cnt_lgc /end REF_MEASUREMENT /end GROUP
/begin GROUP SrlComInput.EtatMTRaw.Cnt_u08 "MICROSAR RTE" /begin REF_MEASUREMENT Rte_SrlComInput_EtatMTRaw_Cnt_u08 /end REF_MEASUREMENT /end GROUP
/begin GROUP SrlComInput.EtatPrincipSev.Cnt_u08 "MICROSAR RTE" /begin REF_MEASUREMENT Rte_SrlComInput_EtatPrincipSev_Cnt_u08 /end REF_MEASUREMENT /end GROUP
/begin GROUP SrlComInput.EtatReseauElec.Cnt_u08 "MICROSAR RTE" /begin REF_MEASUREMENT Rte_SrlComInput_EtatReseauElec_Cnt_u08 /end REF_MEASUREMENT /end GROUP
/begin GROUP SrlComInput.KilometrageIn.Cnt_u32 "MICROSAR RTE" /begin REF_MEASUREMENT Rte_SrlComDriver_Kilometrage_Cnt_u32 /end REF_MEASUREMENT /end GROUP
/begin GROUP SrlComInput.SrlComVehSpd.Kph_f32 "MICROSAR RTE" /begin REF_MEASUREMENT Rte_SrlComInput_SrlComVehSpd_Kph_f32 /end REF_MEASUREMENT /end GROUP
/begin GROUP SrlComInput.ValidEngineStatus.Cnt_lgc "MICROSAR RTE" /begin REF_MEASUREMENT Rte_SrlComInput_ValidEngineStatus_Cnt_lgc /end REF_MEASUREMENT /end GROUP
/begin GROUP SrlComOutput.CTCFailed.Cnt_lgc "MICROSAR RTE" /begin REF_MEASUREMENT Rte_DemIf_CTCFailed_Cnt_lgc /end REF_MEASUREMENT /end GROUP
/begin GROUP SrlComOutput.DefaultHwaSCommExportValue.Cnt_lgc "MICROSAR RTE" /begin REF_MEASUREMENT Rte_DiagMgr10_DiagStsScomHWANotValid_Cnt_lgc /end REF_MEASUREMENT /end GROUP
/begin GROUP SrlComOutput.EtatMT.Cnt_u08 "MICROSAR RTE" /begin REF_MEASUREMENT Rte_SrlComInput_EtatMTRaw_Cnt_u08 /end REF_MEASUREMENT /end GROUP
/begin GROUP SrlComOutput.ValidEngineStatus.Cnt_lgc "MICROSAR RTE" /begin REF_MEASUREMENT Rte_SrlComInput_ValidEngineStatus_Cnt_lgc /end REF_MEASUREMENT /end GROUP
/begin GROUP StOpCtrl.DiagRampRate.XpmS_f32 "MICROSAR RTE" /begin REF_MEASUREMENT Rte_DiagMgr10_DiagRampRate_XpmS_f32 /end REF_MEASUREMENT /end GROUP
/begin GROUP StOpCtrl.DiagRampValue.Uls_f32 "MICROSAR RTE" /begin REF_MEASUREMENT Rte_DiagMgr10_DiagRampValue_Uls_f32 /end REF_MEASUREMENT /end GROUP
/begin GROUP StOpCtrl.DiagStsDiagRmpActive.Cnt_lgc "MICROSAR RTE" /begin REF_MEASUREMENT Rte_DiagMgr10_DiagRmpToZeroActive_Cnt_lgc /end REF_MEASUREMENT /end GROUP
/begin GROUP StaMd.CTerm.Cnt_lgc "MICROSAR RTE" /begin REF_MEASUREMENT Rte_VehPwrMd_CTermActive_Cnt_lgc /end REF_MEASUREMENT /end GROUP
/begin GROUP StaMd.FTerm.Cnt_lgc "MICROSAR RTE" /begin REF_MEASUREMENT Rte_DiagMgr10_DiagRmpToZeroActive_Cnt_lgc /end REF_MEASUREMENT /end GROUP
/begin GROUP StaMd11.CTerm.Cnt_lgc "MICROSAR RTE" /begin REF_MEASUREMENT Rte_VehPwrMd_CTermActive_Cnt_lgc /end REF_MEASUREMENT /end GROUP
/begin GROUP StaMd11.FTerm.Cnt_lgc "MICROSAR RTE" /begin REF_MEASUREMENT Rte_DiagMgr10_DiagRmpToZeroActive_Cnt_lgc /end REF_MEASUREMENT /end GROUP
/begin GROUP StaMd11.SystemState11.Mode "MICROSAR RTE" /begin REF_MEASUREMENT Rte_ModeMachine_StaMd11_SystemState11_Mode /end REF_MEASUREMENT /end GROUP
/begin GROUP StaMd6.SystemState6.Mode "MICROSAR RTE" /begin REF_MEASUREMENT Rte_ModeMachine_StaMd6_SystemState6_Mode /end REF_MEASUREMENT /end GROUP
/begin GROUP ThrmlDutyCycle.CuTempEst.DegC_f32 "MICROSAR RTE" /begin REF_MEASUREMENT Rte_MtrTempEst_CuTempEst_DegC_f32 /end REF_MEASUREMENT /end GROUP
/begin GROUP ThrmlDutyCycle.FiltMeasTemp.DegC_f32 "MICROSAR RTE" /begin REF_MEASUREMENT Rte_CtrlTemp_FiltMeasTemp_DegC_f32 /end REF_MEASUREMENT /end GROUP
/begin GROUP ThrmlDutyCycle.MagTempEst.DegC_f32 "MICROSAR RTE" /begin REF_MEASUREMENT Rte_MtrTempEst_MagTempEst_DegC_f32 /end REF_MEASUREMENT /end GROUP
/begin GROUP ThrmlDutyCycle.MotorVelCRF.MtrRadpS_f32 "MICROSAR RTE" /begin REF_MEASUREMENT Rte_MtrVel_MotorVelCRF_MtrRadpS_f32 /end REF_MEASUREMENT /end GROUP
/begin GROUP ThrmlDutyCycle.SiTempEst.DegC_f32 "MICROSAR RTE" /begin REF_MEASUREMENT Rte_MtrTempEst_SiTempEst_DegC_f32 /end REF_MEASUREMENT /end GROUP
/begin GROUP TqRsDg.CorrMtrPosElec.Rev_f32 "MICROSAR RTE" /begin REF_MEASUREMENT Rte_CDDInterface9_SysCCorrMtrPosElec_Rev_f32 /end REF_MEASUREMENT /end GROUP
/begin GROUP TqRsDg.EstKe.VpRadpS_f32 "MICROSAR RTE" /begin REF_MEASUREMENT Rte_CurrParamComp_EstKe_VpRadpS_f32 /end REF_MEASUREMENT /end GROUP
/begin GROUP TqRsDg.EstR.Ohm_f32 "MICROSAR RTE" /begin REF_MEASUREMENT Rte_CurrParamComp_EstR_Ohm_f32 /end REF_MEASUREMENT /end GROUP
/begin GROUP TqRsDg.MtrCurrDaxRef.Amp_f32 "MICROSAR RTE" /begin REF_MEASUREMENT Rte_CurrCmd_MtrCurrDaxRef_Amp_f32 /end REF_MEASUREMENT /end GROUP
/begin GROUP TqRsDg.MtrCurrQaxFinalRef.Amp_f32 "MICROSAR RTE" /begin REF_MEASUREMENT Rte_CDDInterface9_MtrCurrQaxFinalRef_Amp_f32 /end REF_MEASUREMENT /end GROUP
/begin GROUP TqRsDg.MtrVoltDax.Volt_f32 "MICROSAR RTE" /begin REF_MEASUREMENT Rte_CDDInterface9_MtrVoltDax_Volt_f32 /end REF_MEASUREMENT /end GROUP
/begin GROUP TqRsDg.MtrVoltQax.Volt_f32 "MICROSAR RTE" /begin REF_MEASUREMENT Rte_CDDInterface9_MtrVoltQax_Volt_f32 /end REF_MEASUREMENT /end GROUP
/begin GROUP TranlDampg.CRFMtrVel.MtrRadpS_f32 "MICROSAR RTE" /begin REF_MEASUREMENT Rte_MtrVel_MotorVelCRF_MtrRadpS_f32 /end REF_MEASUREMENT /end GROUP
/begin GROUP TranlDampg.DiagStsF2Active.Cnt_lgc "MICROSAR RTE" /begin REF_MEASUREMENT Rte_DiagMgr10_DiagStsCtrldDisRmpPres_Cnt_lgc /end REF_MEASUREMENT /end GROUP
/begin GROUP TranlDampg.MRFMtrTrqCmd.MtrNm_f32 "MICROSAR RTE" /begin REF_MEASUREMENT Rte_TranlDampg_MRFMtrTrqCmd_MtrNm_f32 /end REF_MEASUREMENT /end GROUP
/begin GROUP TrqCanc.EstKe.VpRadpS_f32 "MICROSAR RTE" /begin REF_MEASUREMENT Rte_CurrParamComp_EstKe_VpRadpS_f32 /end REF_MEASUREMENT /end GROUP
/begin GROUP TrqCanc.EstLd.Henry_f32 "MICROSAR RTE" /begin REF_MEASUREMENT Rte_CurrParamComp_EstLd_Henry_f32 /end REF_MEASUREMENT /end GROUP
/begin GROUP TrqCanc.EstLq.Henry_f32 "MICROSAR RTE" /begin REF_MEASUREMENT Rte_CurrParamComp_EstLq_Henry_f32 /end REF_MEASUREMENT /end GROUP
/begin GROUP TrqCanc.MtrCurrDaxRef.Amp_f32 "MICROSAR RTE" /begin REF_MEASUREMENT Rte_CurrCmd_MtrCurrDaxRef_Amp_f32 /end REF_MEASUREMENT /end GROUP
/begin GROUP TrqCanc.MtrCurrQaxRef.Amp_f32 "MICROSAR RTE" /begin REF_MEASUREMENT Rte_CurrCmd_MtrCurrQaxRef_Amp_f32 /end REF_MEASUREMENT /end GROUP
/begin GROUP TrqCanc.MtrTrqCmdMRFScl.MtrNm_f32 "MICROSAR RTE" /begin REF_MEASUREMENT Rte_TrqCmdScl_MRFMtrTrqCmdScl_MtrNm_f32 /end REF_MEASUREMENT /end GROUP
/begin GROUP TrqCmdScl.MRFMtrTrqCmd.MtrNm_f32 "MICROSAR RTE" /begin REF_MEASUREMENT Rte_PwrLmtFuncCr_MRFMtrTrqCmd_MtrNm_f32 /end REF_MEASUREMENT /end GROUP
/begin GROUP TrqCmdScl.MRFMtrTrqCmdScl.MtrNm_f32 "MICROSAR RTE" /begin REF_MEASUREMENT Rte_TrqCmdScl_MRFMtrTrqCmdScl_MtrNm_f32 /end REF_MEASUREMENT /end GROUP
/begin GROUP TrqLOA.MtrVelCRF.MtrRadpS_f32 "MICROSAR RTE" /begin REF_MEASUREMENT Rte_MtrVel_MotorVelCRF_MtrRadpS_f32 /end REF_MEASUREMENT /end GROUP
/begin GROUP VehDyn.CCWPosition.HwDeg_f32 "MICROSAR RTE" /begin REF_MEASUREMENT Rte_LrnEOT_CCWPosition_HwDeg_f32 /end REF_MEASUREMENT /end GROUP
/begin GROUP VehDyn.CWPosition.HwDeg_f32 "MICROSAR RTE" /begin REF_MEASUREMENT Rte_LrnEOT_CWPosition_HwDeg_f32 /end REF_MEASUREMENT /end GROUP
/begin GROUP VehDyn.MtrVelCRF.MtrRadpS_f32 "MICROSAR RTE" /begin REF_MEASUREMENT Rte_MtrVel_MotorVelCRF_MtrRadpS_f32 /end REF_MEASUREMENT /end GROUP
/begin GROUP VehPwrMd.CTermActive.Cnt_lgc "MICROSAR RTE" /begin REF_MEASUREMENT Rte_VehPwrMd_CTermActive_Cnt_lgc /end REF_MEASUREMENT /end GROUP
/begin GROUP VehPwrMd.DmdDelestDASts.Cnt_u08 "MICROSAR RTE" /begin REF_MEASUREMENT Rte_SrlComInput_DmdDelestDaSts_Cnt_u08 /end REF_MEASUREMENT /end GROUP
/begin GROUP VehPwrMd.EngOn.Cnt_lgc "MICROSAR RTE" /begin REF_MEASUREMENT Rte_SrlComInput_EngOn_Cnt_lgc /end REF_MEASUREMENT /end GROUP
/begin GROUP VehPwrMd.EtatMT.Cnt_u08 "MICROSAR RTE" /begin REF_MEASUREMENT Rte_SrlComInput_EtatMTRaw_Cnt_u08 /end REF_MEASUREMENT /end GROUP
/begin GROUP VehPwrMd.SrlComVehSpd.Kph_f32 "MICROSAR RTE" /begin REF_MEASUREMENT Rte_SrlComInput_SrlComVehSpd_Kph_f32 /end REF_MEASUREMENT /end GROUP
/begin GROUP VehSpdLmt.CCWPosition.HwDeg_f32 "MICROSAR RTE" /begin REF_MEASUREMENT Rte_LrnEOT_CCWPosition_HwDeg_f32 /end REF_MEASUREMENT /end GROUP
/begin GROUP VehSpdLmt.CWPosition.HwDeg_f32 "MICROSAR RTE" /begin REF_MEASUREMENT Rte_LrnEOT_CWPosition_HwDeg_f32 /end REF_MEASUREMENT /end GROUP
/begin GROUP ePWM2.DiagStsCtrldDisRmpPres.Cnt_lgc "MICROSAR RTE" /begin REF_MEASUREMENT Rte_DiagMgr10_DiagStsCtrldDisRmpPres_Cnt_lgc /end REF_MEASUREMENT /end GROUP
/begin GROUP ePWM2.DiagStsNonRecRmpToZeroFltPres.Cnt_lgc "MICROSAR RTE" /begin REF_MEASUREMENT Rte_DiagMgr10_DiagStsNonRecRmpToZeroFltPres_Cnt_lgc /end REF_MEASUREMENT /end GROUP
/begin RECORD_LAYOUT RTE_RL_UWORD FNC_VALUES 1 UWORD ROW_DIR DIRECT /end RECORD_LAYOUT
/begin RECORD_LAYOUT RTE_RL_ULONG FNC_VALUES 1 ULONG ROW_DIR DIRECT /end RECORD_LAYOUT
/**********************************************************************************************************************
* COMPU_METHOD / COMPU_VTAB_RANGE
*********************************************************************************************************************/
/begin COMPU_METHOD RTE_CM_BOOLEAN "" TAB_VERB "%3.1" "" COMPU_TAB_REF RTE_CM_BOOLEAN /end COMPU_METHOD
/begin COMPU_VTAB_RANGE RTE_CM_BOOLEAN "" 2 0 0 "false" 1 255 "true" /end COMPU_VTAB_RANGE
/begin COMPU_METHOD RTE_CM_ENUM_StaMd_Mode "" TAB_VERB "%.1" "" COMPU_TAB_REF RTE_CM_ENUM_StaMd_Mode /end COMPU_METHOD
/begin COMPU_VTAB_RANGE RTE_CM_ENUM_StaMd_Mode "" 5 0 0 "RTE_MODE_StaMd_Mode_DISABLE" 1 1 "RTE_MODE_StaMd_Mode_OFF" 2 2 "RTE_MODE_StaMd_Mode_OPERATE" 3 3 "RTE_MODE_StaMd_Mode_WARMINIT" 4 4 "RTE_TRANSITION_StaMd_Mode" /end COMPU_VTAB_RANGE
