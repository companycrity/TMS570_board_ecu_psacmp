/begin MEASUREMENT Rte_FaultLog_FaultLog.CTCFailData[32].Byte2_Cnt_u08 "MICROSAR RTE" UBYTE NO_COMPU_METHOD 0 0 0 255 ECU_ADDRESS 0 READ_WRITE /end MEASUREMENT
/begin MEASUREMENT Rte_FaultLog_FaultLog.CTCFailData[32].Byte3_Cnt_u08 "MICROSAR RTE" UBYTE NO_COMPU_METHOD 0 0 0 255 ECU_ADDRESS 0 READ_WRITE /end MEASUREMENT
/begin MEASUREMENT Rte_FaultLog_FaultLog.CTCFailData[32].Byte4_Cnt_u08 "MICROSAR RTE" UBYTE NO_COMPU_METHOD 0 0 0 255 ECU_ADDRESS 0 READ_WRITE /end MEASUREMENT
/begin MEASUREMENT Rte_FaultLog_FaultLog.CTCFailData[32].Byte5_Cnt_u08 "MICROSAR RTE" UBYTE NO_COMPU_METHOD 0 0 0 255 ECU_ADDRESS 0 READ_WRITE /end MEASUREMENT
/begin MEASUREMENT Rte_FaultLog_FaultLog.CTCFailData[32].Byte6_Cnt_u08 "MICROSAR RTE" UBYTE NO_COMPU_METHOD 0 0 0 255 ECU_ADDRESS 0 READ_WRITE /end MEASUREMENT
/begin MEASUREMENT Rte_FaultLog_FaultLog.CTCFailData[32].Reserved1_Cnt_u08 "MICROSAR RTE" UBYTE NO_COMPU_METHOD 0 0 0 255 ECU_ADDRESS 0 READ_WRITE /end MEASUREMENT
/begin MEASUREMENT Rte_FaultLog_FaultLog.CTCFailData[32].Reserved2_Cnt_u08 "MICROSAR RTE" UBYTE NO_COMPU_METHOD 0 0 0 255 ECU_ADDRESS 0 READ_WRITE /end MEASUREMENT
/begin MEASUREMENT Rte_FaultLog_FaultLog.CTCFailData[33].Byte1_Cnt_u08 "MICROSAR RTE" UBYTE NO_COMPU_METHOD 0 0 0 255 ECU_ADDRESS 0 READ_WRITE /end MEASUREMENT
/begin MEASUREMENT Rte_FaultLog_FaultLog.CTCFailData[33].Byte2_Cnt_u08 "MICROSAR RTE" UBYTE NO_COMPU_METHOD 0 0 0 255 ECU_ADDRESS 0 READ_WRITE /end MEASUREMENT
/begin MEASUREMENT Rte_FaultLog_FaultLog.CTCFailData[33].Byte3_Cnt_u08 "MICROSAR RTE" UBYTE NO_COMPU_METHOD 0 0 0 255 ECU_ADDRESS 0 READ_WRITE /end MEASUREMENT
/begin MEASUREMENT Rte_FaultLog_FaultLog.CTCFailData[33].Byte4_Cnt_u08 "MICROSAR RTE" UBYTE NO_COMPU_METHOD 0 0 0 255 ECU_ADDRESS 0 READ_WRITE /end MEASUREMENT
/begin MEASUREMENT Rte_FaultLog_FaultLog.CTCFailData[33].Byte5_Cnt_u08 "MICROSAR RTE" UBYTE NO_COMPU_METHOD 0 0 0 255 ECU_ADDRESS 0 READ_WRITE /end MEASUREMENT
/begin MEASUREMENT Rte_FaultLog_FaultLog.CTCFailData[33].Byte6_Cnt_u08 "MICROSAR RTE" UBYTE NO_COMPU_METHOD 0 0 0 255 ECU_ADDRESS 0 READ_WRITE /end MEASUREMENT
/begin MEASUREMENT Rte_FaultLog_FaultLog.CTCFailData[33].Reserved1_Cnt_u08 "MICROSAR RTE" UBYTE NO_COMPU_METHOD 0 0 0 255 ECU_ADDRESS 0 READ_WRITE /end MEASUREMENT
/begin MEASUREMENT Rte_FaultLog_FaultLog.CTCFailData[33].Reserved2_Cnt_u08 "MICROSAR RTE" UBYTE NO_COMPU_METHOD 0 0 0 255 ECU_ADDRESS 0 READ_WRITE /end MEASUREMENT
/begin MEASUREMENT Rte_FaultLog_FaultLog.CTCFailData[34].Byte1_Cnt_u08 "MICROSAR RTE" UBYTE NO_COMPU_METHOD 0 0 0 255 ECU_ADDRESS 0 READ_WRITE /end MEASUREMENT
/begin MEASUREMENT Rte_FaultLog_FaultLog.CTCFailData[34].Byte2_Cnt_u08 "MICROSAR RTE" UBYTE NO_COMPU_METHOD 0 0 0 255 ECU_ADDRESS 0 READ_WRITE /end MEASUREMENT
/begin MEASUREMENT Rte_FaultLog_FaultLog.CTCFailData[34].Byte3_Cnt_u08 "MICROSAR RTE" UBYTE NO_COMPU_METHOD 0 0 0 255 ECU_ADDRESS 0 READ_WRITE /end MEASUREMENT
/begin MEASUREMENT Rte_FaultLog_FaultLog.CTCFailData[34].Byte4_Cnt_u08 "MICROSAR RTE" UBYTE NO_COMPU_METHOD 0 0 0 255 ECU_ADDRESS 0 READ_WRITE /end MEASUREMENT
/begin MEASUREMENT Rte_FaultLog_FaultLog.CTCFailData[34].Byte5_Cnt_u08 "MICROSAR RTE" UBYTE NO_COMPU_METHOD 0 0 0 255 ECU_ADDRESS 0 READ_WRITE /end MEASUREMENT
/begin MEASUREMENT Rte_FaultLog_FaultLog.CTCFailData[34].Byte6_Cnt_u08 "MICROSAR RTE" UBYTE NO_COMPU_METHOD 0 0 0 255 ECU_ADDRESS 0 READ_WRITE /end MEASUREMENT
/begin MEASUREMENT Rte_FaultLog_FaultLog.CTCFailData[34].Reserved1_Cnt_u08 "MICROSAR RTE" UBYTE NO_COMPU_METHOD 0 0 0 255 ECU_ADDRESS 0 READ_WRITE /end MEASUREMENT
/begin MEASUREMENT Rte_FaultLog_FaultLog.CTCFailData[34].Reserved2_Cnt_u08 "MICROSAR RTE" UBYTE NO_COMPU_METHOD 0 0 0 255 ECU_ADDRESS 0 READ_WRITE /end MEASUREMENT
/begin MEASUREMENT Rte_FaultLog_FaultLog.CTCFailData[35].Byte1_Cnt_u08 "MICROSAR RTE" UBYTE NO_COMPU_METHOD 0 0 0 255 ECU_ADDRESS 0 READ_WRITE /end MEASUREMENT
/begin MEASUREMENT Rte_FaultLog_FaultLog.CTCFailData[35].Byte2_Cnt_u08 "MICROSAR RTE" UBYTE NO_COMPU_METHOD 0 0 0 255 ECU_ADDRESS 0 READ_WRITE /end MEASUREMENT
/begin MEASUREMENT Rte_FaultLog_FaultLog.CTCFailData[35].Byte3_Cnt_u08 "MICROSAR RTE" UBYTE NO_COMPU_METHOD 0 0 0 255 ECU_ADDRESS 0 READ_WRITE /end MEASUREMENT
/begin MEASUREMENT Rte_FaultLog_FaultLog.CTCFailData[35].Byte4_Cnt_u08 "MICROSAR RTE" UBYTE NO_COMPU_METHOD 0 0 0 255 ECU_ADDRESS 0 READ_WRITE /end MEASUREMENT
/begin MEASUREMENT Rte_FaultLog_FaultLog.CTCFailData[35].Byte5_Cnt_u08 "MICROSAR RTE" UBYTE NO_COMPU_METHOD 0 0 0 255 ECU_ADDRESS 0 READ_WRITE /end MEASUREMENT
/begin MEASUREMENT Rte_FaultLog_FaultLog.CTCFailData[35].Byte6_Cnt_u08 "MICROSAR RTE" UBYTE NO_COMPU_METHOD 0 0 0 255 ECU_ADDRESS 0 READ_WRITE /end MEASUREMENT
/begin MEASUREMENT Rte_FaultLog_FaultLog.CTCFailData[35].Reserved1_Cnt_u08 "MICROSAR RTE" UBYTE NO_COMPU_METHOD 0 0 0 255 ECU_ADDRESS 0 READ_WRITE /end MEASUREMENT
/begin MEASUREMENT Rte_FaultLog_FaultLog.CTCFailData[35].Reserved2_Cnt_u08 "MICROSAR RTE" UBYTE NO_COMPU_METHOD 0 0 0 255 ECU_ADDRESS 0 READ_WRITE /end MEASUREMENT
/begin MEASUREMENT Rte_FaultLog_FaultLog.CTCFailData[36].Byte1_Cnt_u08 "MICROSAR RTE" UBYTE NO_COMPU_METHOD 0 0 0 255 ECU_ADDRESS 0 READ_WRITE /end MEASUREMENT
/begin MEASUREMENT Rte_FaultLog_FaultLog.CTCFailData[36].Byte2_Cnt_u08 "MICROSAR RTE" UBYTE NO_COMPU_METHOD 0 0 0 255 ECU_ADDRESS 0 READ_WRITE /end MEASUREMENT
/begin MEASUREMENT Rte_FaultLog_FaultLog.CTCFailData[36].Byte3_Cnt_u08 "MICROSAR RTE" UBYTE NO_COMPU_METHOD 0 0 0 255 ECU_ADDRESS 0 READ_WRITE /end MEASUREMENT
/begin MEASUREMENT Rte_FaultLog_FaultLog.CTCFailData[36].Byte4_Cnt_u08 "MICROSAR RTE" UBYTE NO_COMPU_METHOD 0 0 0 255 ECU_ADDRESS 0 READ_WRITE /end MEASUREMENT
/begin MEASUREMENT Rte_FaultLog_FaultLog.CTCFailData[36].Byte5_Cnt_u08 "MICROSAR RTE" UBYTE NO_COMPU_METHOD 0 0 0 255 ECU_ADDRESS 0 READ_WRITE /end MEASUREMENT
/begin MEASUREMENT Rte_FaultLog_FaultLog.CTCFailData[36].Byte6_Cnt_u08 "MICROSAR RTE" UBYTE NO_COMPU_METHOD 0 0 0 255 ECU_ADDRESS 0 READ_WRITE /end MEASUREMENT
/begin MEASUREMENT Rte_FaultLog_FaultLog.CTCFailData[36].Reserved1_Cnt_u08 "MICROSAR RTE" UBYTE NO_COMPU_METHOD 0 0 0 255 ECU_ADDRESS 0 READ_WRITE /end MEASUREMENT
/begin MEASUREMENT Rte_FaultLog_FaultLog.CTCFailData[36].Reserved2_Cnt_u08 "MICROSAR RTE" UBYTE NO_COMPU_METHOD 0 0 0 255 ECU_ADDRESS 0 READ_WRITE /end MEASUREMENT
/begin MEASUREMENT Rte_FaultLog_FaultLog.CTCFailData[37].Byte1_Cnt_u08 "MICROSAR RTE" UBYTE NO_COMPU_METHOD 0 0 0 255 ECU_ADDRESS 0 READ_WRITE /end MEASUREMENT
/begin MEASUREMENT Rte_FaultLog_FaultLog.CTCFailData[37].Byte2_Cnt_u08 "MICROSAR RTE" UBYTE NO_COMPU_METHOD 0 0 0 255 ECU_ADDRESS 0 READ_WRITE /end MEASUREMENT
/begin MEASUREMENT Rte_FaultLog_FaultLog.CTCFailData[37].Byte3_Cnt_u08 "MICROSAR RTE" UBYTE NO_COMPU_METHOD 0 0 0 255 ECU_ADDRESS 0 READ_WRITE /end MEASUREMENT
/begin MEASUREMENT Rte_FaultLog_FaultLog.CTCFailData[37].Byte4_Cnt_u08 "MICROSAR RTE" UBYTE NO_COMPU_METHOD 0 0 0 255 ECU_ADDRESS 0 READ_WRITE /end MEASUREMENT
/begin MEASUREMENT Rte_FaultLog_FaultLog.CTCFailData[37].Byte5_Cnt_u08 "MICROSAR RTE" UBYTE NO_COMPU_METHOD 0 0 0 255 ECU_ADDRESS 0 READ_WRITE /end MEASUREMENT
/begin MEASUREMENT Rte_FaultLog_FaultLog.CTCFailData[37].Byte6_Cnt_u08 "MICROSAR RTE" UBYTE NO_COMPU_METHOD 0 0 0 255 ECU_ADDRESS 0 READ_WRITE /end MEASUREMENT
/begin MEASUREMENT Rte_FaultLog_FaultLog.CTCFailData[37].Reserved1_Cnt_u08 "MICROSAR RTE" UBYTE NO_COMPU_METHOD 0 0 0 255 ECU_ADDRESS 0 READ_WRITE /end MEASUREMENT
/begin MEASUREMENT Rte_FaultLog_FaultLog.CTCFailData[37].Reserved2_Cnt_u08 "MICROSAR RTE" UBYTE NO_COMPU_METHOD 0 0 0 255 ECU_ADDRESS 0 READ_WRITE /end MEASUREMENT
/begin MEASUREMENT Rte_FaultLog_FaultLog.CTCFailData[38].Byte1_Cnt_u08 "MICROSAR RTE" UBYTE NO_COMPU_METHOD 0 0 0 255 ECU_ADDRESS 0 READ_WRITE /end MEASUREMENT
/begin MEASUREMENT Rte_FaultLog_FaultLog.CTCFailData[38].Byte2_Cnt_u08 "MICROSAR RTE" UBYTE NO_COMPU_METHOD 0 0 0 255 ECU_ADDRESS 0 READ_WRITE /end MEASUREMENT
/begin MEASUREMENT Rte_FaultLog_FaultLog.CTCFailData[38].Byte3_Cnt_u08 "MICROSAR RTE" UBYTE NO_COMPU_METHOD 0 0 0 255 ECU_ADDRESS 0 READ_WRITE /end MEASUREMENT
/begin MEASUREMENT Rte_FaultLog_FaultLog.CTCFailData[38].Byte4_Cnt_u08 "MICROSAR RTE" UBYTE NO_COMPU_METHOD 0 0 0 255 ECU_ADDRESS 0 READ_WRITE /end MEASUREMENT
/begin MEASUREMENT Rte_FaultLog_FaultLog.CTCFailData[38].Byte5_Cnt_u08 "MICROSAR RTE" UBYTE NO_COMPU_METHOD 0 0 0 255 ECU_ADDRESS 0 READ_WRITE /end MEASUREMENT
/begin MEASUREMENT Rte_FaultLog_FaultLog.CTCFailData[38].Byte6_Cnt_u08 "MICROSAR RTE" UBYTE NO_COMPU_METHOD 0 0 0 255 ECU_ADDRESS 0 READ_WRITE /end MEASUREMENT
/begin MEASUREMENT Rte_FaultLog_FaultLog.CTCFailData[38].Reserved1_Cnt_u08 "MICROSAR RTE" UBYTE NO_COMPU_METHOD 0 0 0 255 ECU_ADDRESS 0 READ_WRITE /end MEASUREMENT
/begin MEASUREMENT Rte_FaultLog_FaultLog.CTCFailData[38].Reserved2_Cnt_u08 "MICROSAR RTE" UBYTE NO_COMPU_METHOD 0 0 0 255 ECU_ADDRESS 0 READ_WRITE /end MEASUREMENT
/begin MEASUREMENT Rte_FaultLog_FaultLog.CTCFailData[39].Byte1_Cnt_u08 "MICROSAR RTE" UBYTE NO_COMPU_METHOD 0 0 0 255 ECU_ADDRESS 0 READ_WRITE /end MEASUREMENT
/begin MEASUREMENT Rte_FaultLog_FaultLog.CTCFailData[39].Byte2_Cnt_u08 "MICROSAR RTE" UBYTE NO_COMPU_METHOD 0 0 0 255 ECU_ADDRESS 0 READ_WRITE /end MEASUREMENT
/begin MEASUREMENT Rte_FaultLog_FaultLog.CTCFailData[39].Byte3_Cnt_u08 "MICROSAR RTE" UBYTE NO_COMPU_METHOD 0 0 0 255 ECU_ADDRESS 0 READ_WRITE /end MEASUREMENT
/begin MEASUREMENT Rte_FaultLog_FaultLog.CTCFailData[39].Byte4_Cnt_u08 "MICROSAR RTE" UBYTE NO_COMPU_METHOD 0 0 0 255 ECU_ADDRESS 0 READ_WRITE /end MEASUREMENT
/begin MEASUREMENT Rte_FaultLog_FaultLog.CTCFailData[39].Byte5_Cnt_u08 "MICROSAR RTE" UBYTE NO_COMPU_METHOD 0 0 0 255 ECU_ADDRESS 0 READ_WRITE /end MEASUREMENT
/begin MEASUREMENT Rte_FaultLog_FaultLog.CTCFailData[39].Byte6_Cnt_u08 "MICROSAR RTE" UBYTE NO_COMPU_METHOD 0 0 0 255 ECU_ADDRESS 0 READ_WRITE /end MEASUREMENT
/begin MEASUREMENT Rte_FaultLog_FaultLog.CTCFailData[39].Reserved1_Cnt_u08 "MICROSAR RTE" UBYTE NO_COMPU_METHOD 0 0 0 255 ECU_ADDRESS 0 READ_WRITE /end MEASUREMENT
/begin MEASUREMENT Rte_FaultLog_FaultLog.CTCFailData[39].Reserved2_Cnt_u08 "MICROSAR RTE" UBYTE NO_COMPU_METHOD 0 0 0 255 ECU_ADDRESS 0 READ_WRITE /end MEASUREMENT
/begin MEASUREMENT Rte_FaultLog_FaultLog.CTCFailData[3].Byte1_Cnt_u08 "MICROSAR RTE" UBYTE NO_COMPU_METHOD 0 0 0 255 ECU_ADDRESS 0 READ_WRITE /end MEASUREMENT
/begin MEASUREMENT Rte_FaultLog_FaultLog.CTCFailData[3].Byte2_Cnt_u08 "MICROSAR RTE" UBYTE NO_COMPU_METHOD 0 0 0 255 ECU_ADDRESS 0 READ_WRITE /end MEASUREMENT
/begin MEASUREMENT Rte_FaultLog_FaultLog.CTCFailData[3].Byte3_Cnt_u08 "MICROSAR RTE" UBYTE NO_COMPU_METHOD 0 0 0 255 ECU_ADDRESS 0 READ_WRITE /end MEASUREMENT
/begin MEASUREMENT Rte_FaultLog_FaultLog.CTCFailData[3].Byte4_Cnt_u08 "MICROSAR RTE" UBYTE NO_COMPU_METHOD 0 0 0 255 ECU_ADDRESS 0 READ_WRITE /end MEASUREMENT
/begin MEASUREMENT Rte_FaultLog_FaultLog.CTCFailData[3].Byte5_Cnt_u08 "MICROSAR RTE" UBYTE NO_COMPU_METHOD 0 0 0 255 ECU_ADDRESS 0 READ_WRITE /end MEASUREMENT
/begin MEASUREMENT Rte_FaultLog_FaultLog.CTCFailData[3].Byte6_Cnt_u08 "MICROSAR RTE" UBYTE NO_COMPU_METHOD 0 0 0 255 ECU_ADDRESS 0 READ_WRITE /end MEASUREMENT
/begin MEASUREMENT Rte_FaultLog_FaultLog.CTCFailData[3].Reserved1_Cnt_u08 "MICROSAR RTE" UBYTE NO_COMPU_METHOD 0 0 0 255 ECU_ADDRESS 0 READ_WRITE /end MEASUREMENT
/begin MEASUREMENT Rte_FaultLog_FaultLog.CTCFailData[3].Reserved2_Cnt_u08 "MICROSAR RTE" UBYTE NO_COMPU_METHOD 0 0 0 255 ECU_ADDRESS 0 READ_WRITE /end MEASUREMENT
/begin MEASUREMENT Rte_FaultLog_FaultLog.CTCFailData[40].Byte1_Cnt_u08 "MICROSAR RTE" UBYTE NO_COMPU_METHOD 0 0 0 255 ECU_ADDRESS 0 READ_WRITE /end MEASUREMENT
/begin MEASUREMENT Rte_FaultLog_FaultLog.CTCFailData[40].Byte2_Cnt_u08 "MICROSAR RTE" UBYTE NO_COMPU_METHOD 0 0 0 255 ECU_ADDRESS 0 READ_WRITE /end MEASUREMENT
/begin MEASUREMENT Rte_FaultLog_FaultLog.CTCFailData[40].Byte3_Cnt_u08 "MICROSAR RTE" UBYTE NO_COMPU_METHOD 0 0 0 255 ECU_ADDRESS 0 READ_WRITE /end MEASUREMENT
/begin MEASUREMENT Rte_FaultLog_FaultLog.CTCFailData[40].Byte4_Cnt_u08 "MICROSAR RTE" UBYTE NO_COMPU_METHOD 0 0 0 255 ECU_ADDRESS 0 READ_WRITE /end MEASUREMENT
/begin MEASUREMENT Rte_FaultLog_FaultLog.CTCFailData[40].Byte5_Cnt_u08 "MICROSAR RTE" UBYTE NO_COMPU_METHOD 0 0 0 255 ECU_ADDRESS 0 READ_WRITE /end MEASUREMENT
/begin MEASUREMENT Rte_FaultLog_FaultLog.CTCFailData[40].Byte6_Cnt_u08 "MICROSAR RTE" UBYTE NO_COMPU_METHOD 0 0 0 255 ECU_ADDRESS 0 READ_WRITE /end MEASUREMENT
/begin MEASUREMENT Rte_FaultLog_FaultLog.CTCFailData[40].Reserved1_Cnt_u08 "MICROSAR RTE" UBYTE NO_COMPU_METHOD 0 0 0 255 ECU_ADDRESS 0 READ_WRITE /end MEASUREMENT
/begin MEASUREMENT Rte_FaultLog_FaultLog.CTCFailData[40].Reserved2_Cnt_u08 "MICROSAR RTE" UBYTE NO_COMPU_METHOD 0 0 0 255 ECU_ADDRESS 0 READ_WRITE /end MEASUREMENT
/begin MEASUREMENT Rte_FaultLog_FaultLog.CTCFailData[41].Byte1_Cnt_u08 "MICROSAR RTE" UBYTE NO_COMPU_METHOD 0 0 0 255 ECU_ADDRESS 0 READ_WRITE /end MEASUREMENT
/begin MEASUREMENT Rte_FaultLog_FaultLog.CTCFailData[41].Byte2_Cnt_u08 "MICROSAR RTE" UBYTE NO_COMPU_METHOD 0 0 0 255 ECU_ADDRESS 0 READ_WRITE /end MEASUREMENT
/begin MEASUREMENT Rte_FaultLog_FaultLog.CTCFailData[41].Byte3_Cnt_u08 "MICROSAR RTE" UBYTE NO_COMPU_METHOD 0 0 0 255 ECU_ADDRESS 0 READ_WRITE /end MEASUREMENT
/begin MEASUREMENT Rte_FaultLog_FaultLog.CTCFailData[41].Byte4_Cnt_u08 "MICROSAR RTE" UBYTE NO_COMPU_METHOD 0 0 0 255 ECU_ADDRESS 0 READ_WRITE /end MEASUREMENT
/begin MEASUREMENT Rte_FaultLog_FaultLog.CTCFailData[41].Byte5_Cnt_u08 "MICROSAR RTE" UBYTE NO_COMPU_METHOD 0 0 0 255 ECU_ADDRESS 0 READ_WRITE /end MEASUREMENT
/begin MEASUREMENT Rte_FaultLog_FaultLog.CTCFailData[41].Byte6_Cnt_u08 "MICROSAR RTE" UBYTE NO_COMPU_METHOD 0 0 0 255 ECU_ADDRESS 0 READ_WRITE /end MEASUREMENT
/begin MEASUREMENT Rte_FaultLog_FaultLog.CTCFailData[41].Reserved1_Cnt_u08 "MICROSAR RTE" UBYTE NO_COMPU_METHOD 0 0 0 255 ECU_ADDRESS 0 READ_WRITE /end MEASUREMENT
/begin MEASUREMENT Rte_FaultLog_FaultLog.CTCFailData[41].Reserved2_Cnt_u08 "MICROSAR RTE" UBYTE NO_COMPU_METHOD 0 0 0 255 ECU_ADDRESS 0 READ_WRITE /end MEASUREMENT
/begin MEASUREMENT Rte_FaultLog_FaultLog.CTCFailData[42].Byte1_Cnt_u08 "MICROSAR RTE" UBYTE NO_COMPU_METHOD 0 0 0 255 ECU_ADDRESS 0 READ_WRITE /end MEASUREMENT
/begin MEASUREMENT Rte_FaultLog_FaultLog.CTCFailData[42].Byte2_Cnt_u08 "MICROSAR RTE" UBYTE NO_COMPU_METHOD 0 0 0 255 ECU_ADDRESS 0 READ_WRITE /end MEASUREMENT
/begin MEASUREMENT Rte_FaultLog_FaultLog.CTCFailData[42].Byte3_Cnt_u08 "MICROSAR RTE" UBYTE NO_COMPU_METHOD 0 0 0 255 ECU_ADDRESS 0 READ_WRITE /end MEASUREMENT
/begin MEASUREMENT Rte_FaultLog_FaultLog.CTCFailData[42].Byte4_Cnt_u08 "MICROSAR RTE" UBYTE NO_COMPU_METHOD 0 0 0 255 ECU_ADDRESS 0 READ_WRITE /end MEASUREMENT
/begin MEASUREMENT Rte_FaultLog_FaultLog.CTCFailData[42].Byte5_Cnt_u08 "MICROSAR RTE" UBYTE NO_COMPU_METHOD 0 0 0 255 ECU_ADDRESS 0 READ_WRITE /end MEASUREMENT
/begin MEASUREMENT Rte_FaultLog_FaultLog.CTCFailData[42].Byte6_Cnt_u08 "MICROSAR RTE" UBYTE NO_COMPU_METHOD 0 0 0 255 ECU_ADDRESS 0 READ_WRITE /end MEASUREMENT
/begin MEASUREMENT Rte_FaultLog_FaultLog.CTCFailData[42].Reserved1_Cnt_u08 "MICROSAR RTE" UBYTE NO_COMPU_METHOD 0 0 0 255 ECU_ADDRESS 0 READ_WRITE /end MEASUREMENT
/begin MEASUREMENT Rte_FaultLog_FaultLog.CTCFailData[42].Reserved2_Cnt_u08 "MICROSAR RTE" UBYTE NO_COMPU_METHOD 0 0 0 255 ECU_ADDRESS 0 READ_WRITE /end MEASUREMENT
/begin MEASUREMENT Rte_FaultLog_FaultLog.CTCFailData[43].Byte1_Cnt_u08 "MICROSAR RTE" UBYTE NO_COMPU_METHOD 0 0 0 255 ECU_ADDRESS 0 READ_WRITE /end MEASUREMENT
/begin MEASUREMENT Rte_FaultLog_FaultLog.CTCFailData[43].Byte2_Cnt_u08 "MICROSAR RTE" UBYTE NO_COMPU_METHOD 0 0 0 255 ECU_ADDRESS 0 READ_WRITE /end MEASUREMENT
/begin MEASUREMENT Rte_FaultLog_FaultLog.CTCFailData[43].Byte3_Cnt_u08 "MICROSAR RTE" UBYTE NO_COMPU_METHOD 0 0 0 255 ECU_ADDRESS 0 READ_WRITE /end MEASUREMENT
/begin MEASUREMENT Rte_FaultLog_FaultLog.CTCFailData[43].Byte4_Cnt_u08 "MICROSAR RTE" UBYTE NO_COMPU_METHOD 0 0 0 255 ECU_ADDRESS 0 READ_WRITE /end MEASUREMENT
/begin MEASUREMENT Rte_FaultLog_FaultLog.CTCFailData[43].Byte5_Cnt_u08 "MICROSAR RTE" UBYTE NO_COMPU_METHOD 0 0 0 255 ECU_ADDRESS 0 READ_WRITE /end MEASUREMENT
/begin MEASUREMENT Rte_FaultLog_FaultLog.CTCFailData[43].Byte6_Cnt_u08 "MICROSAR RTE" UBYTE NO_COMPU_METHOD 0 0 0 255 ECU_ADDRESS 0 READ_WRITE /end MEASUREMENT
/begin MEASUREMENT Rte_FaultLog_FaultLog.CTCFailData[43].Reserved1_Cnt_u08 "MICROSAR RTE" UBYTE NO_COMPU_METHOD 0 0 0 255 ECU_ADDRESS 0 READ_WRITE /end MEASUREMENT
/begin MEASUREMENT Rte_FaultLog_FaultLog.CTCFailData[43].Reserved2_Cnt_u08 "MICROSAR RTE" UBYTE NO_COMPU_METHOD 0 0 0 255 ECU_ADDRESS 0 READ_WRITE /end MEASUREMENT
/begin MEASUREMENT Rte_FaultLog_FaultLog.CTCFailData[44].Byte1_Cnt_u08 "MICROSAR RTE" UBYTE NO_COMPU_METHOD 0 0 0 255 ECU_ADDRESS 0 READ_WRITE /end MEASUREMENT
/begin MEASUREMENT Rte_FaultLog_FaultLog.CTCFailData[44].Byte2_Cnt_u08 "MICROSAR RTE" UBYTE NO_COMPU_METHOD 0 0 0 255 ECU_ADDRESS 0 READ_WRITE /end MEASUREMENT
/begin MEASUREMENT Rte_FaultLog_FaultLog.CTCFailData[44].Byte3_Cnt_u08 "MICROSAR RTE" UBYTE NO_COMPU_METHOD 0 0 0 255 ECU_ADDRESS 0 READ_WRITE /end MEASUREMENT
/begin MEASUREMENT Rte_FaultLog_FaultLog.CTCFailData[44].Byte4_Cnt_u08 "MICROSAR RTE" UBYTE NO_COMPU_METHOD 0 0 0 255 ECU_ADDRESS 0 READ_WRITE /end MEASUREMENT
/begin MEASUREMENT Rte_FaultLog_FaultLog.CTCFailData[44].Byte5_Cnt_u08 "MICROSAR RTE" UBYTE NO_COMPU_METHOD 0 0 0 255 ECU_ADDRESS 0 READ_WRITE /end MEASUREMENT
/begin MEASUREMENT Rte_FaultLog_FaultLog.CTCFailData[44].Byte6_Cnt_u08 "MICROSAR RTE" UBYTE NO_COMPU_METHOD 0 0 0 255 ECU_ADDRESS 0 READ_WRITE /end MEASUREMENT
/begin MEASUREMENT Rte_FaultLog_FaultLog.CTCFailData[44].Reserved1_Cnt_u08 "MICROSAR RTE" UBYTE NO_COMPU_METHOD 0 0 0 255 ECU_ADDRESS 0 READ_WRITE /end MEASUREMENT
/begin MEASUREMENT Rte_FaultLog_FaultLog.CTCFailData[44].Reserved2_Cnt_u08 "MICROSAR RTE" UBYTE NO_COMPU_METHOD 0 0 0 255 ECU_ADDRESS 0 READ_WRITE /end MEASUREMENT
/begin MEASUREMENT Rte_FaultLog_FaultLog.CTCFailData[45].Byte1_Cnt_u08 "MICROSAR RTE" UBYTE NO_COMPU_METHOD 0 0 0 255 ECU_ADDRESS 0 READ_WRITE /end MEASUREMENT
/begin MEASUREMENT Rte_FaultLog_FaultLog.CTCFailData[45].Byte2_Cnt_u08 "MICROSAR RTE" UBYTE NO_COMPU_METHOD 0 0 0 255 ECU_ADDRESS 0 READ_WRITE /end MEASUREMENT
/begin MEASUREMENT Rte_FaultLog_FaultLog.CTCFailData[45].Byte3_Cnt_u08 "MICROSAR RTE" UBYTE NO_COMPU_METHOD 0 0 0 255 ECU_ADDRESS 0 READ_WRITE /end MEASUREMENT
/begin MEASUREMENT Rte_FaultLog_FaultLog.CTCFailData[45].Byte4_Cnt_u08 "MICROSAR RTE" UBYTE NO_COMPU_METHOD 0 0 0 255 ECU_ADDRESS 0 READ_WRITE /end MEASUREMENT
/begin MEASUREMENT Rte_FaultLog_FaultLog.CTCFailData[45].Byte5_Cnt_u08 "MICROSAR RTE" UBYTE NO_COMPU_METHOD 0 0 0 255 ECU_ADDRESS 0 READ_WRITE /end MEASUREMENT
/begin MEASUREMENT Rte_FaultLog_FaultLog.CTCFailData[45].Byte6_Cnt_u08 "MICROSAR RTE" UBYTE NO_COMPU_METHOD 0 0 0 255 ECU_ADDRESS 0 READ_WRITE /end MEASUREMENT
/begin MEASUREMENT Rte_FaultLog_FaultLog.CTCFailData[45].Reserved1_Cnt_u08 "MICROSAR RTE" UBYTE NO_COMPU_METHOD 0 0 0 255 ECU_ADDRESS 0 READ_WRITE /end MEASUREMENT
/begin MEASUREMENT Rte_FaultLog_FaultLog.CTCFailData[45].Reserved2_Cnt_u08 "MICROSAR RTE" UBYTE NO_COMPU_METHOD 0 0 0 255 ECU_ADDRESS 0 READ_WRITE /end MEASUREMENT
/begin MEASUREMENT Rte_FaultLog_FaultLog.CTCFailData[46].Byte1_Cnt_u08 "MICROSAR RTE" UBYTE NO_COMPU_METHOD 0 0 0 255 ECU_ADDRESS 0 READ_WRITE /end MEASUREMENT
/begin MEASUREMENT Rte_FaultLog_FaultLog.CTCFailData[46].Byte2_Cnt_u08 "MICROSAR RTE" UBYTE NO_COMPU_METHOD 0 0 0 255 ECU_ADDRESS 0 READ_WRITE /end MEASUREMENT
/begin MEASUREMENT Rte_FaultLog_FaultLog.CTCFailData[46].Byte3_Cnt_u08 "MICROSAR RTE" UBYTE NO_COMPU_METHOD 0 0 0 255 ECU_ADDRESS 0 READ_WRITE /end MEASUREMENT
/begin MEASUREMENT Rte_FaultLog_FaultLog.CTCFailData[46].Byte4_Cnt_u08 "MICROSAR RTE" UBYTE NO_COMPU_METHOD 0 0 0 255 ECU_ADDRESS 0 READ_WRITE /end MEASUREMENT
/begin MEASUREMENT Rte_FaultLog_FaultLog.CTCFailData[46].Byte5_Cnt_u08 "MICROSAR RTE" UBYTE NO_COMPU_METHOD 0 0 0 255 ECU_ADDRESS 0 READ_WRITE /end MEASUREMENT
/begin MEASUREMENT Rte_FaultLog_FaultLog.CTCFailData[46].Byte6_Cnt_u08 "MICROSAR RTE" UBYTE NO_COMPU_METHOD 0 0 0 255 ECU_ADDRESS 0 READ_WRITE /end MEASUREMENT
/begin MEASUREMENT Rte_FaultLog_FaultLog.CTCFailData[46].Reserved1_Cnt_u08 "MICROSAR RTE" UBYTE NO_COMPU_METHOD 0 0 0 255 ECU_ADDRESS 0 READ_WRITE /end MEASUREMENT
/begin MEASUREMENT Rte_FaultLog_FaultLog.CTCFailData[46].Reserved2_Cnt_u08 "MICROSAR RTE" UBYTE NO_COMPU_METHOD 0 0 0 255 ECU_ADDRESS 0 READ_WRITE /end MEASUREMENT
/begin MEASUREMENT Rte_FaultLog_FaultLog.CTCFailData[47].Byte1_Cnt_u08 "MICROSAR RTE" UBYTE NO_COMPU_METHOD 0 0 0 255 ECU_ADDRESS 0 READ_WRITE /end MEASUREMENT
/begin MEASUREMENT Rte_FaultLog_FaultLog.CTCFailData[47].Byte2_Cnt_u08 "MICROSAR RTE" UBYTE NO_COMPU_METHOD 0 0 0 255 ECU_ADDRESS 0 READ_WRITE /end MEASUREMENT
/begin MEASUREMENT Rte_FaultLog_FaultLog.CTCFailData[47].Byte3_Cnt_u08 "MICROSAR RTE" UBYTE NO_COMPU_METHOD 0 0 0 255 ECU_ADDRESS 0 READ_WRITE /end MEASUREMENT
/begin MEASUREMENT Rte_FaultLog_FaultLog.CTCFailData[47].Byte4_Cnt_u08 "MICROSAR RTE" UBYTE NO_COMPU_METHOD 0 0 0 255 ECU_ADDRESS 0 READ_WRITE /end MEASUREMENT
/begin MEASUREMENT Rte_FaultLog_FaultLog.CTCFailData[47].Byte5_Cnt_u08 "MICROSAR RTE" UBYTE NO_COMPU_METHOD 0 0 0 255 ECU_ADDRESS 0 READ_WRITE /end MEASUREMENT
/begin MEASUREMENT Rte_FaultLog_FaultLog.CTCFailData[47].Byte6_Cnt_u08 "MICROSAR RTE" UBYTE NO_COMPU_METHOD 0 0 0 255 ECU_ADDRESS 0 READ_WRITE /end MEASUREMENT
/begin MEASUREMENT Rte_FaultLog_FaultLog.CTCFailData[47].Reserved1_Cnt_u08 "MICROSAR RTE" UBYTE NO_COMPU_METHOD 0 0 0 255 ECU_ADDRESS 0 READ_WRITE /end MEASUREMENT
/begin MEASUREMENT Rte_FaultLog_FaultLog.CTCFailData[47].Reserved2_Cnt_u08 "MICROSAR RTE" UBYTE NO_COMPU_METHOD 0 0 0 255 ECU_ADDRESS 0 READ_WRITE /end MEASUREMENT
/begin MEASUREMENT Rte_FaultLog_FaultLog.CTCFailData[48].Byte1_Cnt_u08 "MICROSAR RTE" UBYTE NO_COMPU_METHOD 0 0 0 255 ECU_ADDRESS 0 READ_WRITE /end MEASUREMENT
/begin MEASUREMENT Rte_FaultLog_FaultLog.CTCFailData[48].Byte2_Cnt_u08 "MICROSAR RTE" UBYTE NO_COMPU_METHOD 0 0 0 255 ECU_ADDRESS 0 READ_WRITE /end MEASUREMENT
/begin MEASUREMENT Rte_FaultLog_FaultLog.CTCFailData[48].Byte3_Cnt_u08 "MICROSAR RTE" UBYTE NO_COMPU_METHOD 0 0 0 255 ECU_ADDRESS 0 READ_WRITE /end MEASUREMENT
/begin MEASUREMENT Rte_FaultLog_FaultLog.CTCFailData[48].Byte4_Cnt_u08 "MICROSAR RTE" UBYTE NO_COMPU_METHOD 0 0 0 255 ECU_ADDRESS 0 READ_WRITE /end MEASUREMENT
/begin MEASUREMENT Rte_FaultLog_FaultLog.CTCFailData[48].Byte5_Cnt_u08 "MICROSAR RTE" UBYTE NO_COMPU_METHOD 0 0 0 255 ECU_ADDRESS 0 READ_WRITE /end MEASUREMENT
/begin MEASUREMENT Rte_FaultLog_FaultLog.CTCFailData[48].Byte6_Cnt_u08 "MICROSAR RTE" UBYTE NO_COMPU_METHOD 0 0 0 255 ECU_ADDRESS 0 READ_WRITE /end MEASUREMENT
/begin MEASUREMENT Rte_FaultLog_FaultLog.CTCFailData[48].Reserved1_Cnt_u08 "MICROSAR RTE" UBYTE NO_COMPU_METHOD 0 0 0 255 ECU_ADDRESS 0 READ_WRITE /end MEASUREMENT
/begin MEASUREMENT Rte_FaultLog_FaultLog.CTCFailData[48].Reserved2_Cnt_u08 "MICROSAR RTE" UBYTE NO_COMPU_METHOD 0 0 0 255 ECU_ADDRESS 0 READ_WRITE /end MEASUREMENT
/begin MEASUREMENT Rte_FaultLog_FaultLog.CTCFailData[49].Byte1_Cnt_u08 "MICROSAR RTE" UBYTE NO_COMPU_METHOD 0 0 0 255 ECU_ADDRESS 0 READ_WRITE /end MEASUREMENT
/begin MEASUREMENT Rte_FaultLog_FaultLog.CTCFailData[49].Byte2_Cnt_u08 "MICROSAR RTE" UBYTE NO_COMPU_METHOD 0 0 0 255 ECU_ADDRESS 0 READ_WRITE /end MEASUREMENT
/begin MEASUREMENT Rte_FaultLog_FaultLog.CTCFailData[49].Byte3_Cnt_u08 "MICROSAR RTE" UBYTE NO_COMPU_METHOD 0 0 0 255 ECU_ADDRESS 0 READ_WRITE /end MEASUREMENT
/begin MEASUREMENT Rte_FaultLog_FaultLog.CTCFailData[49].Byte4_Cnt_u08 "MICROSAR RTE" UBYTE NO_COMPU_METHOD 0 0 0 255 ECU_ADDRESS 0 READ_WRITE /end MEASUREMENT
/begin MEASUREMENT Rte_FaultLog_FaultLog.CTCFailData[49].Byte5_Cnt_u08 "MICROSAR RTE" UBYTE NO_COMPU_METHOD 0 0 0 255 ECU_ADDRESS 0 READ_WRITE /end MEASUREMENT
/begin MEASUREMENT Rte_FaultLog_FaultLog.CTCFailData[49].Byte6_Cnt_u08 "MICROSAR RTE" UBYTE NO_COMPU_METHOD 0 0 0 255 ECU_ADDRESS 0 READ_WRITE /end MEASUREMENT
/begin MEASUREMENT Rte_FaultLog_FaultLog.CTCFailData[49].Reserved1_Cnt_u08 "MICROSAR RTE" UBYTE NO_COMPU_METHOD 0 0 0 255 ECU_ADDRESS 0 READ_WRITE /end MEASUREMENT
/begin MEASUREMENT Rte_FaultLog_FaultLog.CTCFailData[49].Reserved2_Cnt_u08 "MICROSAR RTE" UBYTE NO_COMPU_METHOD 0 0 0 255 ECU_ADDRESS 0 READ_WRITE /end MEASUREMENT
/begin MEASUREMENT Rte_FaultLog_FaultLog.CTCFailData[4].Byte1_Cnt_u08 "MICROSAR RTE" UBYTE NO_COMPU_METHOD 0 0 0 255 ECU_ADDRESS 0 READ_WRITE /end MEASUREMENT
/begin MEASUREMENT Rte_FaultLog_FaultLog.CTCFailData[4].Byte2_Cnt_u08 "MICROSAR RTE" UBYTE NO_COMPU_METHOD 0 0 0 255 ECU_ADDRESS 0 READ_WRITE /end MEASUREMENT
/begin MEASUREMENT Rte_FaultLog_FaultLog.CTCFailData[4].Byte3_Cnt_u08 "MICROSAR RTE" UBYTE NO_COMPU_METHOD 0 0 0 255 ECU_ADDRESS 0 READ_WRITE /end MEASUREMENT
/begin MEASUREMENT Rte_FaultLog_FaultLog.CTCFailData[4].Byte4_Cnt_u08 "MICROSAR RTE" UBYTE NO_COMPU_METHOD 0 0 0 255 ECU_ADDRESS 0 READ_WRITE /end MEASUREMENT
/begin MEASUREMENT Rte_FaultLog_FaultLog.CTCFailData[4].Byte5_Cnt_u08 "MICROSAR RTE" UBYTE NO_COMPU_METHOD 0 0 0 255 ECU_ADDRESS 0 READ_WRITE /end MEASUREMENT
/begin MEASUREMENT Rte_FaultLog_FaultLog.CTCFailData[4].Byte6_Cnt_u08 "MICROSAR RTE" UBYTE NO_COMPU_METHOD 0 0 0 255 ECU_ADDRESS 0 READ_WRITE /end MEASUREMENT
/begin MEASUREMENT Rte_FaultLog_FaultLog.CTCFailData[4].Reserved1_Cnt_u08 "MICROSAR RTE" UBYTE NO_COMPU_METHOD 0 0 0 255 ECU_ADDRESS 0 READ_WRITE /end MEASUREMENT
/begin MEASUREMENT Rte_FaultLog_FaultLog.CTCFailData[4].Reserved2_Cnt_u08 "MICROSAR RTE" UBYTE NO_COMPU_METHOD 0 0 0 255 ECU_ADDRESS 0 READ_WRITE /end MEASUREMENT
/begin MEASUREMENT Rte_FaultLog_FaultLog.CTCFailData[50].Byte1_Cnt_u08 "MICROSAR RTE" UBYTE NO_COMPU_METHOD 0 0 0 255 ECU_ADDRESS 0 READ_WRITE /end MEASUREMENT
/begin MEASUREMENT Rte_FaultLog_FaultLog.CTCFailData[50].Byte2_Cnt_u08 "MICROSAR RTE" UBYTE NO_COMPU_METHOD 0 0 0 255 ECU_ADDRESS 0 READ_WRITE /end MEASUREMENT
/begin MEASUREMENT Rte_FaultLog_FaultLog.CTCFailData[50].Byte3_Cnt_u08 "MICROSAR RTE" UBYTE NO_COMPU_METHOD 0 0 0 255 ECU_ADDRESS 0 READ_WRITE /end MEASUREMENT
/begin MEASUREMENT Rte_FaultLog_FaultLog.CTCFailData[50].Byte4_Cnt_u08 "MICROSAR RTE" UBYTE NO_COMPU_METHOD 0 0 0 255 ECU_ADDRESS 0 READ_WRITE /end MEASUREMENT
/begin MEASUREMENT Rte_FaultLog_FaultLog.CTCFailData[50].Byte5_Cnt_u08 "MICROSAR RTE" UBYTE NO_COMPU_METHOD 0 0 0 255 ECU_ADDRESS 0 READ_WRITE /end MEASUREMENT
/begin MEASUREMENT Rte_FaultLog_FaultLog.CTCFailData[50].Byte6_Cnt_u08 "MICROSAR RTE" UBYTE NO_COMPU_METHOD 0 0 0 255 ECU_ADDRESS 0 READ_WRITE /end MEASUREMENT
/begin MEASUREMENT Rte_FaultLog_FaultLog.CTCFailData[50].Reserved1_Cnt_u08 "MICROSAR RTE" UBYTE NO_COMPU_METHOD 0 0 0 255 ECU_ADDRESS 0 READ_WRITE /end MEASUREMENT
/begin MEASUREMENT Rte_FaultLog_FaultLog.CTCFailData[50].Reserved2_Cnt_u08 "MICROSAR RTE" UBYTE NO_COMPU_METHOD 0 0 0 255 ECU_ADDRESS 0 READ_WRITE /end MEASUREMENT
/begin MEASUREMENT Rte_FaultLog_FaultLog.CTCFailData[51].Byte1_Cnt_u08 "MICROSAR RTE" UBYTE NO_COMPU_METHOD 0 0 0 255 ECU_ADDRESS 0 READ_WRITE /end MEASUREMENT
/begin MEASUREMENT Rte_FaultLog_FaultLog.CTCFailData[51].Byte2_Cnt_u08 "MICROSAR RTE" UBYTE NO_COMPU_METHOD 0 0 0 255 ECU_ADDRESS 0 READ_WRITE /end MEASUREMENT
/begin MEASUREMENT Rte_FaultLog_FaultLog.CTCFailData[51].Byte3_Cnt_u08 "MICROSAR RTE" UBYTE NO_COMPU_METHOD 0 0 0 255 ECU_ADDRESS 0 READ_WRITE /end MEASUREMENT
/begin MEASUREMENT Rte_FaultLog_FaultLog.CTCFailData[51].Byte4_Cnt_u08 "MICROSAR RTE" UBYTE NO_COMPU_METHOD 0 0 0 255 ECU_ADDRESS 0 READ_WRITE /end MEASUREMENT
/begin MEASUREMENT Rte_FaultLog_FaultLog.CTCFailData[51].Byte5_Cnt_u08 "MICROSAR RTE" UBYTE NO_COMPU_METHOD 0 0 0 255 ECU_ADDRESS 0 READ_WRITE /end MEASUREMENT
/begin MEASUREMENT Rte_FaultLog_FaultLog.CTCFailData[51].Byte6_Cnt_u08 "MICROSAR RTE" UBYTE NO_COMPU_METHOD 0 0 0 255 ECU_ADDRESS 0 READ_WRITE /end MEASUREMENT
/begin MEASUREMENT Rte_FaultLog_FaultLog.CTCFailData[51].Reserved1_Cnt_u08 "MICROSAR RTE" UBYTE NO_COMPU_METHOD 0 0 0 255 ECU_ADDRESS 0 READ_WRITE /end MEASUREMENT
/begin MEASUREMENT Rte_FaultLog_FaultLog.CTCFailData[51].Reserved2_Cnt_u08 "MICROSAR RTE" UBYTE NO_COMPU_METHOD 0 0 0 255 ECU_ADDRESS 0 READ_WRITE /end MEASUREMENT
/begin MEASUREMENT Rte_FaultLog_FaultLog.CTCFailData[52].Byte1_Cnt_u08 "MICROSAR RTE" UBYTE NO_COMPU_METHOD 0 0 0 255 ECU_ADDRESS 0 READ_WRITE /end MEASUREMENT
/begin MEASUREMENT Rte_FaultLog_FaultLog.CTCFailData[52].Byte2_Cnt_u08 "MICROSAR RTE" UBYTE NO_COMPU_METHOD 0 0 0 255 ECU_ADDRESS 0 READ_WRITE /end MEASUREMENT
/begin MEASUREMENT Rte_FaultLog_FaultLog.CTCFailData[52].Byte3_Cnt_u08 "MICROSAR RTE" UBYTE NO_COMPU_METHOD 0 0 0 255 ECU_ADDRESS 0 READ_WRITE /end MEASUREMENT
/begin MEASUREMENT Rte_FaultLog_FaultLog.CTCFailData[52].Byte4_Cnt_u08 "MICROSAR RTE" UBYTE NO_COMPU_METHOD 0 0 0 255 ECU_ADDRESS 0 READ_WRITE /end MEASUREMENT
/begin MEASUREMENT Rte_FaultLog_FaultLog.CTCFailData[52].Byte5_Cnt_u08 "MICROSAR RTE" UBYTE NO_COMPU_METHOD 0 0 0 255 ECU_ADDRESS 0 READ_WRITE /end MEASUREMENT
/begin MEASUREMENT Rte_FaultLog_FaultLog.CTCFailData[52].Byte6_Cnt_u08 "MICROSAR RTE" UBYTE NO_COMPU_METHOD 0 0 0 255 ECU_ADDRESS 0 READ_WRITE /end MEASUREMENT
/begin MEASUREMENT Rte_FaultLog_FaultLog.CTCFailData[52].Reserved1_Cnt_u08 "MICROSAR RTE" UBYTE NO_COMPU_METHOD 0 0 0 255 ECU_ADDRESS 0 READ_WRITE /end MEASUREMENT
/begin MEASUREMENT Rte_FaultLog_FaultLog.CTCFailData[52].Reserved2_Cnt_u08 "MICROSAR RTE" UBYTE NO_COMPU_METHOD 0 0 0 255 ECU_ADDRESS 0 READ_WRITE /end MEASUREMENT
/begin MEASUREMENT Rte_FaultLog_FaultLog.CTCFailData[53].Byte1_Cnt_u08 "MICROSAR RTE" UBYTE NO_COMPU_METHOD 0 0 0 255 ECU_ADDRESS 0 READ_WRITE /end MEASUREMENT
/begin MEASUREMENT Rte_FaultLog_FaultLog.CTCFailData[53].Byte2_Cnt_u08 "MICROSAR RTE" UBYTE NO_COMPU_METHOD 0 0 0 255 ECU_ADDRESS 0 READ_WRITE /end MEASUREMENT
/begin MEASUREMENT Rte_FaultLog_FaultLog.CTCFailData[53].Byte3_Cnt_u08 "MICROSAR RTE" UBYTE NO_COMPU_METHOD 0 0 0 255 ECU_ADDRESS 0 READ_WRITE /end MEASUREMENT
/begin MEASUREMENT Rte_FaultLog_FaultLog.CTCFailData[53].Byte4_Cnt_u08 "MICROSAR RTE" UBYTE NO_COMPU_METHOD 0 0 0 255 ECU_ADDRESS 0 READ_WRITE /end MEASUREMENT
/begin MEASUREMENT Rte_FaultLog_FaultLog.CTCFailData[53].Byte5_Cnt_u08 "MICROSAR RTE" UBYTE NO_COMPU_METHOD 0 0 0 255 ECU_ADDRESS 0 READ_WRITE /end MEASUREMENT
/begin MEASUREMENT Rte_FaultLog_FaultLog.CTCFailData[53].Byte6_Cnt_u08 "MICROSAR RTE" UBYTE NO_COMPU_METHOD 0 0 0 255 ECU_ADDRESS 0 READ_WRITE /end MEASUREMENT
/begin MEASUREMENT Rte_FaultLog_FaultLog.CTCFailData[53].Reserved1_Cnt_u08 "MICROSAR RTE" UBYTE NO_COMPU_METHOD 0 0 0 255 ECU_ADDRESS 0 READ_WRITE /end MEASUREMENT
/begin MEASUREMENT Rte_FaultLog_FaultLog.CTCFailData[53].Reserved2_Cnt_u08 "MICROSAR RTE" UBYTE NO_COMPU_METHOD 0 0 0 255 ECU_ADDRESS 0 READ_WRITE /end MEASUREMENT
/begin MEASUREMENT Rte_FaultLog_FaultLog.CTCFailData[54].Byte1_Cnt_u08 "MICROSAR RTE" UBYTE NO_COMPU_METHOD 0 0 0 255 ECU_ADDRESS 0 READ_WRITE /end MEASUREMENT
/begin MEASUREMENT Rte_FaultLog_FaultLog.CTCFailData[54].Byte2_Cnt_u08 "MICROSAR RTE" UBYTE NO_COMPU_METHOD 0 0 0 255 ECU_ADDRESS 0 READ_WRITE /end MEASUREMENT
/begin MEASUREMENT Rte_FaultLog_FaultLog.CTCFailData[54].Byte3_Cnt_u08 "MICROSAR RTE" UBYTE NO_COMPU_METHOD 0 0 0 255 ECU_ADDRESS 0 READ_WRITE /end MEASUREMENT
/begin MEASUREMENT Rte_FaultLog_FaultLog.CTCFailData[54].Byte4_Cnt_u08 "MICROSAR RTE" UBYTE NO_COMPU_METHOD 0 0 0 255 ECU_ADDRESS 0 READ_WRITE /end MEASUREMENT
/begin MEASUREMENT Rte_FaultLog_FaultLog.CTCFailData[54].Byte5_Cnt_u08 "MICROSAR RTE" UBYTE NO_COMPU_METHOD 0 0 0 255 ECU_ADDRESS 0 READ_WRITE /end MEASUREMENT
/begin MEASUREMENT Rte_FaultLog_FaultLog.CTCFailData[54].Byte6_Cnt_u08 "MICROSAR RTE" UBYTE NO_COMPU_METHOD 0 0 0 255 ECU_ADDRESS 0 READ_WRITE /end MEASUREMENT
/begin MEASUREMENT Rte_FaultLog_FaultLog.CTCFailData[54].Reserved1_Cnt_u08 "MICROSAR RTE" UBYTE NO_COMPU_METHOD 0 0 0 255 ECU_ADDRESS 0 READ_WRITE /end MEASUREMENT
/begin MEASUREMENT Rte_FaultLog_FaultLog.CTCFailData[54].Reserved2_Cnt_u08 "MICROSAR RTE" UBYTE NO_COMPU_METHOD 0 0 0 255 ECU_ADDRESS 0 READ_WRITE /end MEASUREMENT
/begin MEASUREMENT Rte_FaultLog_FaultLog.CTCFailData[55].Byte1_Cnt_u08 "MICROSAR RTE" UBYTE NO_COMPU_METHOD 0 0 0 255 ECU_ADDRESS 0 READ_WRITE /end MEASUREMENT
/begin MEASUREMENT Rte_FaultLog_FaultLog.CTCFailData[55].Byte2_Cnt_u08 "MICROSAR RTE" UBYTE NO_COMPU_METHOD 0 0 0 255 ECU_ADDRESS 0 READ_WRITE /end MEASUREMENT
/begin MEASUREMENT Rte_FaultLog_FaultLog.CTCFailData[55].Byte3_Cnt_u08 "MICROSAR RTE" UBYTE NO_COMPU_METHOD 0 0 0 255 ECU_ADDRESS 0 READ_WRITE /end MEASUREMENT
/begin MEASUREMENT Rte_FaultLog_FaultLog.CTCFailData[55].Byte4_Cnt_u08 "MICROSAR RTE" UBYTE NO_COMPU_METHOD 0 0 0 255 ECU_ADDRESS 0 READ_WRITE /end MEASUREMENT
/begin MEASUREMENT Rte_FaultLog_FaultLog.CTCFailData[55].Byte5_Cnt_u08 "MICROSAR RTE" UBYTE NO_COMPU_METHOD 0 0 0 255 ECU_ADDRESS 0 READ_WRITE /end MEASUREMENT
/begin MEASUREMENT Rte_FaultLog_FaultLog.CTCFailData[55].Byte6_Cnt_u08 "MICROSAR RTE" UBYTE NO_COMPU_METHOD 0 0 0 255 ECU_ADDRESS 0 READ_WRITE /end MEASUREMENT
/begin MEASUREMENT Rte_FaultLog_FaultLog.CTCFailData[55].Reserved1_Cnt_u08 "MICROSAR RTE" UBYTE NO_COMPU_METHOD 0 0 0 255 ECU_ADDRESS 0 READ_WRITE /end MEASUREMENT
/begin MEASUREMENT Rte_FaultLog_FaultLog.CTCFailData[55].Reserved2_Cnt_u08 "MICROSAR RTE" UBYTE NO_COMPU_METHOD 0 0 0 255 ECU_ADDRESS 0 READ_WRITE /end MEASUREMENT
/begin MEASUREMENT Rte_FaultLog_FaultLog.CTCFailData[56].Byte1_Cnt_u08 "MICROSAR RTE" UBYTE NO_COMPU_METHOD 0 0 0 255 ECU_ADDRESS 0 READ_WRITE /end MEASUREMENT
/begin MEASUREMENT Rte_FaultLog_FaultLog.CTCFailData[56].Byte2_Cnt_u08 "MICROSAR RTE" UBYTE NO_COMPU_METHOD 0 0 0 255 ECU_ADDRESS 0 READ_WRITE /end MEASUREMENT
/begin MEASUREMENT Rte_FaultLog_FaultLog.CTCFailData[56].Byte3_Cnt_u08 "MICROSAR RTE" UBYTE NO_COMPU_METHOD 0 0 0 255 ECU_ADDRESS 0 READ_WRITE /end MEASUREMENT
/begin MEASUREMENT Rte_FaultLog_FaultLog.CTCFailData[56].Byte4_Cnt_u08 "MICROSAR RTE" UBYTE NO_COMPU_METHOD 0 0 0 255 ECU_ADDRESS 0 READ_WRITE /end MEASUREMENT
/begin MEASUREMENT Rte_FaultLog_FaultLog.CTCFailData[56].Byte5_Cnt_u08 "MICROSAR RTE" UBYTE NO_COMPU_METHOD 0 0 0 255 ECU_ADDRESS 0 READ_WRITE /end MEASUREMENT
/begin MEASUREMENT Rte_FaultLog_FaultLog.CTCFailData[56].Byte6_Cnt_u08 "MICROSAR RTE" UBYTE NO_COMPU_METHOD 0 0 0 255 ECU_ADDRESS 0 READ_WRITE /end MEASUREMENT
/begin MEASUREMENT Rte_FaultLog_FaultLog.CTCFailData[56].Reserved1_Cnt_u08 "MICROSAR RTE" UBYTE NO_COMPU_METHOD 0 0 0 255 ECU_ADDRESS 0 READ_WRITE /end MEASUREMENT
/begin MEASUREMENT Rte_FaultLog_FaultLog.CTCFailData[56].Reserved2_Cnt_u08 "MICROSAR RTE" UBYTE NO_COMPU_METHOD 0 0 0 255 ECU_ADDRESS 0 READ_WRITE /end MEASUREMENT
/begin MEASUREMENT Rte_FaultLog_FaultLog.CTCFailData[57].Byte1_Cnt_u08 "MICROSAR RTE" UBYTE NO_COMPU_METHOD 0 0 0 255 ECU_ADDRESS 0 READ_WRITE /end MEASUREMENT
/begin MEASUREMENT Rte_FaultLog_FaultLog.CTCFailData[57].Byte2_Cnt_u08 "MICROSAR RTE" UBYTE NO_COMPU_METHOD 0 0 0 255 ECU_ADDRESS 0 READ_WRITE /end MEASUREMENT
/begin MEASUREMENT Rte_FaultLog_FaultLog.CTCFailData[57].Byte3_Cnt_u08 "MICROSAR RTE" UBYTE NO_COMPU_METHOD 0 0 0 255 ECU_ADDRESS 0 READ_WRITE /end MEASUREMENT
/begin MEASUREMENT Rte_FaultLog_FaultLog.CTCFailData[57].Byte4_Cnt_u08 "MICROSAR RTE" UBYTE NO_COMPU_METHOD 0 0 0 255 ECU_ADDRESS 0 READ_WRITE /end MEASUREMENT
/begin MEASUREMENT Rte_FaultLog_FaultLog.CTCFailData[57].Byte5_Cnt_u08 "MICROSAR RTE" UBYTE NO_COMPU_METHOD 0 0 0 255 ECU_ADDRESS 0 READ_WRITE /end MEASUREMENT
/begin MEASUREMENT Rte_FaultLog_FaultLog.CTCFailData[57].Byte6_Cnt_u08 "MICROSAR RTE" UBYTE NO_COMPU_METHOD 0 0 0 255 ECU_ADDRESS 0 READ_WRITE /end MEASUREMENT
/begin MEASUREMENT Rte_FaultLog_FaultLog.CTCFailData[57].Reserved1_Cnt_u08 "MICROSAR RTE" UBYTE NO_COMPU_METHOD 0 0 0 255 ECU_ADDRESS 0 READ_WRITE /end MEASUREMENT
/begin MEASUREMENT Rte_FaultLog_FaultLog.CTCFailData[57].Reserved2_Cnt_u08 "MICROSAR RTE" UBYTE NO_COMPU_METHOD 0 0 0 255 ECU_ADDRESS 0 READ_WRITE /end MEASUREMENT
/begin MEASUREMENT Rte_FaultLog_FaultLog.CTCFailData[58].Byte1_Cnt_u08 "MICROSAR RTE" UBYTE NO_COMPU_METHOD 0 0 0 255 ECU_ADDRESS 0 READ_WRITE /end MEASUREMENT
/begin MEASUREMENT Rte_FaultLog_FaultLog.CTCFailData[58].Byte2_Cnt_u08 "MICROSAR RTE" UBYTE NO_COMPU_METHOD 0 0 0 255 ECU_ADDRESS 0 READ_WRITE /end MEASUREMENT
/begin MEASUREMENT Rte_FaultLog_FaultLog.CTCFailData[58].Byte3_Cnt_u08 "MICROSAR RTE" UBYTE NO_COMPU_METHOD 0 0 0 255 ECU_ADDRESS 0 READ_WRITE /end MEASUREMENT
/begin MEASUREMENT Rte_FaultLog_FaultLog.CTCFailData[58].Byte4_Cnt_u08 "MICROSAR RTE" UBYTE NO_COMPU_METHOD 0 0 0 255 ECU_ADDRESS 0 READ_WRITE /end MEASUREMENT
/begin MEASUREMENT Rte_FaultLog_FaultLog.CTCFailData[58].Byte5_Cnt_u08 "MICROSAR RTE" UBYTE NO_COMPU_METHOD 0 0 0 255 ECU_ADDRESS 0 READ_WRITE /end MEASUREMENT
/begin MEASUREMENT Rte_FaultLog_FaultLog.CTCFailData[58].Byte6_Cnt_u08 "MICROSAR RTE" UBYTE NO_COMPU_METHOD 0 0 0 255 ECU_ADDRESS 0 READ_WRITE /end MEASUREMENT
/begin MEASUREMENT Rte_FaultLog_FaultLog.CTCFailData[58].Reserved1_Cnt_u08 "MICROSAR RTE" UBYTE NO_COMPU_METHOD 0 0 0 255 ECU_ADDRESS 0 READ_WRITE /end MEASUREMENT
/begin MEASUREMENT Rte_FaultLog_FaultLog.CTCFailData[58].Reserved2_Cnt_u08 "MICROSAR RTE" UBYTE NO_COMPU_METHOD 0 0 0 255 ECU_ADDRESS 0 READ_WRITE /end MEASUREMENT
/begin MEASUREMENT Rte_FaultLog_FaultLog.CTCFailData[59].Byte1_Cnt_u08 "MICROSAR RTE" UBYTE NO_COMPU_METHOD 0 0 0 255 ECU_ADDRESS 0 READ_WRITE /end MEASUREMENT
/begin MEASUREMENT Rte_FaultLog_FaultLog.CTCFailData[59].Byte2_Cnt_u08 "MICROSAR RTE" UBYTE NO_COMPU_METHOD 0 0 0 255 ECU_ADDRESS 0 READ_WRITE /end MEASUREMENT
/begin MEASUREMENT Rte_FaultLog_FaultLog.CTCFailData[59].Byte3_Cnt_u08 "MICROSAR RTE" UBYTE NO_COMPU_METHOD 0 0 0 255 ECU_ADDRESS 0 READ_WRITE /end MEASUREMENT
/begin MEASUREMENT Rte_FaultLog_FaultLog.CTCFailData[59].Byte4_Cnt_u08 "MICROSAR RTE" UBYTE NO_COMPU_METHOD 0 0 0 255 ECU_ADDRESS 0 READ_WRITE /end MEASUREMENT
/begin MEASUREMENT Rte_FaultLog_FaultLog.CTCFailData[59].Byte5_Cnt_u08 "MICROSAR RTE" UBYTE NO_COMPU_METHOD 0 0 0 255 ECU_ADDRESS 0 READ_WRITE /end MEASUREMENT
/begin MEASUREMENT Rte_FaultLog_FaultLog.CTCFailData[59].Byte6_Cnt_u08 "MICROSAR RTE" UBYTE NO_COMPU_METHOD 0 0 0 255 ECU_ADDRESS 0 READ_WRITE /end MEASUREMENT
/begin MEASUREMENT Rte_FaultLog_FaultLog.CTCFailData[59].Reserved1_Cnt_u08 "MICROSAR RTE" UBYTE NO_COMPU_METHOD 0 0 0 255 ECU_ADDRESS 0 READ_WRITE /end MEASUREMENT
/begin MEASUREMENT Rte_FaultLog_FaultLog.CTCFailData[59].Reserved2_Cnt_u08 "MICROSAR RTE" UBYTE NO_COMPU_METHOD 0 0 0 255 ECU_ADDRESS 0 READ_WRITE /end MEASUREMENT
/begin MEASUREMENT Rte_FaultLog_FaultLog.CTCFailData[5].Byte1_Cnt_u08 "MICROSAR RTE" UBYTE NO_COMPU_METHOD 0 0 0 255 ECU_ADDRESS 0 READ_WRITE /end MEASUREMENT
/begin MEASUREMENT Rte_FaultLog_FaultLog.CTCFailData[5].Byte2_Cnt_u08 "MICROSAR RTE" UBYTE NO_COMPU_METHOD 0 0 0 255 ECU_ADDRESS 0 READ_WRITE /end MEASUREMENT
/begin MEASUREMENT Rte_FaultLog_FaultLog.CTCFailData[5].Byte3_Cnt_u08 "MICROSAR RTE" UBYTE NO_COMPU_METHOD 0 0 0 255 ECU_ADDRESS 0 READ_WRITE /end MEASUREMENT
/begin MEASUREMENT Rte_FaultLog_FaultLog.CTCFailData[5].Byte4_Cnt_u08 "MICROSAR RTE" UBYTE NO_COMPU_METHOD 0 0 0 255 ECU_ADDRESS 0 READ_WRITE /end MEASUREMENT
/begin MEASUREMENT Rte_FaultLog_FaultLog.CTCFailData[5].Byte5_Cnt_u08 "MICROSAR RTE" UBYTE NO_COMPU_METHOD 0 0 0 255 ECU_ADDRESS 0 READ_WRITE /end MEASUREMENT
/begin MEASUREMENT Rte_FaultLog_FaultLog.CTCFailData[5].Byte6_Cnt_u08 "MICROSAR RTE" UBYTE NO_COMPU_METHOD 0 0 0 255 ECU_ADDRESS 0 READ_WRITE /end MEASUREMENT
/begin MEASUREMENT Rte_FaultLog_FaultLog.CTCFailData[5].Reserved1_Cnt_u08 "MICROSAR RTE" UBYTE NO_COMPU_METHOD 0 0 0 255 ECU_ADDRESS 0 READ_WRITE /end MEASUREMENT
/begin MEASUREMENT Rte_FaultLog_FaultLog.CTCFailData[5].Reserved2_Cnt_u08 "MICROSAR RTE" UBYTE NO_COMPU_METHOD 0 0 0 255 ECU_ADDRESS 0 READ_WRITE /end MEASUREMENT
/begin MEASUREMENT Rte_FaultLog_FaultLog.CTCFailData[6].Byte1_Cnt_u08 "MICROSAR RTE" UBYTE NO_COMPU_METHOD 0 0 0 255 ECU_ADDRESS 0 READ_WRITE /end MEASUREMENT
/begin MEASUREMENT Rte_FaultLog_FaultLog.CTCFailData[6].Byte2_Cnt_u08 "MICROSAR RTE" UBYTE NO_COMPU_METHOD 0 0 0 255 ECU_ADDRESS 0 READ_WRITE /end MEASUREMENT
/begin MEASUREMENT Rte_FaultLog_FaultLog.CTCFailData[6].Byte3_Cnt_u08 "MICROSAR RTE" UBYTE NO_COMPU_METHOD 0 0 0 255 ECU_ADDRESS 0 READ_WRITE /end MEASUREMENT
/begin MEASUREMENT Rte_FaultLog_FaultLog.CTCFailData[6].Byte4_Cnt_u08 "MICROSAR RTE" UBYTE NO_COMPU_METHOD 0 0 0 255 ECU_ADDRESS 0 READ_WRITE /end MEASUREMENT
/begin MEASUREMENT Rte_FaultLog_FaultLog.CTCFailData[6].Byte5_Cnt_u08 "MICROSAR RTE" UBYTE NO_COMPU_METHOD 0 0 0 255 ECU_ADDRESS 0 READ_WRITE /end MEASUREMENT
/begin MEASUREMENT Rte_FaultLog_FaultLog.CTCFailData[6].Byte6_Cnt_u08 "MICROSAR RTE" UBYTE NO_COMPU_METHOD 0 0 0 255 ECU_ADDRESS 0 READ_WRITE /end MEASUREMENT
/begin MEASUREMENT Rte_FaultLog_FaultLog.CTCFailData[6].Reserved1_Cnt_u08 "MICROSAR RTE" UBYTE NO_COMPU_METHOD 0 0 0 255 ECU_ADDRESS 0 READ_WRITE /end MEASUREMENT
/begin MEASUREMENT Rte_FaultLog_FaultLog.CTCFailData[6].Reserved2_Cnt_u08 "MICROSAR RTE" UBYTE NO_COMPU_METHOD 0 0 0 255 ECU_ADDRESS 0 READ_WRITE /end MEASUREMENT
/begin MEASUREMENT Rte_FaultLog_FaultLog.CTCFailData[7].Byte1_Cnt_u08 "MICROSAR RTE" UBYTE NO_COMPU_METHOD 0 0 0 255 ECU_ADDRESS 0 READ_WRITE /end MEASUREMENT
/begin MEASUREMENT Rte_FaultLog_FaultLog.CTCFailData[7].Byte2_Cnt_u08 "MICROSAR RTE" UBYTE NO_COMPU_METHOD 0 0 0 255 ECU_ADDRESS 0 READ_WRITE /end MEASUREMENT
/begin MEASUREMENT Rte_FaultLog_FaultLog.CTCFailData[7].Byte3_Cnt_u08 "MICROSAR RTE" UBYTE NO_COMPU_METHOD 0 0 0 255 ECU_ADDRESS 0 READ_WRITE /end MEASUREMENT
/begin MEASUREMENT Rte_FaultLog_FaultLog.CTCFailData[7].Byte4_Cnt_u08 "MICROSAR RTE" UBYTE NO_COMPU_METHOD 0 0 0 255 ECU_ADDRESS 0 READ_WRITE /end MEASUREMENT
/begin MEASUREMENT Rte_FaultLog_FaultLog.CTCFailData[7].Byte5_Cnt_u08 "MICROSAR RTE" UBYTE NO_COMPU_METHOD 0 0 0 255 ECU_ADDRESS 0 READ_WRITE /end MEASUREMENT
/begin MEASUREMENT Rte_FaultLog_FaultLog.CTCFailData[7].Byte6_Cnt_u08 "MICROSAR RTE" UBYTE NO_COMPU_METHOD 0 0 0 255 ECU_ADDRESS 0 READ_WRITE /end MEASUREMENT
/begin MEASUREMENT Rte_FaultLog_FaultLog.CTCFailData[7].Reserved1_Cnt_u08 "MICROSAR RTE" UBYTE NO_COMPU_METHOD 0 0 0 255 ECU_ADDRESS 0 READ_WRITE /end MEASUREMENT
/begin MEASUREMENT Rte_FaultLog_FaultLog.CTCFailData[7].Reserved2_Cnt_u08 "MICROSAR RTE" UBYTE NO_COMPU_METHOD 0 0 0 255 ECU_ADDRESS 0 READ_WRITE /end MEASUREMENT
/begin MEASUREMENT Rte_FaultLog_FaultLog.CTCFailData[8].Byte1_Cnt_u08 "MICROSAR RTE" UBYTE NO_COMPU_METHOD 0 0 0 255 ECU_ADDRESS 0 READ_WRITE /end MEASUREMENT
/begin MEASUREMENT Rte_FaultLog_FaultLog.CTCFailData[8].Byte2_Cnt_u08 "MICROSAR RTE" UBYTE NO_COMPU_METHOD 0 0 0 255 ECU_ADDRESS 0 READ_WRITE /end MEASUREMENT
/begin MEASUREMENT Rte_FaultLog_FaultLog.CTCFailData[8].Byte3_Cnt_u08 "MICROSAR RTE" UBYTE NO_COMPU_METHOD 0 0 0 255 ECU_ADDRESS 0 READ_WRITE /end MEASUREMENT
/begin MEASUREMENT Rte_FaultLog_FaultLog.CTCFailData[8].Byte4_Cnt_u08 "MICROSAR RTE" UBYTE NO_COMPU_METHOD 0 0 0 255 ECU_ADDRESS 0 READ_WRITE /end MEASUREMENT
/begin MEASUREMENT Rte_FaultLog_FaultLog.CTCFailData[8].Byte5_Cnt_u08 "MICROSAR RTE" UBYTE NO_COMPU_METHOD 0 0 0 255 ECU_ADDRESS 0 READ_WRITE /end MEASUREMENT
/begin MEASUREMENT Rte_FaultLog_FaultLog.CTCFailData[8].Byte6_Cnt_u08 "MICROSAR RTE" UBYTE NO_COMPU_METHOD 0 0 0 255 ECU_ADDRESS 0 READ_WRITE /end MEASUREMENT
/begin MEASUREMENT Rte_FaultLog_FaultLog.CTCFailData[8].Reserved1_Cnt_u08 "MICROSAR RTE" UBYTE NO_COMPU_METHOD 0 0 0 255 ECU_ADDRESS 0 READ_WRITE /end MEASUREMENT
/begin MEASUREMENT Rte_FaultLog_FaultLog.CTCFailData[8].Reserved2_Cnt_u08 "MICROSAR RTE" UBYTE NO_COMPU_METHOD 0 0 0 255 ECU_ADDRESS 0 READ_WRITE /end MEASUREMENT
/begin MEASUREMENT Rte_FaultLog_FaultLog.CTCFailData[9].Byte1_Cnt_u08 "MICROSAR RTE" UBYTE NO_COMPU_METHOD 0 0 0 255 ECU_ADDRESS 0 READ_WRITE /end MEASUREMENT
/begin MEASUREMENT Rte_FaultLog_FaultLog.CTCFailData[9].Byte2_Cnt_u08 "MICROSAR RTE" UBYTE NO_COMPU_METHOD 0 0 0 255 ECU_ADDRESS 0 READ_WRITE /end MEASUREMENT
/begin MEASUREMENT Rte_FaultLog_FaultLog.CTCFailData[9].Byte3_Cnt_u08 "MICROSAR RTE" UBYTE NO_COMPU_METHOD 0 0 0 255 ECU_ADDRESS 0 READ_WRITE /end MEASUREMENT
/begin MEASUREMENT Rte_FaultLog_FaultLog.CTCFailData[9].Byte4_Cnt_u08 "MICROSAR RTE" UBYTE NO_COMPU_METHOD 0 0 0 255 ECU_ADDRESS 0 READ_WRITE /end MEASUREMENT
/begin MEASUREMENT Rte_FaultLog_FaultLog.CTCFailData[9].Byte5_Cnt_u08 "MICROSAR RTE" UBYTE NO_COMPU_METHOD 0 0 0 255 ECU_ADDRESS 0 READ_WRITE /end MEASUREMENT
/begin MEASUREMENT Rte_FaultLog_FaultLog.CTCFailData[9].Byte6_Cnt_u08 "MICROSAR RTE" UBYTE NO_COMPU_METHOD 0 0 0 255 ECU_ADDRESS 0 READ_WRITE /end MEASUREMENT
/begin MEASUREMENT Rte_FaultLog_FaultLog.CTCFailData[9].Reserved1_Cnt_u08 "MICROSAR RTE" UBYTE NO_COMPU_METHOD 0 0 0 255 ECU_ADDRESS 0 READ_WRITE /end MEASUREMENT
/begin MEASUREMENT Rte_FaultLog_FaultLog.CTCFailData[9].Reserved2_Cnt_u08 "MICROSAR RTE" UBYTE NO_COMPU_METHOD 0 0 0 255 ECU_ADDRESS 0 READ_WRITE /end MEASUREMENT
/begin MEASUREMENT Rte_FaultLog_FaultLog.CTCPassData[0].Byte1_Cnt_u08 "MICROSAR RTE" UBYTE NO_COMPU_METHOD 0 0 0 255 ECU_ADDRESS 0 READ_WRITE /end MEASUREMENT
/begin MEASUREMENT Rte_FaultLog_FaultLog.CTCPassData[0].Byte2_Cnt_u08 "MICROSAR RTE" UBYTE NO_COMPU_METHOD 0 0 0 255 ECU_ADDRESS 0 READ_WRITE /end MEASUREMENT
/begin MEASUREMENT Rte_FaultLog_FaultLog.CTCPassData[0].Byte3_Cnt_u08 "MICROSAR RTE" UBYTE NO_COMPU_METHOD 0 0 0 255 ECU_ADDRESS 0 READ_WRITE /end MEASUREMENT
/begin MEASUREMENT Rte_FaultLog_FaultLog.CTCPassData[0].Byte4_Cnt_u08 "MICROSAR RTE" UBYTE NO_COMPU_METHOD 0 0 0 255 ECU_ADDRESS 0 READ_WRITE /end MEASUREMENT
/begin MEASUREMENT Rte_FaultLog_FaultLog.CTCPassData[0].Byte5_Cnt_u08 "MICROSAR RTE" UBYTE NO_COMPU_METHOD 0 0 0 255 ECU_ADDRESS 0 READ_WRITE /end MEASUREMENT
/begin MEASUREMENT Rte_FaultLog_FaultLog.CTCPassData[0].Byte6_Cnt_u08 "MICROSAR RTE" UBYTE NO_COMPU_METHOD 0 0 0 255 ECU_ADDRESS 0 READ_WRITE /end MEASUREMENT
/begin MEASUREMENT Rte_FaultLog_FaultLog.CTCPassData[0].Reserved1_Cnt_u08 "MICROSAR RTE" UBYTE NO_COMPU_METHOD 0 0 0 255 ECU_ADDRESS 0 READ_WRITE /end MEASUREMENT
/begin MEASUREMENT Rte_FaultLog_FaultLog.CTCPassData[0].Reserved2_Cnt_u08 "MICROSAR RTE" UBYTE NO_COMPU_METHOD 0 0 0 255 ECU_ADDRESS 0 READ_WRITE /end MEASUREMENT
/begin MEASUREMENT Rte_FaultLog_FaultLog.CTCPassData[10].Byte1_Cnt_u08 "MICROSAR RTE" UBYTE NO_COMPU_METHOD 0 0 0 255 ECU_ADDRESS 0 READ_WRITE /end MEASUREMENT
/begin MEASUREMENT Rte_FaultLog_FaultLog.CTCPassData[10].Byte2_Cnt_u08 "MICROSAR RTE" UBYTE NO_COMPU_METHOD 0 0 0 255 ECU_ADDRESS 0 READ_WRITE /end MEASUREMENT
/begin MEASUREMENT Rte_FaultLog_FaultLog.CTCPassData[10].Byte3_Cnt_u08 "MICROSAR RTE" UBYTE NO_COMPU_METHOD 0 0 0 255 ECU_ADDRESS 0 READ_WRITE /end MEASUREMENT
/begin MEASUREMENT Rte_FaultLog_FaultLog.CTCPassData[10].Byte4_Cnt_u08 "MICROSAR RTE" UBYTE NO_COMPU_METHOD 0 0 0 255 ECU_ADDRESS 0 READ_WRITE /end MEASUREMENT
/begin MEASUREMENT Rte_FaultLog_FaultLog.CTCPassData[10].Byte5_Cnt_u08 "MICROSAR RTE" UBYTE NO_COMPU_METHOD 0 0 0 255 ECU_ADDRESS 0 READ_WRITE /end MEASUREMENT
/begin MEASUREMENT Rte_FaultLog_FaultLog.CTCPassData[10].Byte6_Cnt_u08 "MICROSAR RTE" UBYTE NO_COMPU_METHOD 0 0 0 255 ECU_ADDRESS 0 READ_WRITE /end MEASUREMENT
/begin MEASUREMENT Rte_FaultLog_FaultLog.CTCPassData[10].Reserved1_Cnt_u08 "MICROSAR RTE" UBYTE NO_COMPU_METHOD 0 0 0 255 ECU_ADDRESS 0 READ_WRITE /end MEASUREMENT
/begin MEASUREMENT Rte_FaultLog_FaultLog.CTCPassData[10].Reserved2_Cnt_u08 "MICROSAR RTE" UBYTE NO_COMPU_METHOD 0 0 0 255 ECU_ADDRESS 0 READ_WRITE /end MEASUREMENT
/begin MEASUREMENT Rte_FaultLog_FaultLog.CTCPassData[11].Byte1_Cnt_u08 "MICROSAR RTE" UBYTE NO_COMPU_METHOD 0 0 0 255 ECU_ADDRESS 0 READ_WRITE /end MEASUREMENT
/begin MEASUREMENT Rte_FaultLog_FaultLog.CTCPassData[11].Byte2_Cnt_u08 "MICROSAR RTE" UBYTE NO_COMPU_METHOD 0 0 0 255 ECU_ADDRESS 0 READ_WRITE /end MEASUREMENT
/begin MEASUREMENT Rte_FaultLog_FaultLog.CTCPassData[11].Byte3_Cnt_u08 "MICROSAR RTE" UBYTE NO_COMPU_METHOD 0 0 0 255 ECU_ADDRESS 0 READ_WRITE /end MEASUREMENT
/begin MEASUREMENT Rte_FaultLog_FaultLog.CTCPassData[11].Byte4_Cnt_u08 "MICROSAR RTE" UBYTE NO_COMPU_METHOD 0 0 0 255 ECU_ADDRESS 0 READ_WRITE /end MEASUREMENT
/begin MEASUREMENT Rte_FaultLog_FaultLog.CTCPassData[11].Byte5_Cnt_u08 "MICROSAR RTE" UBYTE NO_COMPU_METHOD 0 0 0 255 ECU_ADDRESS 0 READ_WRITE /end MEASUREMENT
/begin MEASUREMENT Rte_FaultLog_FaultLog.CTCPassData[11].Byte6_Cnt_u08 "MICROSAR RTE" UBYTE NO_COMPU_METHOD 0 0 0 255 ECU_ADDRESS 0 READ_WRITE /end MEASUREMENT
/begin MEASUREMENT Rte_FaultLog_FaultLog.CTCPassData[11].Reserved1_Cnt_u08 "MICROSAR RTE" UBYTE NO_COMPU_METHOD 0 0 0 255 ECU_ADDRESS 0 READ_WRITE /end MEASUREMENT
/begin MEASUREMENT Rte_FaultLog_FaultLog.CTCPassData[11].Reserved2_Cnt_u08 "MICROSAR RTE" UBYTE NO_COMPU_METHOD 0 0 0 255 ECU_ADDRESS 0 READ_WRITE /end MEASUREMENT
/begin MEASUREMENT Rte_FaultLog_FaultLog.CTCPassData[12].Byte1_Cnt_u08 "MICROSAR RTE" UBYTE NO_COMPU_METHOD 0 0 0 255 ECU_ADDRESS 0 READ_WRITE /end MEASUREMENT
/begin MEASUREMENT Rte_FaultLog_FaultLog.CTCPassData[12].Byte2_Cnt_u08 "MICROSAR RTE" UBYTE NO_COMPU_METHOD 0 0 0 255 ECU_ADDRESS 0 READ_WRITE /end MEASUREMENT
/begin MEASUREMENT Rte_FaultLog_FaultLog.CTCPassData[12].Byte3_Cnt_u08 "MICROSAR RTE" UBYTE NO_COMPU_METHOD 0 0 0 255 ECU_ADDRESS 0 READ_WRITE /end MEASUREMENT
/begin MEASUREMENT Rte_FaultLog_FaultLog.CTCPassData[12].Byte4_Cnt_u08 "MICROSAR RTE" UBYTE NO_COMPU_METHOD 0 0 0 255 ECU_ADDRESS 0 READ_WRITE /end MEASUREMENT
/begin MEASUREMENT Rte_FaultLog_FaultLog.CTCPassData[12].Byte5_Cnt_u08 "MICROSAR RTE" UBYTE NO_COMPU_METHOD 0 0 0 255 ECU_ADDRESS 0 READ_WRITE /end MEASUREMENT
/begin MEASUREMENT Rte_FaultLog_FaultLog.CTCPassData[12].Byte6_Cnt_u08 "MICROSAR RTE" UBYTE NO_COMPU_METHOD 0 0 0 255 ECU_ADDRESS 0 READ_WRITE /end MEASUREMENT
/begin MEASUREMENT Rte_FaultLog_FaultLog.CTCPassData[12].Reserved1_Cnt_u08 "MICROSAR RTE" UBYTE NO_COMPU_METHOD 0 0 0 255 ECU_ADDRESS 0 READ_WRITE /end MEASUREMENT
/begin MEASUREMENT Rte_FaultLog_FaultLog.CTCPassData[12].Reserved2_Cnt_u08 "MICROSAR RTE" UBYTE NO_COMPU_METHOD 0 0 0 255 ECU_ADDRESS 0 READ_WRITE /end MEASUREMENT
/begin MEASUREMENT Rte_FaultLog_FaultLog.CTCPassData[13].Byte1_Cnt_u08 "MICROSAR RTE" UBYTE NO_COMPU_METHOD 0 0 0 255 ECU_ADDRESS 0 READ_WRITE /end MEASUREMENT
/begin MEASUREMENT Rte_FaultLog_FaultLog.CTCPassData[13].Byte2_Cnt_u08 "MICROSAR RTE" UBYTE NO_COMPU_METHOD 0 0 0 255 ECU_ADDRESS 0 READ_WRITE /end MEASUREMENT
/begin MEASUREMENT Rte_FaultLog_FaultLog.CTCPassData[13].Byte3_Cnt_u08 "MICROSAR RTE" UBYTE NO_COMPU_METHOD 0 0 0 255 ECU_ADDRESS 0 READ_WRITE /end MEASUREMENT
/begin MEASUREMENT Rte_FaultLog_FaultLog.CTCPassData[13].Byte4_Cnt_u08 "MICROSAR RTE" UBYTE NO_COMPU_METHOD 0 0 0 255 ECU_ADDRESS 0 READ_WRITE /end MEASUREMENT
/begin MEASUREMENT Rte_FaultLog_FaultLog.CTCPassData[13].Byte5_Cnt_u08 "MICROSAR RTE" UBYTE NO_COMPU_METHOD 0 0 0 255 ECU_ADDRESS 0 READ_WRITE /end MEASUREMENT
/begin MEASUREMENT Rte_FaultLog_FaultLog.CTCPassData[13].Byte6_Cnt_u08 "MICROSAR RTE" UBYTE NO_COMPU_METHOD 0 0 0 255 ECU_ADDRESS 0 READ_WRITE /end MEASUREMENT
/begin MEASUREMENT Rte_FaultLog_FaultLog.CTCPassData[13].Reserved1_Cnt_u08 "MICROSAR RTE" UBYTE NO_COMPU_METHOD 0 0 0 255 ECU_ADDRESS 0 READ_WRITE /end MEASUREMENT
/begin MEASUREMENT Rte_FaultLog_FaultLog.CTCPassData[13].Reserved2_Cnt_u08 "MICROSAR RTE" UBYTE NO_COMPU_METHOD 0 0 0 255 ECU_ADDRESS 0 READ_WRITE /end MEASUREMENT
/begin MEASUREMENT Rte_FaultLog_FaultLog.CTCPassData[14].Byte1_Cnt_u08 "MICROSAR RTE" UBYTE NO_COMPU_METHOD 0 0 0 255 ECU_ADDRESS 0 READ_WRITE /end MEASUREMENT
/begin MEASUREMENT Rte_FaultLog_FaultLog.CTCPassData[14].Byte2_Cnt_u08 "MICROSAR RTE" UBYTE NO_COMPU_METHOD 0 0 0 255 ECU_ADDRESS 0 READ_WRITE /end MEASUREMENT
/begin MEASUREMENT Rte_FaultLog_FaultLog.CTCPassData[14].Byte3_Cnt_u08 "MICROSAR RTE" UBYTE NO_COMPU_METHOD 0 0 0 255 ECU_ADDRESS 0 READ_WRITE /end MEASUREMENT
/begin MEASUREMENT Rte_FaultLog_FaultLog.CTCPassData[14].Byte4_Cnt_u08 "MICROSAR RTE" UBYTE NO_COMPU_METHOD 0 0 0 255 ECU_ADDRESS 0 READ_WRITE /end MEASUREMENT
/begin MEASUREMENT Rte_FaultLog_FaultLog.CTCPassData[14].Byte5_Cnt_u08 "MICROSAR RTE" UBYTE NO_COMPU_METHOD 0 0 0 255 ECU_ADDRESS 0 READ_WRITE /end MEASUREMENT
/begin MEASUREMENT Rte_FaultLog_FaultLog.CTCPassData[14].Byte6_Cnt_u08 "MICROSAR RTE" UBYTE NO_COMPU_METHOD 0 0 0 255 ECU_ADDRESS 0 READ_WRITE /end MEASUREMENT
/begin MEASUREMENT Rte_FaultLog_FaultLog.CTCPassData[14].Reserved1_Cnt_u08 "MICROSAR RTE" UBYTE NO_COMPU_METHOD 0 0 0 255 ECU_ADDRESS 0 READ_WRITE /end MEASUREMENT
/begin MEASUREMENT Rte_FaultLog_FaultLog.CTCPassData[14].Reserved2_Cnt_u08 "MICROSAR RTE" UBYTE NO_COMPU_METHOD 0 0 0 255 ECU_ADDRESS 0 READ_WRITE /end MEASUREMENT
/begin MEASUREMENT Rte_FaultLog_FaultLog.CTCPassData[15].Byte1_Cnt_u08 "MICROSAR RTE" UBYTE NO_COMPU_METHOD 0 0 0 255 ECU_ADDRESS 0 READ_WRITE /end MEASUREMENT
/begin MEASUREMENT Rte_FaultLog_FaultLog.CTCPassData[15].Byte2_Cnt_u08 "MICROSAR RTE" UBYTE NO_COMPU_METHOD 0 0 0 255 ECU_ADDRESS 0 READ_WRITE /end MEASUREMENT
/begin MEASUREMENT Rte_FaultLog_FaultLog.CTCPassData[15].Byte3_Cnt_u08 "MICROSAR RTE" UBYTE NO_COMPU_METHOD 0 0 0 255 ECU_ADDRESS 0 READ_WRITE /end MEASUREMENT
/begin MEASUREMENT Rte_FaultLog_FaultLog.CTCPassData[15].Byte4_Cnt_u08 "MICROSAR RTE" UBYTE NO_COMPU_METHOD 0 0 0 255 ECU_ADDRESS 0 READ_WRITE /end MEASUREMENT
/begin MEASUREMENT Rte_FaultLog_FaultLog.CTCPassData[15].Byte5_Cnt_u08 "MICROSAR RTE" UBYTE NO_COMPU_METHOD 0 0 0 255 ECU_ADDRESS 0 READ_WRITE /end MEASUREMENT
/begin MEASUREMENT Rte_FaultLog_FaultLog.CTCPassData[15].Byte6_Cnt_u08 "MICROSAR RTE" UBYTE NO_COMPU_METHOD 0 0 0 255 ECU_ADDRESS 0 READ_WRITE /end MEASUREMENT
/begin MEASUREMENT Rte_FaultLog_FaultLog.CTCPassData[15].Reserved1_Cnt_u08 "MICROSAR RTE" UBYTE NO_COMPU_METHOD 0 0 0 255 ECU_ADDRESS 0 READ_WRITE /end MEASUREMENT
/begin MEASUREMENT Rte_FaultLog_FaultLog.CTCPassData[15].Reserved2_Cnt_u08 "MICROSAR RTE" UBYTE NO_COMPU_METHOD 0 0 0 255 ECU_ADDRESS 0 READ_WRITE /end MEASUREMENT
/begin MEASUREMENT Rte_FaultLog_FaultLog.CTCPassData[16].Byte1_Cnt_u08 "MICROSAR RTE" UBYTE NO_COMPU_METHOD 0 0 0 255 ECU_ADDRESS 0 READ_WRITE /end MEASUREMENT
/begin MEASUREMENT Rte_FaultLog_FaultLog.CTCPassData[16].Byte2_Cnt_u08 "MICROSAR RTE" UBYTE NO_COMPU_METHOD 0 0 0 255 ECU_ADDRESS 0 READ_WRITE /end MEASUREMENT
/begin MEASUREMENT Rte_FaultLog_FaultLog.CTCPassData[16].Byte3_Cnt_u08 "MICROSAR RTE" UBYTE NO_COMPU_METHOD 0 0 0 255 ECU_ADDRESS 0 READ_WRITE /end MEASUREMENT
/begin MEASUREMENT Rte_FaultLog_FaultLog.CTCPassData[16].Byte4_Cnt_u08 "MICROSAR RTE" UBYTE NO_COMPU_METHOD 0 0 0 255 ECU_ADDRESS 0 READ_WRITE /end MEASUREMENT
/begin MEASUREMENT Rte_FaultLog_FaultLog.CTCPassData[16].Byte5_Cnt_u08 "MICROSAR RTE" UBYTE NO_COMPU_METHOD 0 0 0 255 ECU_ADDRESS 0 READ_WRITE /end MEASUREMENT
/begin MEASUREMENT Rte_FaultLog_FaultLog.CTCPassData[16].Byte6_Cnt_u08 "MICROSAR RTE" UBYTE NO_COMPU_METHOD 0 0 0 255 ECU_ADDRESS 0 READ_WRITE /end MEASUREMENT
/begin MEASUREMENT Rte_FaultLog_FaultLog.CTCPassData[16].Reserved1_Cnt_u08 "MICROSAR RTE" UBYTE NO_COMPU_METHOD 0 0 0 255 ECU_ADDRESS 0 READ_WRITE /end MEASUREMENT
/begin MEASUREMENT Rte_FaultLog_FaultLog.CTCPassData[16].Reserved2_Cnt_u08 "MICROSAR RTE" UBYTE NO_COMPU_METHOD 0 0 0 255 ECU_ADDRESS 0 READ_WRITE /end MEASUREMENT
/begin MEASUREMENT Rte_FaultLog_FaultLog.CTCPassData[17].Byte1_Cnt_u08 "MICROSAR RTE" UBYTE NO_COMPU_METHOD 0 0 0 255 ECU_ADDRESS 0 READ_WRITE /end MEASUREMENT
/begin MEASUREMENT Rte_FaultLog_FaultLog.CTCPassData[17].Byte2_Cnt_u08 "MICROSAR RTE" UBYTE NO_COMPU_METHOD 0 0 0 255 ECU_ADDRESS 0 READ_WRITE /end MEASUREMENT
/begin MEASUREMENT Rte_FaultLog_FaultLog.CTCPassData[17].Byte3_Cnt_u08 "MICROSAR RTE" UBYTE NO_COMPU_METHOD 0 0 0 255 ECU_ADDRESS 0 READ_WRITE /end MEASUREMENT
/begin MEASUREMENT Rte_FaultLog_FaultLog.CTCPassData[17].Byte4_Cnt_u08 "MICROSAR RTE" UBYTE NO_COMPU_METHOD 0 0 0 255 ECU_ADDRESS 0 READ_WRITE /end MEASUREMENT
/begin MEASUREMENT Rte_FaultLog_FaultLog.CTCPassData[17].Byte5_Cnt_u08 "MICROSAR RTE" UBYTE NO_COMPU_METHOD 0 0 0 255 ECU_ADDRESS 0 READ_WRITE /end MEASUREMENT
/begin MEASUREMENT Rte_FaultLog_FaultLog.CTCPassData[17].Byte6_Cnt_u08 "MICROSAR RTE" UBYTE NO_COMPU_METHOD 0 0 0 255 ECU_ADDRESS 0 READ_WRITE /end MEASUREMENT
/begin MEASUREMENT Rte_FaultLog_FaultLog.CTCPassData[17].Reserved1_Cnt_u08 "MICROSAR RTE" UBYTE NO_COMPU_METHOD 0 0 0 255 ECU_ADDRESS 0 READ_WRITE /end MEASUREMENT
/begin MEASUREMENT Rte_FaultLog_FaultLog.CTCPassData[17].Reserved2_Cnt_u08 "MICROSAR RTE" UBYTE NO_COMPU_METHOD 0 0 0 255 ECU_ADDRESS 0 READ_WRITE /end MEASUREMENT
/begin MEASUREMENT Rte_FaultLog_FaultLog.CTCPassData[18].Byte1_Cnt_u08 "MICROSAR RTE" UBYTE NO_COMPU_METHOD 0 0 0 255 ECU_ADDRESS 0 READ_WRITE /end MEASUREMENT
/begin MEASUREMENT Rte_FaultLog_FaultLog.CTCPassData[18].Byte2_Cnt_u08 "MICROSAR RTE" UBYTE NO_COMPU_METHOD 0 0 0 255 ECU_ADDRESS 0 READ_WRITE /end MEASUREMENT
/begin MEASUREMENT Rte_FaultLog_FaultLog.CTCPassData[18].Byte3_Cnt_u08 "MICROSAR RTE" UBYTE NO_COMPU_METHOD 0 0 0 255 ECU_ADDRESS 0 READ_WRITE /end MEASUREMENT
/begin MEASUREMENT Rte_FaultLog_FaultLog.CTCPassData[18].Byte4_Cnt_u08 "MICROSAR RTE" UBYTE NO_COMPU_METHOD 0 0 0 255 ECU_ADDRESS 0 READ_WRITE /end MEASUREMENT
/begin MEASUREMENT Rte_FaultLog_FaultLog.CTCPassData[18].Byte5_Cnt_u08 "MICROSAR RTE" UBYTE NO_COMPU_METHOD 0 0 0 255 ECU_ADDRESS 0 READ_WRITE /end MEASUREMENT
/begin MEASUREMENT Rte_FaultLog_FaultLog.CTCPassData[18].Byte6_Cnt_u08 "MICROSAR RTE" UBYTE NO_COMPU_METHOD 0 0 0 255 ECU_ADDRESS 0 READ_WRITE /end MEASUREMENT
/begin MEASUREMENT Rte_FaultLog_FaultLog.CTCPassData[18].Reserved1_Cnt_u08 "MICROSAR RTE" UBYTE NO_COMPU_METHOD 0 0 0 255 ECU_ADDRESS 0 READ_WRITE /end MEASUREMENT
/begin MEASUREMENT Rte_FaultLog_FaultLog.CTCPassData[18].Reserved2_Cnt_u08 "MICROSAR RTE" UBYTE NO_COMPU_METHOD 0 0 0 255 ECU_ADDRESS 0 READ_WRITE /end MEASUREMENT
/begin MEASUREMENT Rte_FaultLog_FaultLog.CTCPassData[19].Byte1_Cnt_u08 "MICROSAR RTE" UBYTE NO_COMPU_METHOD 0 0 0 255 ECU_ADDRESS 0 READ_WRITE /end MEASUREMENT
/begin MEASUREMENT Rte_FaultLog_FaultLog.CTCPassData[19].Byte2_Cnt_u08 "MICROSAR RTE" UBYTE NO_COMPU_METHOD 0 0 0 255 ECU_ADDRESS 0 READ_WRITE /end MEASUREMENT
/begin MEASUREMENT Rte_FaultLog_FaultLog.CTCPassData[19].Byte3_Cnt_u08 "MICROSAR RTE" UBYTE NO_COMPU_METHOD 0 0 0 255 ECU_ADDRESS 0 READ_WRITE /end MEASUREMENT
/begin MEASUREMENT Rte_FaultLog_FaultLog.CTCPassData[19].Byte4_Cnt_u08 "MICROSAR RTE" UBYTE NO_COMPU_METHOD 0 0 0 255 ECU_ADDRESS 0 READ_WRITE /end MEASUREMENT
/begin MEASUREMENT Rte_FaultLog_FaultLog.CTCPassData[19].Byte5_Cnt_u08 "MICROSAR RTE" UBYTE NO_COMPU_METHOD 0 0 0 255 ECU_ADDRESS 0 READ_WRITE /end MEASUREMENT
/begin MEASUREMENT Rte_FaultLog_FaultLog.CTCPassData[19].Byte6_Cnt_u08 "MICROSAR RTE" UBYTE NO_COMPU_METHOD 0 0 0 255 ECU_ADDRESS 0 READ_WRITE /end MEASUREMENT
/begin MEASUREMENT Rte_FaultLog_FaultLog.CTCPassData[19].Reserved1_Cnt_u08 "MICROSAR RTE" UBYTE NO_COMPU_METHOD 0 0 0 255 ECU_ADDRESS 0 READ_WRITE /end MEASUREMENT
/begin MEASUREMENT Rte_FaultLog_FaultLog.CTCPassData[19].Reserved2_Cnt_u08 "MICROSAR RTE" UBYTE NO_COMPU_METHOD 0 0 0 255 ECU_ADDRESS 0 READ_WRITE /end MEASUREMENT
/begin MEASUREMENT Rte_FaultLog_FaultLog.CTCPassData[1].Byte1_Cnt_u08 "MICROSAR RTE" UBYTE NO_COMPU_METHOD 0 0 0 255 ECU_ADDRESS 0 READ_WRITE /end MEASUREMENT
/begin MEASUREMENT Rte_FaultLog_FaultLog.CTCPassData[1].Byte2_Cnt_u08 "MICROSAR RTE" UBYTE NO_COMPU_METHOD 0 0 0 255 ECU_ADDRESS 0 READ_WRITE /end MEASUREMENT
/begin MEASUREMENT Rte_FaultLog_FaultLog.CTCPassData[1].Byte3_Cnt_u08 "MICROSAR RTE" UBYTE NO_COMPU_METHOD 0 0 0 255 ECU_ADDRESS 0 READ_WRITE /end MEASUREMENT
/begin MEASUREMENT Rte_FaultLog_FaultLog.CTCPassData[1].Byte4_Cnt_u08 "MICROSAR RTE" UBYTE NO_COMPU_METHOD 0 0 0 255 ECU_ADDRESS 0 READ_WRITE /end MEASUREMENT
/begin MEASUREMENT Rte_FaultLog_FaultLog.CTCPassData[1].Byte5_Cnt_u08 "MICROSAR RTE" UBYTE NO_COMPU_METHOD 0 0 0 255 ECU_ADDRESS 0 READ_WRITE /end MEASUREMENT
/begin MEASUREMENT Rte_FaultLog_FaultLog.CTCPassData[1].Byte6_Cnt_u08 "MICROSAR RTE" UBYTE NO_COMPU_METHOD 0 0 0 255 ECU_ADDRESS 0 READ_WRITE /end MEASUREMENT
/begin MEASUREMENT Rte_FaultLog_FaultLog.CTCPassData[1].Reserved1_Cnt_u08 "MICROSAR RTE" UBYTE NO_COMPU_METHOD 0 0 0 255 ECU_ADDRESS 0 READ_WRITE /end MEASUREMENT
/begin MEASUREMENT Rte_FaultLog_FaultLog.CTCPassData[1].Reserved2_Cnt_u08 "MICROSAR RTE" UBYTE NO_COMPU_METHOD 0 0 0 255 ECU_ADDRESS 0 READ_WRITE /end MEASUREMENT
/begin MEASUREMENT Rte_FaultLog_FaultLog.CTCPassData[20].Byte1_Cnt_u08 "MICROSAR RTE" UBYTE NO_COMPU_METHOD 0 0 0 255 ECU_ADDRESS 0 READ_WRITE /end MEASUREMENT
/begin MEASUREMENT Rte_FaultLog_FaultLog.CTCPassData[20].Byte2_Cnt_u08 "MICROSAR RTE" UBYTE NO_COMPU_METHOD 0 0 0 255 ECU_ADDRESS 0 READ_WRITE /end MEASUREMENT
/begin MEASUREMENT Rte_FaultLog_FaultLog.CTCPassData[20].Byte3_Cnt_u08 "MICROSAR RTE" UBYTE NO_COMPU_METHOD 0 0 0 255 ECU_ADDRESS 0 READ_WRITE /end MEASUREMENT
/begin MEASUREMENT Rte_FaultLog_FaultLog.CTCPassData[20].Byte4_Cnt_u08 "MICROSAR RTE" UBYTE NO_COMPU_METHOD 0 0 0 255 ECU_ADDRESS 0 READ_WRITE /end MEASUREMENT
/begin MEASUREMENT Rte_FaultLog_FaultLog.CTCPassData[20].Byte5_Cnt_u08 "MICROSAR RTE" UBYTE NO_COMPU_METHOD 0 0 0 255 ECU_ADDRESS 0 READ_WRITE /end MEASUREMENT
/begin MEASUREMENT Rte_FaultLog_FaultLog.CTCPassData[20].Byte6_Cnt_u08 "MICROSAR RTE" UBYTE NO_COMPU_METHOD 0 0 0 255 ECU_ADDRESS 0 READ_WRITE /end MEASUREMENT
/begin MEASUREMENT Rte_FaultLog_FaultLog.CTCPassData[20].Reserved1_Cnt_u08 "MICROSAR RTE" UBYTE NO_COMPU_METHOD 0 0 0 255 ECU_ADDRESS 0 READ_WRITE /end MEASUREMENT
/begin MEASUREMENT Rte_FaultLog_FaultLog.CTCPassData[20].Reserved2_Cnt_u08 "MICROSAR RTE" UBYTE NO_COMPU_METHOD 0 0 0 255 ECU_ADDRESS 0 READ_WRITE /end MEASUREMENT
/begin MEASUREMENT Rte_FaultLog_FaultLog.CTCPassData[21].Byte1_Cnt_u08 "MICROSAR RTE" UBYTE NO_COMPU_METHOD 0 0 0 255 ECU_ADDRESS 0 READ_WRITE /end MEASUREMENT
/begin MEASUREMENT Rte_FaultLog_FaultLog.CTCPassData[21].Byte2_Cnt_u08 "MICROSAR RTE" UBYTE NO_COMPU_METHOD 0 0 0 255 ECU_ADDRESS 0 READ_WRITE /end MEASUREMENT
/begin MEASUREMENT Rte_FaultLog_FaultLog.CTCPassData[21].Byte3_Cnt_u08 "MICROSAR RTE" UBYTE NO_COMPU_METHOD 0 0 0 255 ECU_ADDRESS 0 READ_WRITE /end MEASUREMENT
/begin MEASUREMENT Rte_FaultLog_FaultLog.CTCPassData[21].Byte4_Cnt_u08 "MICROSAR RTE" UBYTE NO_COMPU_METHOD 0 0 0 255 ECU_ADDRESS 0 READ_WRITE /end MEASUREMENT
/begin MEASUREMENT Rte_FaultLog_FaultLog.CTCPassData[21].Byte5_Cnt_u08 "MICROSAR RTE" UBYTE NO_COMPU_METHOD 0 0 0 255 ECU_ADDRESS 0 READ_WRITE /end MEASUREMENT
/begin MEASUREMENT Rte_FaultLog_FaultLog.CTCPassData[21].Byte6_Cnt_u08 "MICROSAR RTE" UBYTE NO_COMPU_METHOD 0 0 0 255 ECU_ADDRESS 0 READ_WRITE /end MEASUREMENT
/begin MEASUREMENT Rte_FaultLog_FaultLog.CTCPassData[21].Reserved1_Cnt_u08 "MICROSAR RTE" UBYTE NO_COMPU_METHOD 0 0 0 255 ECU_ADDRESS 0 READ_WRITE /end MEASUREMENT
/begin MEASUREMENT Rte_FaultLog_FaultLog.CTCPassData[21].Reserved2_Cnt_u08 "MICROSAR RTE" UBYTE NO_COMPU_METHOD 0 0 0 255 ECU_ADDRESS 0 READ_WRITE /end MEASUREMENT
/begin MEASUREMENT Rte_FaultLog_FaultLog.CTCPassData[22].Byte1_Cnt_u08 "MICROSAR RTE" UBYTE NO_COMPU_METHOD 0 0 0 255 ECU_ADDRESS 0 READ_WRITE /end MEASUREMENT
/begin MEASUREMENT Rte_FaultLog_FaultLog.CTCPassData[22].Byte2_Cnt_u08 "MICROSAR RTE" UBYTE NO_COMPU_METHOD 0 0 0 255 ECU_ADDRESS 0 READ_WRITE /end MEASUREMENT
/begin MEASUREMENT Rte_FaultLog_FaultLog.CTCPassData[22].Byte3_Cnt_u08 "MICROSAR RTE" UBYTE NO_COMPU_METHOD 0 0 0 255 ECU_ADDRESS 0 READ_WRITE /end MEASUREMENT
/begin MEASUREMENT Rte_FaultLog_FaultLog.CTCPassData[22].Byte4_Cnt_u08 "MICROSAR RTE" UBYTE NO_COMPU_METHOD 0 0 0 255 ECU_ADDRESS 0 READ_WRITE /end MEASUREMENT
/begin MEASUREMENT Rte_FaultLog_FaultLog.CTCPassData[22].Byte5_Cnt_u08 "MICROSAR RTE" UBYTE NO_COMPU_METHOD 0 0 0 255 ECU_ADDRESS 0 READ_WRITE /end MEASUREMENT
/begin MEASUREMENT Rte_FaultLog_FaultLog.CTCPassData[22].Byte6_Cnt_u08 "MICROSAR RTE" UBYTE NO_COMPU_METHOD 0 0 0 255 ECU_ADDRESS 0 READ_WRITE /end MEASUREMENT
/begin MEASUREMENT Rte_FaultLog_FaultLog.CTCPassData[22].Reserved1_Cnt_u08 "MICROSAR RTE" UBYTE NO_COMPU_METHOD 0 0 0 255 ECU_ADDRESS 0 READ_WRITE /end MEASUREMENT
/begin MEASUREMENT Rte_FaultLog_FaultLog.CTCPassData[22].Reserved2_Cnt_u08 "MICROSAR RTE" UBYTE NO_COMPU_METHOD 0 0 0 255 ECU_ADDRESS 0 READ_WRITE /end MEASUREMENT
/begin MEASUREMENT Rte_FaultLog_FaultLog.CTCPassData[23].Byte1_Cnt_u08 "MICROSAR RTE" UBYTE NO_COMPU_METHOD 0 0 0 255 ECU_ADDRESS 0 READ_WRITE /end MEASUREMENT
/begin MEASUREMENT Rte_FaultLog_FaultLog.CTCPassData[23].Byte2_Cnt_u08 "MICROSAR RTE" UBYTE NO_COMPU_METHOD 0 0 0 255 ECU_ADDRESS 0 READ_WRITE /end MEASUREMENT
/begin MEASUREMENT Rte_FaultLog_FaultLog.CTCPassData[23].Byte3_Cnt_u08 "MICROSAR RTE" UBYTE NO_COMPU_METHOD 0 0 0 255 ECU_ADDRESS 0 READ_WRITE /end MEASUREMENT
/begin MEASUREMENT Rte_FaultLog_FaultLog.CTCPassData[23].Byte4_Cnt_u08 "MICROSAR RTE" UBYTE NO_COMPU_METHOD 0 0 0 255 ECU_ADDRESS 0 READ_WRITE /end MEASUREMENT
/begin MEASUREMENT Rte_FaultLog_FaultLog.CTCPassData[23].Byte5_Cnt_u08 "MICROSAR RTE" UBYTE NO_COMPU_METHOD 0 0 0 255 ECU_ADDRESS 0 READ_WRITE /end MEASUREMENT
/begin MEASUREMENT Rte_FaultLog_FaultLog.CTCPassData[23].Byte6_Cnt_u08 "MICROSAR RTE" UBYTE NO_COMPU_METHOD 0 0 0 255 ECU_ADDRESS 0 READ_WRITE /end MEASUREMENT
/begin MEASUREMENT Rte_FaultLog_FaultLog.CTCPassData[23].Reserved1_Cnt_u08 "MICROSAR RTE" UBYTE NO_COMPU_METHOD 0 0 0 255 ECU_ADDRESS 0 READ_WRITE /end MEASUREMENT
/begin MEASUREMENT Rte_FaultLog_FaultLog.CTCPassData[23].Reserved2_Cnt_u08 "MICROSAR RTE" UBYTE NO_COMPU_METHOD 0 0 0 255 ECU_ADDRESS 0 READ_WRITE /end MEASUREMENT
/begin MEASUREMENT Rte_FaultLog_FaultLog.CTCPassData[24].Byte1_Cnt_u08 "MICROSAR RTE" UBYTE NO_COMPU_METHOD 0 0 0 255 ECU_ADDRESS 0 READ_WRITE /end MEASUREMENT
/begin MEASUREMENT Rte_FaultLog_FaultLog.CTCPassData[24].Byte2_Cnt_u08 "MICROSAR RTE" UBYTE NO_COMPU_METHOD 0 0 0 255 ECU_ADDRESS 0 READ_WRITE /end MEASUREMENT
/begin MEASUREMENT Rte_FaultLog_FaultLog.CTCPassData[24].Byte3_Cnt_u08 "MICROSAR RTE" UBYTE NO_COMPU_METHOD 0 0 0 255 ECU_ADDRESS 0 READ_WRITE /end MEASUREMENT
/begin MEASUREMENT Rte_FaultLog_FaultLog.CTCPassData[24].Byte4_Cnt_u08 "MICROSAR RTE" UBYTE NO_COMPU_METHOD 0 0 0 255 ECU_ADDRESS 0 READ_WRITE /end MEASUREMENT
/begin MEASUREMENT Rte_FaultLog_FaultLog.CTCPassData[24].Byte5_Cnt_u08 "MICROSAR RTE" UBYTE NO_COMPU_METHOD 0 0 0 255 ECU_ADDRESS 0 READ_WRITE /end MEASUREMENT
/begin MEASUREMENT Rte_FaultLog_FaultLog.CTCPassData[24].Byte6_Cnt_u08 "MICROSAR RTE" UBYTE NO_COMPU_METHOD 0 0 0 255 ECU_ADDRESS 0 READ_WRITE /end MEASUREMENT
/begin MEASUREMENT Rte_FaultLog_FaultLog.CTCPassData[24].Reserved1_Cnt_u08 "MICROSAR RTE" UBYTE NO_COMPU_METHOD 0 0 0 255 ECU_ADDRESS 0 READ_WRITE /end MEASUREMENT
/begin MEASUREMENT Rte_FaultLog_FaultLog.CTCPassData[24].Reserved2_Cnt_u08 "MICROSAR RTE" UBYTE NO_COMPU_METHOD 0 0 0 255 ECU_ADDRESS 0 READ_WRITE /end MEASUREMENT
/begin MEASUREMENT Rte_FaultLog_FaultLog.CTCPassData[25].Byte1_Cnt_u08 "MICROSAR RTE" UBYTE NO_COMPU_METHOD 0 0 0 255 ECU_ADDRESS 0 READ_WRITE /end MEASUREMENT
/begin MEASUREMENT Rte_FaultLog_FaultLog.CTCPassData[25].Byte2_Cnt_u08 "MICROSAR RTE" UBYTE NO_COMPU_METHOD 0 0 0 255 ECU_ADDRESS 0 READ_WRITE /end MEASUREMENT
/begin MEASUREMENT Rte_FaultLog_FaultLog.CTCPassData[25].Byte3_Cnt_u08 "MICROSAR RTE" UBYTE NO_COMPU_METHOD 0 0 0 255 ECU_ADDRESS 0 READ_WRITE /end MEASUREMENT
/begin MEASUREMENT Rte_FaultLog_FaultLog.CTCPassData[25].Byte4_Cnt_u08 "MICROSAR RTE" UBYTE NO_COMPU_METHOD 0 0 0 255 ECU_ADDRESS 0 READ_WRITE /end MEASUREMENT
/begin MEASUREMENT Rte_FaultLog_FaultLog.CTCPassData[25].Byte5_Cnt_u08 "MICROSAR RTE" UBYTE NO_COMPU_METHOD 0 0 0 255 ECU_ADDRESS 0 READ_WRITE /end MEASUREMENT
/begin MEASUREMENT Rte_FaultLog_FaultLog.CTCPassData[25].Byte6_Cnt_u08 "MICROSAR RTE" UBYTE NO_COMPU_METHOD 0 0 0 255 ECU_ADDRESS 0 READ_WRITE /end MEASUREMENT
/begin MEASUREMENT Rte_FaultLog_FaultLog.CTCPassData[25].Reserved1_Cnt_u08 "MICROSAR RTE" UBYTE NO_COMPU_METHOD 0 0 0 255 ECU_ADDRESS 0 READ_WRITE /end MEASUREMENT
/begin MEASUREMENT Rte_FaultLog_FaultLog.CTCPassData[25].Reserved2_Cnt_u08 "MICROSAR RTE" UBYTE NO_COMPU_METHOD 0 0 0 255 ECU_ADDRESS 0 READ_WRITE /end MEASUREMENT
/begin MEASUREMENT Rte_FaultLog_FaultLog.CTCPassData[26].Byte1_Cnt_u08 "MICROSAR RTE" UBYTE NO_COMPU_METHOD 0 0 0 255 ECU_ADDRESS 0 READ_WRITE /end MEASUREMENT
/begin MEASUREMENT Rte_FaultLog_FaultLog.CTCPassData[26].Byte2_Cnt_u08 "MICROSAR RTE" UBYTE NO_COMPU_METHOD 0 0 0 255 ECU_ADDRESS 0 READ_WRITE /end MEASUREMENT
/begin MEASUREMENT Rte_FaultLog_FaultLog.CTCPassData[26].Byte3_Cnt_u08 "MICROSAR RTE" UBYTE NO_COMPU_METHOD 0 0 0 255 ECU_ADDRESS 0 READ_WRITE /end MEASUREMENT
/begin MEASUREMENT Rte_FaultLog_FaultLog.CTCPassData[26].Byte4_Cnt_u08 "MICROSAR RTE" UBYTE NO_COMPU_METHOD 0 0 0 255 ECU_ADDRESS 0 READ_WRITE /end MEASUREMENT
/begin MEASUREMENT Rte_FaultLog_FaultLog.CTCPassData[26].Byte5_Cnt_u08 "MICROSAR RTE" UBYTE NO_COMPU_METHOD 0 0 0 255 ECU_ADDRESS 0 READ_WRITE /end MEASUREMENT
/begin MEASUREMENT Rte_FaultLog_FaultLog.CTCPassData[26].Byte6_Cnt_u08 "MICROSAR RTE" UBYTE NO_COMPU_METHOD 0 0 0 255 ECU_ADDRESS 0 READ_WRITE /end MEASUREMENT
/begin MEASUREMENT Rte_FaultLog_FaultLog.CTCPassData[26].Reserved1_Cnt_u08 "MICROSAR RTE" UBYTE NO_COMPU_METHOD 0 0 0 255 ECU_ADDRESS 0 READ_WRITE /end MEASUREMENT
/begin MEASUREMENT Rte_FaultLog_FaultLog.CTCPassData[26].Reserved2_Cnt_u08 "MICROSAR RTE" UBYTE NO_COMPU_METHOD 0 0 0 255 ECU_ADDRESS 0 READ_WRITE /end MEASUREMENT
/begin MEASUREMENT Rte_FaultLog_FaultLog.CTCPassData[27].Byte1_Cnt_u08 "MICROSAR RTE" UBYTE NO_COMPU_METHOD 0 0 0 255 ECU_ADDRESS 0 READ_WRITE /end MEASUREMENT
/begin MEASUREMENT Rte_FaultLog_FaultLog.CTCPassData[27].Byte2_Cnt_u08 "MICROSAR RTE" UBYTE NO_COMPU_METHOD 0 0 0 255 ECU_ADDRESS 0 READ_WRITE /end MEASUREMENT
/begin MEASUREMENT Rte_FaultLog_FaultLog.CTCPassData[27].Byte3_Cnt_u08 "MICROSAR RTE" UBYTE NO_COMPU_METHOD 0 0 0 255 ECU_ADDRESS 0 READ_WRITE /end MEASUREMENT
/begin MEASUREMENT Rte_FaultLog_FaultLog.CTCPassData[27].Byte4_Cnt_u08 "MICROSAR RTE" UBYTE NO_COMPU_METHOD 0 0 0 255 ECU_ADDRESS 0 READ_WRITE /end MEASUREMENT
/begin MEASUREMENT Rte_FaultLog_FaultLog.CTCPassData[27].Byte5_Cnt_u08 "MICROSAR RTE" UBYTE NO_COMPU_METHOD 0 0 0 255 ECU_ADDRESS 0 READ_WRITE /end MEASUREMENT
/begin MEASUREMENT Rte_FaultLog_FaultLog.CTCPassData[27].Byte6_Cnt_u08 "MICROSAR RTE" UBYTE NO_COMPU_METHOD 0 0 0 255 ECU_ADDRESS 0 READ_WRITE /end MEASUREMENT
/begin MEASUREMENT Rte_FaultLog_FaultLog.CTCPassData[27].Reserved1_Cnt_u08 "MICROSAR RTE" UBYTE NO_COMPU_METHOD 0 0 0 255 ECU_ADDRESS 0 READ_WRITE /end MEASUREMENT
/begin MEASUREMENT Rte_FaultLog_FaultLog.CTCPassData[27].Reserved2_Cnt_u08 "MICROSAR RTE" UBYTE NO_COMPU_METHOD 0 0 0 255 ECU_ADDRESS 0 READ_WRITE /end MEASUREMENT
/begin MEASUREMENT Rte_FaultLog_FaultLog.CTCPassData[28].Byte1_Cnt_u08 "MICROSAR RTE" UBYTE NO_COMPU_METHOD 0 0 0 255 ECU_ADDRESS 0 READ_WRITE /end MEASUREMENT
/begin MEASUREMENT Rte_FaultLog_FaultLog.CTCPassData[28].Byte2_Cnt_u08 "MICROSAR RTE" UBYTE NO_COMPU_METHOD 0 0 0 255 ECU_ADDRESS 0 READ_WRITE /end MEASUREMENT
/begin MEASUREMENT Rte_FaultLog_FaultLog.CTCPassData[28].Byte3_Cnt_u08 "MICROSAR RTE" UBYTE NO_COMPU_METHOD 0 0 0 255 ECU_ADDRESS 0 READ_WRITE /end MEASUREMENT
/begin MEASUREMENT Rte_FaultLog_FaultLog.CTCPassData[28].Byte4_Cnt_u08 "MICROSAR RTE" UBYTE NO_COMPU_METHOD 0 0 0 255 ECU_ADDRESS 0 READ_WRITE /end MEASUREMENT
/begin MEASUREMENT Rte_FaultLog_FaultLog.CTCPassData[28].Byte5_Cnt_u08 "MICROSAR RTE" UBYTE NO_COMPU_METHOD 0 0 0 255 ECU_ADDRESS 0 READ_WRITE /end MEASUREMENT
/begin MEASUREMENT Rte_FaultLog_FaultLog.CTCPassData[28].Byte6_Cnt_u08 "MICROSAR RTE" UBYTE NO_COMPU_METHOD 0 0 0 255 ECU_ADDRESS 0 READ_WRITE /end MEASUREMENT
/begin MEASUREMENT Rte_FaultLog_FaultLog.CTCPassData[28].Reserved1_Cnt_u08 "MICROSAR RTE" UBYTE NO_COMPU_METHOD 0 0 0 255 ECU_ADDRESS 0 READ_WRITE /end MEASUREMENT
/begin MEASUREMENT Rte_FaultLog_FaultLog.CTCPassData[28].Reserved2_Cnt_u08 "MICROSAR RTE" UBYTE NO_COMPU_METHOD 0 0 0 255 ECU_ADDRESS 0 READ_WRITE /end MEASUREMENT
/begin MEASUREMENT Rte_FaultLog_FaultLog.CTCPassData[29].Byte1_Cnt_u08 "MICROSAR RTE" UBYTE NO_COMPU_METHOD 0 0 0 255 ECU_ADDRESS 0 READ_WRITE /end MEASUREMENT
/begin MEASUREMENT Rte_FaultLog_FaultLog.CTCPassData[29].Byte2_Cnt_u08 "MICROSAR RTE" UBYTE NO_COMPU_METHOD 0 0 0 255 ECU_ADDRESS 0 READ_WRITE /end MEASUREMENT
/begin MEASUREMENT Rte_FaultLog_FaultLog.CTCPassData[29].Byte3_Cnt_u08 "MICROSAR RTE" UBYTE NO_COMPU_METHOD 0 0 0 255 ECU_ADDRESS 0 READ_WRITE /end MEASUREMENT
/begin MEASUREMENT Rte_FaultLog_FaultLog.CTCPassData[29].Byte4_Cnt_u08 "MICROSAR RTE" UBYTE NO_COMPU_METHOD 0 0 0 255 ECU_ADDRESS 0 READ_WRITE /end MEASUREMENT
/begin MEASUREMENT Rte_FaultLog_FaultLog.CTCPassData[29].Byte5_Cnt_u08 "MICROSAR RTE" UBYTE NO_COMPU_METHOD 0 0 0 255 ECU_ADDRESS 0 READ_WRITE /end MEASUREMENT
/begin MEASUREMENT Rte_FaultLog_FaultLog.CTCPassData[29].Byte6_Cnt_u08 "MICROSAR RTE" UBYTE NO_COMPU_METHOD 0 0 0 255 ECU_ADDRESS 0 READ_WRITE /end MEASUREMENT
/begin MEASUREMENT Rte_FaultLog_FaultLog.CTCPassData[29].Reserved1_Cnt_u08 "MICROSAR RTE" UBYTE NO_COMPU_METHOD 0 0 0 255 ECU_ADDRESS 0 READ_WRITE /end MEASUREMENT
/begin MEASUREMENT Rte_FaultLog_FaultLog.CTCPassData[29].Reserved2_Cnt_u08 "MICROSAR RTE" UBYTE NO_COMPU_METHOD 0 0 0 255 ECU_ADDRESS 0 READ_WRITE /end MEASUREMENT
/begin MEASUREMENT Rte_FaultLog_FaultLog.CTCPassData[2].Byte1_Cnt_u08 "MICROSAR RTE" UBYTE NO_COMPU_METHOD 0 0 0 255 ECU_ADDRESS 0 READ_WRITE /end MEASUREMENT
/begin MEASUREMENT Rte_FaultLog_FaultLog.CTCPassData[2].Byte2_Cnt_u08 "MICROSAR RTE" UBYTE NO_COMPU_METHOD 0 0 0 255 ECU_ADDRESS 0 READ_WRITE /end MEASUREMENT
/begin MEASUREMENT Rte_FaultLog_FaultLog.CTCPassData[2].Byte3_Cnt_u08 "MICROSAR RTE" UBYTE NO_COMPU_METHOD 0 0 0 255 ECU_ADDRESS 0 READ_WRITE /end MEASUREMENT
/begin MEASUREMENT Rte_FaultLog_FaultLog.CTCPassData[2].Byte4_Cnt_u08 "MICROSAR RTE" UBYTE NO_COMPU_METHOD 0 0 0 255 ECU_ADDRESS 0 READ_WRITE /end MEASUREMENT
/begin MEASUREMENT Rte_FaultLog_FaultLog.CTCPassData[2].Byte5_Cnt_u08 "MICROSAR RTE" UBYTE NO_COMPU_METHOD 0 0 0 255 ECU_ADDRESS 0 READ_WRITE /end MEASUREMENT
/begin MEASUREMENT Rte_FaultLog_FaultLog.CTCPassData[2].Byte6_Cnt_u08 "MICROSAR RTE" UBYTE NO_COMPU_METHOD 0 0 0 255 ECU_ADDRESS 0 READ_WRITE /end MEASUREMENT
/begin MEASUREMENT Rte_FaultLog_FaultLog.CTCPassData[2].Reserved1_Cnt_u08 "MICROSAR RTE" UBYTE NO_COMPU_METHOD 0 0 0 255 ECU_ADDRESS 0 READ_WRITE /end MEASUREMENT
/begin MEASUREMENT Rte_FaultLog_FaultLog.CTCPassData[2].Reserved2_Cnt_u08 "MICROSAR RTE" UBYTE NO_COMPU_METHOD 0 0 0 255 ECU_ADDRESS 0 READ_WRITE /end MEASUREMENT
/begin MEASUREMENT Rte_FaultLog_FaultLog.CTCPassData[30].Byte1_Cnt_u08 "MICROSAR RTE" UBYTE NO_COMPU_METHOD 0 0 0 255 ECU_ADDRESS 0 READ_WRITE /end MEASUREMENT
/begin MEASUREMENT Rte_FaultLog_FaultLog.CTCPassData[30].Byte2_Cnt_u08 "MICROSAR RTE" UBYTE NO_COMPU_METHOD 0 0 0 255 ECU_ADDRESS 0 READ_WRITE /end MEASUREMENT
/begin MEASUREMENT Rte_FaultLog_FaultLog.CTCPassData[30].Byte3_Cnt_u08 "MICROSAR RTE" UBYTE NO_COMPU_METHOD 0 0 0 255 ECU_ADDRESS 0 READ_WRITE /end MEASUREMENT
/begin MEASUREMENT Rte_FaultLog_FaultLog.CTCPassData[30].Byte4_Cnt_u08 "MICROSAR RTE" UBYTE NO_COMPU_METHOD 0 0 0 255 ECU_ADDRESS 0 READ_WRITE /end MEASUREMENT
/begin MEASUREMENT Rte_FaultLog_FaultLog.CTCPassData[30].Byte5_Cnt_u08 "MICROSAR RTE" UBYTE NO_COMPU_METHOD 0 0 0 255 ECU_ADDRESS 0 READ_WRITE /end MEASUREMENT
/begin MEASUREMENT Rte_FaultLog_FaultLog.CTCPassData[30].Byte6_Cnt_u08 "MICROSAR RTE" UBYTE NO_COMPU_METHOD 0 0 0 255 ECU_ADDRESS 0 READ_WRITE /end MEASUREMENT
/begin MEASUREMENT Rte_FaultLog_FaultLog.CTCPassData[30].Reserved1_Cnt_u08 "MICROSAR RTE" UBYTE NO_COMPU_METHOD 0 0 0 255 ECU_ADDRESS 0 READ_WRITE /end MEASUREMENT
/begin MEASUREMENT Rte_FaultLog_FaultLog.CTCPassData[30].Reserved2_Cnt_u08 "MICROSAR RTE" UBYTE NO_COMPU_METHOD 0 0 0 255 ECU_ADDRESS 0 READ_WRITE /end MEASUREMENT
/begin MEASUREMENT Rte_FaultLog_FaultLog.CTCPassData[31].Byte1_Cnt_u08 "MICROSAR RTE" UBYTE NO_COMPU_METHOD 0 0 0 255 ECU_ADDRESS 0 READ_WRITE /end MEASUREMENT
/begin MEASUREMENT Rte_FaultLog_FaultLog.CTCPassData[31].Byte2_Cnt_u08 "MICROSAR RTE" UBYTE NO_COMPU_METHOD 0 0 0 255 ECU_ADDRESS 0 READ_WRITE /end MEASUREMENT
/begin MEASUREMENT Rte_FaultLog_FaultLog.CTCPassData[31].Byte3_Cnt_u08 "MICROSAR RTE" UBYTE NO_COMPU_METHOD 0 0 0 255 ECU_ADDRESS 0 READ_WRITE /end MEASUREMENT
/begin MEASUREMENT Rte_FaultLog_FaultLog.CTCPassData[31].Byte4_Cnt_u08 "MICROSAR RTE" UBYTE NO_COMPU_METHOD 0 0 0 255 ECU_ADDRESS 0 READ_WRITE /end MEASUREMENT
/begin MEASUREMENT Rte_FaultLog_FaultLog.CTCPassData[31].Byte5_Cnt_u08 "MICROSAR RTE" UBYTE NO_COMPU_METHOD 0 0 0 255 ECU_ADDRESS 0 READ_WRITE /end MEASUREMENT
/begin MEASUREMENT Rte_FaultLog_FaultLog.CTCPassData[31].Byte6_Cnt_u08 "MICROSAR RTE" UBYTE NO_COMPU_METHOD 0 0 0 255 ECU_ADDRESS 0 READ_WRITE /end MEASUREMENT
/begin MEASUREMENT Rte_FaultLog_FaultLog.CTCPassData[31].Reserved1_Cnt_u08 "MICROSAR RTE" UBYTE NO_COMPU_METHOD 0 0 0 255 ECU_ADDRESS 0 READ_WRITE /end MEASUREMENT
/begin MEASUREMENT Rte_FaultLog_FaultLog.CTCPassData[31].Reserved2_Cnt_u08 "MICROSAR RTE" UBYTE NO_COMPU_METHOD 0 0 0 255 ECU_ADDRESS 0 READ_WRITE /end MEASUREMENT
/begin MEASUREMENT Rte_FaultLog_FaultLog.CTCPassData[32].Byte1_Cnt_u08 "MICROSAR RTE" UBYTE NO_COMPU_METHOD 0 0 0 255 ECU_ADDRESS 0 READ_WRITE /end MEASUREMENT
/begin MEASUREMENT Rte_FaultLog_FaultLog.CTCPassData[32].Byte2_Cnt_u08 "MICROSAR RTE" UBYTE NO_COMPU_METHOD 0 0 0 255 ECU_ADDRESS 0 READ_WRITE /end MEASUREMENT
/begin MEASUREMENT Rte_FaultLog_FaultLog.CTCPassData[32].Byte3_Cnt_u08 "MICROSAR RTE" UBYTE NO_COMPU_METHOD 0 0 0 255 ECU_ADDRESS 0 READ_WRITE /end MEASUREMENT
/begin MEASUREMENT Rte_FaultLog_FaultLog.CTCPassData[32].Byte4_Cnt_u08 "MICROSAR RTE" UBYTE NO_COMPU_METHOD 0 0 0 255 ECU_ADDRESS 0 READ_WRITE /end MEASUREMENT
/begin MEASUREMENT Rte_FaultLog_FaultLog.CTCPassData[32].Byte5_Cnt_u08 "MICROSAR RTE" UBYTE NO_COMPU_METHOD 0 0 0 255 ECU_ADDRESS 0 READ_WRITE /end MEASUREMENT
/begin MEASUREMENT Rte_FaultLog_FaultLog.CTCPassData[32].Byte6_Cnt_u08 "MICROSAR RTE" UBYTE NO_COMPU_METHOD 0 0 0 255 ECU_ADDRESS 0 READ_WRITE /end MEASUREMENT
/begin MEASUREMENT Rte_FaultLog_FaultLog.CTCPassData[32].Reserved1_Cnt_u08 "MICROSAR RTE" UBYTE NO_COMPU_METHOD 0 0 0 255 ECU_ADDRESS 0 READ_WRITE /end MEASUREMENT
/begin MEASUREMENT Rte_FaultLog_FaultLog.CTCPassData[32].Reserved2_Cnt_u08 "MICROSAR RTE" UBYTE NO_COMPU_METHOD 0 0 0 255 ECU_ADDRESS 0 READ_WRITE /end MEASUREMENT
/begin MEASUREMENT Rte_FaultLog_FaultLog.CTCPassData[33].Byte1_Cnt_u08 "MICROSAR RTE" UBYTE NO_COMPU_METHOD 0 0 0 255 ECU_ADDRESS 0 READ_WRITE /end MEASUREMENT
/begin MEASUREMENT Rte_FaultLog_FaultLog.CTCPassData[33].Byte2_Cnt_u08 "MICROSAR RTE" UBYTE NO_COMPU_METHOD 0 0 0 255 ECU_ADDRESS 0 READ_WRITE /end MEASUREMENT
/begin MEASUREMENT Rte_FaultLog_FaultLog.CTCPassData[33].Byte3_Cnt_u08 "MICROSAR RTE" UBYTE NO_COMPU_METHOD 0 0 0 255 ECU_ADDRESS 0 READ_WRITE /end MEASUREMENT
/begin MEASUREMENT Rte_FaultLog_FaultLog.CTCPassData[33].Byte4_Cnt_u08 "MICROSAR RTE" UBYTE NO_COMPU_METHOD 0 0 0 255 ECU_ADDRESS 0 READ_WRITE /end MEASUREMENT
/begin MEASUREMENT Rte_FaultLog_FaultLog.CTCPassData[33].Byte5_Cnt_u08 "MICROSAR RTE" UBYTE NO_COMPU_METHOD 0 0 0 255 ECU_ADDRESS 0 READ_WRITE /end MEASUREMENT
/begin MEASUREMENT Rte_FaultLog_FaultLog.CTCPassData[33].Byte6_Cnt_u08 "MICROSAR RTE" UBYTE NO_COMPU_METHOD 0 0 0 255 ECU_ADDRESS 0 READ_WRITE /end MEASUREMENT
/begin MEASUREMENT Rte_FaultLog_FaultLog.CTCPassData[33].Reserved1_Cnt_u08 "MICROSAR RTE" UBYTE NO_COMPU_METHOD 0 0 0 255 ECU_ADDRESS 0 READ_WRITE /end MEASUREMENT
/begin MEASUREMENT Rte_FaultLog_FaultLog.CTCPassData[33].Reserved2_Cnt_u08 "MICROSAR RTE" UBYTE NO_COMPU_METHOD 0 0 0 255 ECU_ADDRESS 0 READ_WRITE /end MEASUREMENT
/begin MEASUREMENT Rte_FaultLog_FaultLog.CTCPassData[34].Byte1_Cnt_u08 "MICROSAR RTE" UBYTE NO_COMPU_METHOD 0 0 0 255 ECU_ADDRESS 0 READ_WRITE /end MEASUREMENT
/begin MEASUREMENT Rte_FaultLog_FaultLog.CTCPassData[34].Byte2_Cnt_u08 "MICROSAR RTE" UBYTE NO_COMPU_METHOD 0 0 0 255 ECU_ADDRESS 0 READ_WRITE /end MEASUREMENT
/begin MEASUREMENT Rte_FaultLog_FaultLog.CTCPassData[34].Byte3_Cnt_u08 "MICROSAR RTE" UBYTE NO_COMPU_METHOD 0 0 0 255 ECU_ADDRESS 0 READ_WRITE /end MEASUREMENT
/begin MEASUREMENT Rte_FaultLog_FaultLog.CTCPassData[34].Byte4_Cnt_u08 "MICROSAR RTE" UBYTE NO_COMPU_METHOD 0 0 0 255 ECU_ADDRESS 0 READ_WRITE /end MEASUREMENT
/begin MEASUREMENT Rte_FaultLog_FaultLog.CTCPassData[34].Byte5_Cnt_u08 "MICROSAR RTE" UBYTE NO_COMPU_METHOD 0 0 0 255 ECU_ADDRESS 0 READ_WRITE /end MEASUREMENT
/begin MEASUREMENT Rte_FaultLog_FaultLog.CTCPassData[34].Byte6_Cnt_u08 "MICROSAR RTE" UBYTE NO_COMPU_METHOD 0 0 0 255 ECU_ADDRESS 0 READ_WRITE /end MEASUREMENT
/begin MEASUREMENT Rte_FaultLog_FaultLog.CTCPassData[34].Reserved1_Cnt_u08 "MICROSAR RTE" UBYTE NO_COMPU_METHOD 0 0 0 255 ECU_ADDRESS 0 READ_WRITE /end MEASUREMENT
/begin MEASUREMENT Rte_FaultLog_FaultLog.CTCPassData[34].Reserved2_Cnt_u08 "MICROSAR RTE" UBYTE NO_COMPU_METHOD 0 0 0 255 ECU_ADDRESS 0 READ_WRITE /end MEASUREMENT
/begin MEASUREMENT Rte_FaultLog_FaultLog.CTCPassData[35].Byte1_Cnt_u08 "MICROSAR RTE" UBYTE NO_COMPU_METHOD 0 0 0 255 ECU_ADDRESS 0 READ_WRITE /end MEASUREMENT
/begin MEASUREMENT Rte_FaultLog_FaultLog.CTCPassData[35].Byte2_Cnt_u08 "MICROSAR RTE" UBYTE NO_COMPU_METHOD 0 0 0 255 ECU_ADDRESS 0 READ_WRITE /end MEASUREMENT
/begin MEASUREMENT Rte_FaultLog_FaultLog.CTCPassData[35].Byte3_Cnt_u08 "MICROSAR RTE" UBYTE NO_COMPU_METHOD 0 0 0 255 ECU_ADDRESS 0 READ_WRITE /end MEASUREMENT
/begin MEASUREMENT Rte_FaultLog_FaultLog.CTCPassData[35].Byte4_Cnt_u08 "MICROSAR RTE" UBYTE NO_COMPU_METHOD 0 0 0 255 ECU_ADDRESS 0 READ_WRITE /end MEASUREMENT
/begin MEASUREMENT Rte_FaultLog_FaultLog.CTCPassData[35].Byte5_Cnt_u08 "MICROSAR RTE" UBYTE NO_COMPU_METHOD 0 0 0 255 ECU_ADDRESS 0 READ_WRITE /end MEASUREMENT
/begin MEASUREMENT Rte_FaultLog_FaultLog.CTCPassData[35].Byte6_Cnt_u08 "MICROSAR RTE" UBYTE NO_COMPU_METHOD 0 0 0 255 ECU_ADDRESS 0 READ_WRITE /end MEASUREMENT
/begin MEASUREMENT Rte_FaultLog_FaultLog.CTCPassData[35].Reserved1_Cnt_u08 "MICROSAR RTE" UBYTE NO_COMPU_METHOD 0 0 0 255 ECU_ADDRESS 0 READ_WRITE /end MEASUREMENT
/begin MEASUREMENT Rte_FaultLog_FaultLog.CTCPassData[35].Reserved2_Cnt_u08 "MICROSAR RTE" UBYTE NO_COMPU_METHOD 0 0 0 255 ECU_ADDRESS 0 READ_WRITE /end MEASUREMENT
/begin MEASUREMENT Rte_FaultLog_FaultLog.CTCPassData[36].Byte1_Cnt_u08 "MICROSAR RTE" UBYTE NO_COMPU_METHOD 0 0 0 255 ECU_ADDRESS 0 READ_WRITE /end MEASUREMENT
/begin MEASUREMENT Rte_FaultLog_FaultLog.CTCPassData[36].Byte2_Cnt_u08 "MICROSAR RTE" UBYTE NO_COMPU_METHOD 0 0 0 255 ECU_ADDRESS 0 READ_WRITE /end MEASUREMENT
/begin MEASUREMENT Rte_FaultLog_FaultLog.CTCPassData[36].Byte3_Cnt_u08 "MICROSAR RTE" UBYTE NO_COMPU_METHOD 0 0 0 255 ECU_ADDRESS 0 READ_WRITE /end MEASUREMENT
/begin MEASUREMENT Rte_FaultLog_FaultLog.CTCPassData[36].Byte4_Cnt_u08 "MICROSAR RTE" UBYTE NO_COMPU_METHOD 0 0 0 255 ECU_ADDRESS 0 READ_WRITE /end MEASUREMENT
/begin MEASUREMENT Rte_FaultLog_FaultLog.CTCPassData[36].Byte5_Cnt_u08 "MICROSAR RTE" UBYTE NO_COMPU_METHOD 0 0 0 255 ECU_ADDRESS 0 READ_WRITE /end MEASUREMENT
/begin MEASUREMENT Rte_FaultLog_FaultLog.CTCPassData[36].Byte6_Cnt_u08 "MICROSAR RTE" UBYTE NO_COMPU_METHOD 0 0 0 255 ECU_ADDRESS 0 READ_WRITE /end MEASUREMENT
/begin MEASUREMENT Rte_FaultLog_FaultLog.CTCPassData[36].Reserved1_Cnt_u08 "MICROSAR RTE" UBYTE NO_COMPU_METHOD 0 0 0 255 ECU_ADDRESS 0 READ_WRITE /end MEASUREMENT
/begin MEASUREMENT Rte_FaultLog_FaultLog.CTCPassData[36].Reserved2_Cnt_u08 "MICROSAR RTE" UBYTE NO_COMPU_METHOD 0 0 0 255 ECU_ADDRESS 0 READ_WRITE /end MEASUREMENT
/begin MEASUREMENT Rte_FaultLog_FaultLog.CTCPassData[37].Byte1_Cnt_u08 "MICROSAR RTE" UBYTE NO_COMPU_METHOD 0 0 0 255 ECU_ADDRESS 0 READ_WRITE /end MEASUREMENT
/begin MEASUREMENT Rte_FaultLog_FaultLog.CTCPassData[37].Byte2_Cnt_u08 "MICROSAR RTE" UBYTE NO_COMPU_METHOD 0 0 0 255 ECU_ADDRESS 0 READ_WRITE /end MEASUREMENT
/begin MEASUREMENT Rte_FaultLog_FaultLog.CTCPassData[37].Byte3_Cnt_u08 "MICROSAR RTE" UBYTE NO_COMPU_METHOD 0 0 0 255 ECU_ADDRESS 0 READ_WRITE /end MEASUREMENT
/begin MEASUREMENT Rte_FaultLog_FaultLog.CTCPassData[37].Byte4_Cnt_u08 "MICROSAR RTE" UBYTE NO_COMPU_METHOD 0 0 0 255 ECU_ADDRESS 0 READ_WRITE /end MEASUREMENT
/begin MEASUREMENT Rte_FaultLog_FaultLog.CTCPassData[37].Byte5_Cnt_u08 "MICROSAR RTE" UBYTE NO_COMPU_METHOD 0 0 0 255 ECU_ADDRESS 0 READ_WRITE /end MEASUREMENT
/begin MEASUREMENT Rte_FaultLog_FaultLog.CTCPassData[37].Byte6_Cnt_u08 "MICROSAR RTE" UBYTE NO_COMPU_METHOD 0 0 0 255 ECU_ADDRESS 0 READ_WRITE /end MEASUREMENT
/begin MEASUREMENT Rte_FaultLog_FaultLog.CTCPassData[37].Reserved1_Cnt_u08 "MICROSAR RTE" UBYTE NO_COMPU_METHOD 0 0 0 255 ECU_ADDRESS 0 READ_WRITE /end MEASUREMENT
/begin MEASUREMENT Rte_FaultLog_FaultLog.CTCPassData[37].Reserved2_Cnt_u08 "MICROSAR RTE" UBYTE NO_COMPU_METHOD 0 0 0 255 ECU_ADDRESS 0 READ_WRITE /end MEASUREMENT
/begin MEASUREMENT Rte_FaultLog_FaultLog.CTCPassData[38].Byte1_Cnt_u08 "MICROSAR RTE" UBYTE NO_COMPU_METHOD 0 0 0 255 ECU_ADDRESS 0 READ_WRITE /end MEASUREMENT
/begin MEASUREMENT Rte_FaultLog_FaultLog.CTCPassData[38].Byte2_Cnt_u08 "MICROSAR RTE" UBYTE NO_COMPU_METHOD 0 0 0 255 ECU_ADDRESS 0 READ_WRITE /end MEASUREMENT
/begin MEASUREMENT Rte_FaultLog_FaultLog.CTCPassData[38].Byte3_Cnt_u08 "MICROSAR RTE" UBYTE NO_COMPU_METHOD 0 0 0 255 ECU_ADDRESS 0 READ_WRITE /end MEASUREMENT
/begin MEASUREMENT Rte_FaultLog_FaultLog.CTCPassData[38].Byte4_Cnt_u08 "MICROSAR RTE" UBYTE NO_COMPU_METHOD 0 0 0 255 ECU_ADDRESS 0 READ_WRITE /end MEASUREMENT
/begin MEASUREMENT Rte_FaultLog_FaultLog.CTCPassData[38].Byte5_Cnt_u08 "MICROSAR RTE" UBYTE NO_COMPU_METHOD 0 0 0 255 ECU_ADDRESS 0 READ_WRITE /end MEASUREMENT
/begin MEASUREMENT Rte_FaultLog_FaultLog.CTCPassData[38].Byte6_Cnt_u08 "MICROSAR RTE" UBYTE NO_COMPU_METHOD 0 0 0 255 ECU_ADDRESS 0 READ_WRITE /end MEASUREMENT
/begin MEASUREMENT Rte_FaultLog_FaultLog.CTCPassData[38].Reserved1_Cnt_u08 "MICROSAR RTE" UBYTE NO_COMPU_METHOD 0 0 0 255 ECU_ADDRESS 0 READ_WRITE /end MEASUREMENT
/begin MEASUREMENT Rte_FaultLog_FaultLog.CTCPassData[38].Reserved2_Cnt_u08 "MICROSAR RTE" UBYTE NO_COMPU_METHOD 0 0 0 255 ECU_ADDRESS 0 READ_WRITE /end MEASUREMENT
/begin MEASUREMENT Rte_FaultLog_FaultLog.CTCPassData[39].Byte1_Cnt_u08 "MICROSAR RTE" UBYTE NO_COMPU_METHOD 0 0 0 255 ECU_ADDRESS 0 READ_WRITE /end MEASUREMENT
/begin MEASUREMENT Rte_FaultLog_FaultLog.CTCPassData[39].Byte2_Cnt_u08 "MICROSAR RTE" UBYTE NO_COMPU_METHOD 0 0 0 255 ECU_ADDRESS 0 READ_WRITE /end MEASUREMENT
/begin MEASUREMENT Rte_FaultLog_FaultLog.CTCPassData[39].Byte3_Cnt_u08 "MICROSAR RTE" UBYTE NO_COMPU_METHOD 0 0 0 255 ECU_ADDRESS 0 READ_WRITE /end MEASUREMENT
/begin MEASUREMENT Rte_FaultLog_FaultLog.CTCPassData[39].Byte4_Cnt_u08 "MICROSAR RTE" UBYTE NO_COMPU_METHOD 0 0 0 255 ECU_ADDRESS 0 READ_WRITE /end MEASUREMENT
/begin MEASUREMENT Rte_FaultLog_FaultLog.CTCPassData[39].Byte5_Cnt_u08 "MICROSAR RTE" UBYTE NO_COMPU_METHOD 0 0 0 255 ECU_ADDRESS 0 READ_WRITE /end MEASUREMENT
/begin MEASUREMENT Rte_FaultLog_FaultLog.CTCPassData[39].Byte6_Cnt_u08 "MICROSAR RTE" UBYTE NO_COMPU_METHOD 0 0 0 255 ECU_ADDRESS 0 READ_WRITE /end MEASUREMENT
/begin MEASUREMENT Rte_FaultLog_FaultLog.CTCPassData[39].Reserved1_Cnt_u08 "MICROSAR RTE" UBYTE NO_COMPU_METHOD 0 0 0 255 ECU_ADDRESS 0 READ_WRITE /end MEASUREMENT
/begin MEASUREMENT Rte_FaultLog_FaultLog.CTCPassData[39].Reserved2_Cnt_u08 "MICROSAR RTE" UBYTE NO_COMPU_METHOD 0 0 0 255 ECU_ADDRESS 0 READ_WRITE /end MEASUREMENT
/begin MEASUREMENT Rte_FaultLog_FaultLog.CTCPassData[3].Byte1_Cnt_u08 "MICROSAR RTE" UBYTE NO_COMPU_METHOD 0 0 0 255 ECU_ADDRESS 0 READ_WRITE /end MEASUREMENT
/begin MEASUREMENT Rte_FaultLog_FaultLog.CTCPassData[3].Byte2_Cnt_u08 "MICROSAR RTE" UBYTE NO_COMPU_METHOD 0 0 0 255 ECU_ADDRESS 0 READ_WRITE /end MEASUREMENT
/begin MEASUREMENT Rte_FaultLog_FaultLog.CTCPassData[3].Byte3_Cnt_u08 "MICROSAR RTE" UBYTE NO_COMPU_METHOD 0 0 0 255 ECU_ADDRESS 0 READ_WRITE /end MEASUREMENT
/begin MEASUREMENT Rte_FaultLog_FaultLog.CTCPassData[3].Byte4_Cnt_u08 "MICROSAR RTE" UBYTE NO_COMPU_METHOD 0 0 0 255 ECU_ADDRESS 0 READ_WRITE /end MEASUREMENT
/begin MEASUREMENT Rte_FaultLog_FaultLog.CTCPassData[3].Byte5_Cnt_u08 "MICROSAR RTE" UBYTE NO_COMPU_METHOD 0 0 0 255 ECU_ADDRESS 0 READ_WRITE /end MEASUREMENT
/begin MEASUREMENT Rte_FaultLog_FaultLog.CTCPassData[3].Byte6_Cnt_u08 "MICROSAR RTE" UBYTE NO_COMPU_METHOD 0 0 0 255 ECU_ADDRESS 0 READ_WRITE /end MEASUREMENT
/begin MEASUREMENT Rte_FaultLog_FaultLog.CTCPassData[3].Reserved1_Cnt_u08 "MICROSAR RTE" UBYTE NO_COMPU_METHOD 0 0 0 255 ECU_ADDRESS 0 READ_WRITE /end MEASUREMENT
/begin MEASUREMENT Rte_FaultLog_FaultLog.CTCPassData[3].Reserved2_Cnt_u08 "MICROSAR RTE" UBYTE NO_COMPU_METHOD 0 0 0 255 ECU_ADDRESS 0 READ_WRITE /end MEASUREMENT
/begin MEASUREMENT Rte_FaultLog_FaultLog.CTCPassData[40].Byte1_Cnt_u08 "MICROSAR RTE" UBYTE NO_COMPU_METHOD 0 0 0 255 ECU_ADDRESS 0 READ_WRITE /end MEASUREMENT
/begin MEASUREMENT Rte_FaultLog_FaultLog.CTCPassData[40].Byte2_Cnt_u08 "MICROSAR RTE" UBYTE NO_COMPU_METHOD 0 0 0 255 ECU_ADDRESS 0 READ_WRITE /end MEASUREMENT
/begin MEASUREMENT Rte_FaultLog_FaultLog.CTCPassData[40].Byte3_Cnt_u08 "MICROSAR RTE" UBYTE NO_COMPU_METHOD 0 0 0 255 ECU_ADDRESS 0 READ_WRITE /end MEASUREMENT
/begin MEASUREMENT Rte_FaultLog_FaultLog.CTCPassData[40].Byte4_Cnt_u08 "MICROSAR RTE" UBYTE NO_COMPU_METHOD 0 0 0 255 ECU_ADDRESS 0 READ_WRITE /end MEASUREMENT
/begin MEASUREMENT Rte_FaultLog_FaultLog.CTCPassData[40].Byte5_Cnt_u08 "MICROSAR RTE" UBYTE NO_COMPU_METHOD 0 0 0 255 ECU_ADDRESS 0 READ_WRITE /end MEASUREMENT
/begin MEASUREMENT Rte_FaultLog_FaultLog.CTCPassData[40].Byte6_Cnt_u08 "MICROSAR RTE" UBYTE NO_COMPU_METHOD 0 0 0 255 ECU_ADDRESS 0 READ_WRITE /end MEASUREMENT
/begin MEASUREMENT Rte_FaultLog_FaultLog.CTCPassData[40].Reserved1_Cnt_u08 "MICROSAR RTE" UBYTE NO_COMPU_METHOD 0 0 0 255 ECU_ADDRESS 0 READ_WRITE /end MEASUREMENT
/begin MEASUREMENT Rte_FaultLog_FaultLog.CTCPassData[40].Reserved2_Cnt_u08 "MICROSAR RTE" UBYTE NO_COMPU_METHOD 0 0 0 255 ECU_ADDRESS 0 READ_WRITE /end MEASUREMENT
/begin MEASUREMENT Rte_FaultLog_FaultLog.CTCPassData[41].Byte1_Cnt_u08 "MICROSAR RTE" UBYTE NO_COMPU_METHOD 0 0 0 255 ECU_ADDRESS 0 READ_WRITE /end MEASUREMENT
/begin MEASUREMENT Rte_FaultLog_FaultLog.CTCPassData[41].Byte2_Cnt_u08 "MICROSAR RTE" UBYTE NO_COMPU_METHOD 0 0 0 255 ECU_ADDRESS 0 READ_WRITE /end MEASUREMENT
/begin MEASUREMENT Rte_FaultLog_FaultLog.CTCPassData[41].Byte3_Cnt_u08 "MICROSAR RTE" UBYTE NO_COMPU_METHOD 0 0 0 255 ECU_ADDRESS 0 READ_WRITE /end MEASUREMENT
/begin MEASUREMENT Rte_FaultLog_FaultLog.CTCPassData[41].Byte4_Cnt_u08 "MICROSAR RTE" UBYTE NO_COMPU_METHOD 0 0 0 255 ECU_ADDRESS 0 READ_WRITE /end MEASUREMENT
/begin MEASUREMENT Rte_FaultLog_FaultLog.CTCPassData[41].Byte5_Cnt_u08 "MICROSAR RTE" UBYTE NO_COMPU_METHOD 0 0 0 255 ECU_ADDRESS 0 READ_WRITE /end MEASUREMENT
/begin MEASUREMENT Rte_FaultLog_FaultLog.CTCPassData[41].Byte6_Cnt_u08 "MICROSAR RTE" UBYTE NO_COMPU_METHOD 0 0 0 255 ECU_ADDRESS 0 READ_WRITE /end MEASUREMENT
/begin MEASUREMENT Rte_FaultLog_FaultLog.CTCPassData[41].Reserved1_Cnt_u08 "MICROSAR RTE" UBYTE NO_COMPU_METHOD 0 0 0 255 ECU_ADDRESS 0 READ_WRITE /end MEASUREMENT
/begin MEASUREMENT Rte_FaultLog_FaultLog.CTCPassData[41].Reserved2_Cnt_u08 "MICROSAR RTE" UBYTE NO_COMPU_METHOD 0 0 0 255 ECU_ADDRESS 0 READ_WRITE /end MEASUREMENT
/begin MEASUREMENT Rte_FaultLog_FaultLog.CTCPassData[42].Byte1_Cnt_u08 "MICROSAR RTE" UBYTE NO_COMPU_METHOD 0 0 0 255 ECU_ADDRESS 0 READ_WRITE /end MEASUREMENT
/begin MEASUREMENT Rte_FaultLog_FaultLog.CTCPassData[42].Byte2_Cnt_u08 "MICROSAR RTE" UBYTE NO_COMPU_METHOD 0 0 0 255 ECU_ADDRESS 0 READ_WRITE /end MEASUREMENT
/begin MEASUREMENT Rte_FaultLog_FaultLog.CTCPassData[42].Byte3_Cnt_u08 "MICROSAR RTE" UBYTE NO_COMPU_METHOD 0 0 0 255 ECU_ADDRESS 0 READ_WRITE /end MEASUREMENT
/begin MEASUREMENT Rte_FaultLog_FaultLog.CTCPassData[42].Byte4_Cnt_u08 "MICROSAR RTE" UBYTE NO_COMPU_METHOD 0 0 0 255 ECU_ADDRESS 0 READ_WRITE /end MEASUREMENT
/begin MEASUREMENT Rte_FaultLog_FaultLog.CTCPassData[42].Byte5_Cnt_u08 "MICROSAR RTE" UBYTE NO_COMPU_METHOD 0 0 0 255 ECU_ADDRESS 0 READ_WRITE /end MEASUREMENT
/begin MEASUREMENT Rte_FaultLog_FaultLog.CTCPassData[42].Byte6_Cnt_u08 "MICROSAR RTE" UBYTE NO_COMPU_METHOD 0 0 0 255 ECU_ADDRESS 0 READ_WRITE /end MEASUREMENT
/begin MEASUREMENT Rte_FaultLog_FaultLog.CTCPassData[42].Reserved1_Cnt_u08 "MICROSAR RTE" UBYTE NO_COMPU_METHOD 0 0 0 255 ECU_ADDRESS 0 READ_WRITE /end MEASUREMENT
/begin MEASUREMENT Rte_FaultLog_FaultLog.CTCPassData[42].Reserved2_Cnt_u08 "MICROSAR RTE" UBYTE NO_COMPU_METHOD 0 0 0 255 ECU_ADDRESS 0 READ_WRITE /end MEASUREMENT
/begin MEASUREMENT Rte_FaultLog_FaultLog.CTCPassData[43].Byte1_Cnt_u08 "MICROSAR RTE" UBYTE NO_COMPU_METHOD 0 0 0 255 ECU_ADDRESS 0 READ_WRITE /end MEASUREMENT
/begin MEASUREMENT Rte_FaultLog_FaultLog.CTCPassData[43].Byte2_Cnt_u08 "MICROSAR RTE" UBYTE NO_COMPU_METHOD 0 0 0 255 ECU_ADDRESS 0 READ_WRITE /end MEASUREMENT
/begin MEASUREMENT Rte_FaultLog_FaultLog.CTCPassData[43].Byte3_Cnt_u08 "MICROSAR RTE" UBYTE NO_COMPU_METHOD 0 0 0 255 ECU_ADDRESS 0 READ_WRITE /end MEASUREMENT
/begin MEASUREMENT Rte_FaultLog_FaultLog.CTCPassData[43].Byte4_Cnt_u08 "MICROSAR RTE" UBYTE NO_COMPU_METHOD 0 0 0 255 ECU_ADDRESS 0 READ_WRITE /end MEASUREMENT
/begin MEASUREMENT Rte_FaultLog_FaultLog.CTCPassData[43].Byte5_Cnt_u08 "MICROSAR RTE" UBYTE NO_COMPU_METHOD 0 0 0 255 ECU_ADDRESS 0 READ_WRITE /end MEASUREMENT
/begin MEASUREMENT Rte_FaultLog_FaultLog.CTCPassData[43].Byte6_Cnt_u08 "MICROSAR RTE" UBYTE NO_COMPU_METHOD 0 0 0 255 ECU_ADDRESS 0 READ_WRITE /end MEASUREMENT
/begin MEASUREMENT Rte_FaultLog_FaultLog.CTCPassData[43].Reserved1_Cnt_u08 "MICROSAR RTE" UBYTE NO_COMPU_METHOD 0 0 0 255 ECU_ADDRESS 0 READ_WRITE /end MEASUREMENT
/begin MEASUREMENT Rte_FaultLog_FaultLog.CTCPassData[43].Reserved2_Cnt_u08 "MICROSAR RTE" UBYTE NO_COMPU_METHOD 0 0 0 255 ECU_ADDRESS 0 READ_WRITE /end MEASUREMENT
/begin MEASUREMENT Rte_FaultLog_FaultLog.CTCPassData[44].Byte1_Cnt_u08 "MICROSAR RTE" UBYTE NO_COMPU_METHOD 0 0 0 255 ECU_ADDRESS 0 READ_WRITE /end MEASUREMENT
/begin MEASUREMENT Rte_FaultLog_FaultLog.CTCPassData[44].Byte2_Cnt_u08 "MICROSAR RTE" UBYTE NO_COMPU_METHOD 0 0 0 255 ECU_ADDRESS 0 READ_WRITE /end MEASUREMENT
/begin MEASUREMENT Rte_FaultLog_FaultLog.CTCPassData[44].Byte3_Cnt_u08 "MICROSAR RTE" UBYTE NO_COMPU_METHOD 0 0 0 255 ECU_ADDRESS 0 READ_WRITE /end MEASUREMENT
/begin MEASUREMENT Rte_FaultLog_FaultLog.CTCPassData[44].Byte4_Cnt_u08 "MICROSAR RTE" UBYTE NO_COMPU_METHOD 0 0 0 255 ECU_ADDRESS 0 READ_WRITE /end MEASUREMENT
/begin MEASUREMENT Rte_FaultLog_FaultLog.CTCPassData[44].Byte5_Cnt_u08 "MICROSAR RTE" UBYTE NO_COMPU_METHOD 0 0 0 255 ECU_ADDRESS 0 READ_WRITE /end MEASUREMENT
/begin MEASUREMENT Rte_FaultLog_FaultLog.CTCPassData[44].Byte6_Cnt_u08 "MICROSAR RTE" UBYTE NO_COMPU_METHOD 0 0 0 255 ECU_ADDRESS 0 READ_WRITE /end MEASUREMENT
/begin MEASUREMENT Rte_FaultLog_FaultLog.CTCPassData[44].Reserved1_Cnt_u08 "MICROSAR RTE" UBYTE NO_COMPU_METHOD 0 0 0 255 ECU_ADDRESS 0 READ_WRITE /end MEASUREMENT
/begin MEASUREMENT Rte_FaultLog_FaultLog.CTCPassData[44].Reserved2_Cnt_u08 "MICROSAR RTE" UBYTE NO_COMPU_METHOD 0 0 0 255 ECU_ADDRESS 0 READ_WRITE /end MEASUREMENT
/begin MEASUREMENT Rte_FaultLog_FaultLog.CTCPassData[45].Byte1_Cnt_u08 "MICROSAR RTE" UBYTE NO_COMPU_METHOD 0 0 0 255 ECU_ADDRESS 0 READ_WRITE /end MEASUREMENT
/begin MEASUREMENT Rte_FaultLog_FaultLog.CTCPassData[45].Byte2_Cnt_u08 "MICROSAR RTE" UBYTE NO_COMPU_METHOD 0 0 0 255 ECU_ADDRESS 0 READ_WRITE /end MEASUREMENT
/begin MEASUREMENT Rte_FaultLog_FaultLog.CTCPassData[45].Byte3_Cnt_u08 "MICROSAR RTE" UBYTE NO_COMPU_METHOD 0 0 0 255 ECU_ADDRESS 0 READ_WRITE /end MEASUREMENT
/begin MEASUREMENT Rte_FaultLog_FaultLog.CTCPassData[45].Byte4_Cnt_u08 "MICROSAR RTE" UBYTE NO_COMPU_METHOD 0 0 0 255 ECU_ADDRESS 0 READ_WRITE /end MEASUREMENT
/begin MEASUREMENT Rte_FaultLog_FaultLog.CTCPassData[45].Byte5_Cnt_u08 "MICROSAR RTE" UBYTE NO_COMPU_METHOD 0 0 0 255 ECU_ADDRESS 0 READ_WRITE /end MEASUREMENT
/begin MEASUREMENT Rte_FaultLog_FaultLog.CTCPassData[45].Byte6_Cnt_u08 "MICROSAR RTE" UBYTE NO_COMPU_METHOD 0 0 0 255 ECU_ADDRESS 0 READ_WRITE /end MEASUREMENT
/begin MEASUREMENT Rte_FaultLog_FaultLog.CTCPassData[45].Reserved1_Cnt_u08 "MICROSAR RTE" UBYTE NO_COMPU_METHOD 0 0 0 255 ECU_ADDRESS 0 READ_WRITE /end MEASUREMENT
/begin MEASUREMENT Rte_FaultLog_FaultLog.CTCPassData[45].Reserved2_Cnt_u08 "MICROSAR RTE" UBYTE NO_COMPU_METHOD 0 0 0 255 ECU_ADDRESS 0 READ_WRITE /end MEASUREMENT
/begin MEASUREMENT Rte_FaultLog_FaultLog.CTCPassData[46].Byte1_Cnt_u08 "MICROSAR RTE" UBYTE NO_COMPU_METHOD 0 0 0 255 ECU_ADDRESS 0 READ_WRITE /end MEASUREMENT
/begin MEASUREMENT Rte_FaultLog_FaultLog.CTCPassData[46].Byte2_Cnt_u08 "MICROSAR RTE" UBYTE NO_COMPU_METHOD 0 0 0 255 ECU_ADDRESS 0 READ_WRITE /end MEASUREMENT
/begin MEASUREMENT Rte_FaultLog_FaultLog.CTCPassData[46].Byte3_Cnt_u08 "MICROSAR RTE" UBYTE NO_COMPU_METHOD 0 0 0 255 ECU_ADDRESS 0 READ_WRITE /end MEASUREMENT
/begin MEASUREMENT Rte_FaultLog_FaultLog.CTCPassData[46].Byte4_Cnt_u08 "MICROSAR RTE" UBYTE NO_COMPU_METHOD 0 0 0 255 ECU_ADDRESS 0 READ_WRITE /end MEASUREMENT
/begin MEASUREMENT Rte_FaultLog_FaultLog.CTCPassData[46].Byte5_Cnt_u08 "MICROSAR RTE" UBYTE NO_COMPU_METHOD 0 0 0 255 ECU_ADDRESS 0 READ_WRITE /end MEASUREMENT
/begin MEASUREMENT Rte_FaultLog_FaultLog.CTCPassData[46].Byte6_Cnt_u08 "MICROSAR RTE" UBYTE NO_COMPU_METHOD 0 0 0 255 ECU_ADDRESS 0 READ_WRITE /end MEASUREMENT
/begin MEASUREMENT Rte_FaultLog_FaultLog.CTCPassData[46].Reserved1_Cnt_u08 "MICROSAR RTE" UBYTE NO_COMPU_METHOD 0 0 0 255 ECU_ADDRESS 0 READ_WRITE /end MEASUREMENT
/begin MEASUREMENT Rte_FaultLog_FaultLog.CTCPassData[46].Reserved2_Cnt_u08 "MICROSAR RTE" UBYTE NO_COMPU_METHOD 0 0 0 255 ECU_ADDRESS 0 READ_WRITE /end MEASUREMENT
/begin MEASUREMENT Rte_FaultLog_FaultLog.CTCPassData[47].Byte1_Cnt_u08 "MICROSAR RTE" UBYTE NO_COMPU_METHOD 0 0 0 255 ECU_ADDRESS 0 READ_WRITE /end MEASUREMENT
/begin MEASUREMENT Rte_FaultLog_FaultLog.CTCPassData[47].Byte2_Cnt_u08 "MICROSAR RTE" UBYTE NO_COMPU_METHOD 0 0 0 255 ECU_ADDRESS 0 READ_WRITE /end MEASUREMENT
/begin MEASUREMENT Rte_FaultLog_FaultLog.CTCPassData[47].Byte3_Cnt_u08 "MICROSAR RTE" UBYTE NO_COMPU_METHOD 0 0 0 255 ECU_ADDRESS 0 READ_WRITE /end MEASUREMENT
/begin MEASUREMENT Rte_FaultLog_FaultLog.CTCPassData[47].Byte4_Cnt_u08 "MICROSAR RTE" UBYTE NO_COMPU_METHOD 0 0 0 255 ECU_ADDRESS 0 READ_WRITE /end MEASUREMENT
/begin MEASUREMENT Rte_FaultLog_FaultLog.CTCPassData[47].Byte5_Cnt_u08 "MICROSAR RTE" UBYTE NO_COMPU_METHOD 0 0 0 255 ECU_ADDRESS 0 READ_WRITE /end MEASUREMENT
/begin MEASUREMENT Rte_FaultLog_FaultLog.CTCPassData[47].Byte6_Cnt_u08 "MICROSAR RTE" UBYTE NO_COMPU_METHOD 0 0 0 255 ECU_ADDRESS 0 READ_WRITE /end MEASUREMENT
/begin MEASUREMENT Rte_FaultLog_FaultLog.CTCPassData[47].Reserved1_Cnt_u08 "MICROSAR RTE" UBYTE NO_COMPU_METHOD 0 0 0 255 ECU_ADDRESS 0 READ_WRITE /end MEASUREMENT
/begin MEASUREMENT Rte_FaultLog_FaultLog.CTCPassData[47].Reserved2_Cnt_u08 "MICROSAR RTE" UBYTE NO_COMPU_METHOD 0 0 0 255 ECU_ADDRESS 0 READ_WRITE /end MEASUREMENT
/begin MEASUREMENT Rte_FaultLog_FaultLog.CTCPassData[48].Byte1_Cnt_u08 "MICROSAR RTE" UBYTE NO_COMPU_METHOD 0 0 0 255 ECU_ADDRESS 0 READ_WRITE /end MEASUREMENT
/begin MEASUREMENT Rte_FaultLog_FaultLog.CTCPassData[48].Byte2_Cnt_u08 "MICROSAR RTE" UBYTE NO_COMPU_METHOD 0 0 0 255 ECU_ADDRESS 0 READ_WRITE /end MEASUREMENT
/begin MEASUREMENT Rte_FaultLog_FaultLog.CTCPassData[48].Byte3_Cnt_u08 "MICROSAR RTE" UBYTE NO_COMPU_METHOD 0 0 0 255 ECU_ADDRESS 0 READ_WRITE /end MEASUREMENT
/begin MEASUREMENT Rte_FaultLog_FaultLog.CTCPassData[48].Byte4_Cnt_u08 "MICROSAR RTE" UBYTE NO_COMPU_METHOD 0 0 0 255 ECU_ADDRESS 0 READ_WRITE /end MEASUREMENT
/begin MEASUREMENT Rte_FaultLog_FaultLog.CTCPassData[48].Byte5_Cnt_u08 "MICROSAR RTE" UBYTE NO_COMPU_METHOD 0 0 0 255 ECU_ADDRESS 0 READ_WRITE /end MEASUREMENT
/begin MEASUREMENT Rte_FaultLog_FaultLog.CTCPassData[48].Byte6_Cnt_u08 "MICROSAR RTE" UBYTE NO_COMPU_METHOD 0 0 0 255 ECU_ADDRESS 0 READ_WRITE /end MEASUREMENT
/begin MEASUREMENT Rte_FaultLog_FaultLog.CTCPassData[48].Reserved1_Cnt_u08 "MICROSAR RTE" UBYTE NO_COMPU_METHOD 0 0 0 255 ECU_ADDRESS 0 READ_WRITE /end MEASUREMENT
/begin MEASUREMENT Rte_FaultLog_FaultLog.CTCPassData[48].Reserved2_Cnt_u08 "MICROSAR RTE" UBYTE NO_COMPU_METHOD 0 0 0 255 ECU_ADDRESS 0 READ_WRITE /end MEASUREMENT
/begin MEASUREMENT Rte_FaultLog_FaultLog.CTCPassData[49].Byte1_Cnt_u08 "MICROSAR RTE" UBYTE NO_COMPU_METHOD 0 0 0 255 ECU_ADDRESS 0 READ_WRITE /end MEASUREMENT
/begin MEASUREMENT Rte_FaultLog_FaultLog.CTCPassData[49].Byte2_Cnt_u08 "MICROSAR RTE" UBYTE NO_COMPU_METHOD 0 0 0 255 ECU_ADDRESS 0 READ_WRITE /end MEASUREMENT
/begin MEASUREMENT Rte_FaultLog_FaultLog.CTCPassData[49].Byte3_Cnt_u08 "MICROSAR RTE" UBYTE NO_COMPU_METHOD 0 0 0 255 ECU_ADDRESS 0 READ_WRITE /end MEASUREMENT
/begin MEASUREMENT Rte_FaultLog_FaultLog.CTCPassData[49].Byte4_Cnt_u08 "MICROSAR RTE" UBYTE NO_COMPU_METHOD 0 0 0 255 ECU_ADDRESS 0 READ_WRITE /end MEASUREMENT
/begin MEASUREMENT Rte_FaultLog_FaultLog.CTCPassData[49].Byte5_Cnt_u08 "MICROSAR RTE" UBYTE NO_COMPU_METHOD 0 0 0 255 ECU_ADDRESS 0 READ_WRITE /end MEASUREMENT
/begin MEASUREMENT Rte_FaultLog_FaultLog.CTCPassData[49].Byte6_Cnt_u08 "MICROSAR RTE" UBYTE NO_COMPU_METHOD 0 0 0 255 ECU_ADDRESS 0 READ_WRITE /end MEASUREMENT
/begin MEASUREMENT Rte_FaultLog_FaultLog.CTCPassData[49].Reserved1_Cnt_u08 "MICROSAR RTE" UBYTE NO_COMPU_METHOD 0 0 0 255 ECU_ADDRESS 0 READ_WRITE /end MEASUREMENT
/begin MEASUREMENT Rte_FaultLog_FaultLog.CTCPassData[49].Reserved2_Cnt_u08 "MICROSAR RTE" UBYTE NO_COMPU_METHOD 0 0 0 255 ECU_ADDRESS 0 READ_WRITE /end MEASUREMENT
/begin MEASUREMENT Rte_FaultLog_FaultLog.CTCPassData[4].Byte1_Cnt_u08 "MICROSAR RTE" UBYTE NO_COMPU_METHOD 0 0 0 255 ECU_ADDRESS 0 READ_WRITE /end MEASUREMENT
/begin MEASUREMENT Rte_FaultLog_FaultLog.CTCPassData[4].Byte2_Cnt_u08 "MICROSAR RTE" UBYTE NO_COMPU_METHOD 0 0 0 255 ECU_ADDRESS 0 READ_WRITE /end MEASUREMENT
/begin MEASUREMENT Rte_FaultLog_FaultLog.CTCPassData[4].Byte3_Cnt_u08 "MICROSAR RTE" UBYTE NO_COMPU_METHOD 0 0 0 255 ECU_ADDRESS 0 READ_WRITE /end MEASUREMENT
/begin MEASUREMENT Rte_FaultLog_FaultLog.CTCPassData[4].Byte4_Cnt_u08 "MICROSAR RTE" UBYTE NO_COMPU_METHOD 0 0 0 255 ECU_ADDRESS 0 READ_WRITE /end MEASUREMENT
/begin MEASUREMENT Rte_FaultLog_FaultLog.CTCPassData[4].Byte5_Cnt_u08 "MICROSAR RTE" UBYTE NO_COMPU_METHOD 0 0 0 255 ECU_ADDRESS 0 READ_WRITE /end MEASUREMENT
/begin MEASUREMENT Rte_FaultLog_FaultLog.CTCPassData[4].Byte6_Cnt_u08 "MICROSAR RTE" UBYTE NO_COMPU_METHOD 0 0 0 255 ECU_ADDRESS 0 READ_WRITE /end MEASUREMENT
/begin MEASUREMENT Rte_FaultLog_FaultLog.CTCPassData[4].Reserved1_Cnt_u08 "MICROSAR RTE" UBYTE NO_COMPU_METHOD 0 0 0 255 ECU_ADDRESS 0 READ_WRITE /end MEASUREMENT
/begin MEASUREMENT Rte_FaultLog_FaultLog.CTCPassData[4].Reserved2_Cnt_u08 "MICROSAR RTE" UBYTE NO_COMPU_METHOD 0 0 0 255 ECU_ADDRESS 0 READ_WRITE /end MEASUREMENT
/begin MEASUREMENT Rte_FaultLog_FaultLog.CTCPassData[50].Byte1_Cnt_u08 "MICROSAR RTE" UBYTE NO_COMPU_METHOD 0 0 0 255 ECU_ADDRESS 0 READ_WRITE /end MEASUREMENT
/begin MEASUREMENT Rte_FaultLog_FaultLog.CTCPassData[50].Byte2_Cnt_u08 "MICROSAR RTE" UBYTE NO_COMPU_METHOD 0 0 0 255 ECU_ADDRESS 0 READ_WRITE /end MEASUREMENT
/begin MEASUREMENT Rte_FaultLog_FaultLog.CTCPassData[50].Byte3_Cnt_u08 "MICROSAR RTE" UBYTE NO_COMPU_METHOD 0 0 0 255 ECU_ADDRESS 0 READ_WRITE /end MEASUREMENT
/begin MEASUREMENT Rte_FaultLog_FaultLog.CTCPassData[50].Byte4_Cnt_u08 "MICROSAR RTE" UBYTE NO_COMPU_METHOD 0 0 0 255 ECU_ADDRESS 0 READ_WRITE /end MEASUREMENT
/begin MEASUREMENT Rte_FaultLog_FaultLog.CTCPassData[50].Byte5_Cnt_u08 "MICROSAR RTE" UBYTE NO_COMPU_METHOD 0 0 0 255 ECU_ADDRESS 0 READ_WRITE /end MEASUREMENT
/begin MEASUREMENT Rte_FaultLog_FaultLog.CTCPassData[50].Byte6_Cnt_u08 "MICROSAR RTE" UBYTE NO_COMPU_METHOD 0 0 0 255 ECU_ADDRESS 0 READ_WRITE /end MEASUREMENT
/begin MEASUREMENT Rte_FaultLog_FaultLog.CTCPassData[50].Reserved1_Cnt_u08 "MICROSAR RTE" UBYTE NO_COMPU_METHOD 0 0 0 255 ECU_ADDRESS 0 READ_WRITE /end MEASUREMENT
/begin MEASUREMENT Rte_FaultLog_FaultLog.CTCPassData[50].Reserved2_Cnt_u08 "MICROSAR RTE" UBYTE NO_COMPU_METHOD 0 0 0 255 ECU_ADDRESS 0 READ_WRITE /end MEASUREMENT
/begin MEASUREMENT Rte_FaultLog_FaultLog.CTCPassData[51].Byte1_Cnt_u08 "MICROSAR RTE" UBYTE NO_COMPU_METHOD 0 0 0 255 ECU_ADDRESS 0 READ_WRITE /end MEASUREMENT
/begin MEASUREMENT Rte_FaultLog_FaultLog.CTCPassData[51].Byte2_Cnt_u08 "MICROSAR RTE" UBYTE NO_COMPU_METHOD 0 0 0 255 ECU_ADDRESS 0 READ_WRITE /end MEASUREMENT
/begin MEASUREMENT Rte_FaultLog_FaultLog.CTCPassData[51].Byte3_Cnt_u08 "MICROSAR RTE" UBYTE NO_COMPU_METHOD 0 0 0 255 ECU_ADDRESS 0 READ_WRITE /end MEASUREMENT
/begin MEASUREMENT Rte_FaultLog_FaultLog.CTCPassData[51].Byte4_Cnt_u08 "MICROSAR RTE" UBYTE NO_COMPU_METHOD 0 0 0 255 ECU_ADDRESS 0 READ_WRITE /end MEASUREMENT
/begin MEASUREMENT Rte_FaultLog_FaultLog.CTCPassData[51].Byte5_Cnt_u08 "MICROSAR RTE" UBYTE NO_COMPU_METHOD 0 0 0 255 ECU_ADDRESS 0 READ_WRITE /end MEASUREMENT
/begin MEASUREMENT Rte_FaultLog_FaultLog.CTCPassData[51].Byte6_Cnt_u08 "MICROSAR RTE" UBYTE NO_COMPU_METHOD 0 0 0 255 ECU_ADDRESS 0 READ_WRITE /end MEASUREMENT
/begin MEASUREMENT Rte_FaultLog_FaultLog.CTCPassData[51].Reserved1_Cnt_u08 "MICROSAR RTE" UBYTE NO_COMPU_METHOD 0 0 0 255 ECU_ADDRESS 0 READ_WRITE /end MEASUREMENT
/begin MEASUREMENT Rte_FaultLog_FaultLog.CTCPassData[51].Reserved2_Cnt_u08 "MICROSAR RTE" UBYTE NO_COMPU_METHOD 0 0 0 255 ECU_ADDRESS 0 READ_WRITE /end MEASUREMENT
/begin MEASUREMENT Rte_FaultLog_FaultLog.CTCPassData[52].Byte1_Cnt_u08 "MICROSAR RTE" UBYTE NO_COMPU_METHOD 0 0 0 255 ECU_ADDRESS 0 READ_WRITE /end MEASUREMENT
/begin MEASUREMENT Rte_FaultLog_FaultLog.CTCPassData[52].Byte2_Cnt_u08 "MICROSAR RTE" UBYTE NO_COMPU_METHOD 0 0 0 255 ECU_ADDRESS 0 READ_WRITE /end MEASUREMENT
/begin MEASUREMENT Rte_FaultLog_FaultLog.CTCPassData[52].Byte3_Cnt_u08 "MICROSAR RTE" UBYTE NO_COMPU_METHOD 0 0 0 255 ECU_ADDRESS 0 READ_WRITE /end MEASUREMENT
/begin MEASUREMENT Rte_FaultLog_FaultLog.CTCPassData[52].Byte4_Cnt_u08 "MICROSAR RTE" UBYTE NO_COMPU_METHOD 0 0 0 255 ECU_ADDRESS 0 READ_WRITE /end MEASUREMENT
/begin MEASUREMENT Rte_FaultLog_FaultLog.CTCPassData[52].Byte5_Cnt_u08 "MICROSAR RTE" UBYTE NO_COMPU_METHOD 0 0 0 255 ECU_ADDRESS 0 READ_WRITE /end MEASUREMENT
/begin MEASUREMENT Rte_FaultLog_FaultLog.CTCPassData[52].Byte6_Cnt_u08 "MICROSAR RTE" UBYTE NO_COMPU_METHOD 0 0 0 255 ECU_ADDRESS 0 READ_WRITE /end MEASUREMENT
/begin MEASUREMENT Rte_FaultLog_FaultLog.CTCPassData[52].Reserved1_Cnt_u08 "MICROSAR RTE" UBYTE NO_COMPU_METHOD 0 0 0 255 ECU_ADDRESS 0 READ_WRITE /end MEASUREMENT
/begin MEASUREMENT Rte_FaultLog_FaultLog.CTCPassData[52].Reserved2_Cnt_u08 "MICROSAR RTE" UBYTE NO_COMPU_METHOD 0 0 0 255 ECU_ADDRESS 0 READ_WRITE /end MEASUREMENT
/begin MEASUREMENT Rte_FaultLog_FaultLog.CTCPassData[53].Byte1_Cnt_u08 "MICROSAR RTE" UBYTE NO_COMPU_METHOD 0 0 0 255 ECU_ADDRESS 0 READ_WRITE /end MEASUREMENT
/begin MEASUREMENT Rte_FaultLog_FaultLog.CTCPassData[53].Byte2_Cnt_u08 "MICROSAR RTE" UBYTE NO_COMPU_METHOD 0 0 0 255 ECU_ADDRESS 0 READ_WRITE /end MEASUREMENT
/begin MEASUREMENT Rte_FaultLog_FaultLog.CTCPassData[53].Byte3_Cnt_u08 "MICROSAR RTE" UBYTE NO_COMPU_METHOD 0 0 0 255 ECU_ADDRESS 0 READ_WRITE /end MEASUREMENT
/begin MEASUREMENT Rte_FaultLog_FaultLog.CTCPassData[53].Byte4_Cnt_u08 "MICROSAR RTE" UBYTE NO_COMPU_METHOD 0 0 0 255 ECU_ADDRESS 0 READ_WRITE /end MEASUREMENT
/begin MEASUREMENT Rte_FaultLog_FaultLog.CTCPassData[53].Byte5_Cnt_u08 "MICROSAR RTE" UBYTE NO_COMPU_METHOD 0 0 0 255 ECU_ADDRESS 0 READ_WRITE /end MEASUREMENT
/begin MEASUREMENT Rte_FaultLog_FaultLog.CTCPassData[53].Byte6_Cnt_u08 "MICROSAR RTE" UBYTE NO_COMPU_METHOD 0 0 0 255 ECU_ADDRESS 0 READ_WRITE /end MEASUREMENT
/begin MEASUREMENT Rte_FaultLog_FaultLog.CTCPassData[53].Reserved1_Cnt_u08 "MICROSAR RTE" UBYTE NO_COMPU_METHOD 0 0 0 255 ECU_ADDRESS 0 READ_WRITE /end MEASUREMENT
/begin MEASUREMENT Rte_FaultLog_FaultLog.CTCPassData[53].Reserved2_Cnt_u08 "MICROSAR RTE" UBYTE NO_COMPU_METHOD 0 0 0 255 ECU_ADDRESS 0 READ_WRITE /end MEASUREMENT
/begin MEASUREMENT Rte_FaultLog_FaultLog.CTCPassData[54].Byte1_Cnt_u08 "MICROSAR RTE" UBYTE NO_COMPU_METHOD 0 0 0 255 ECU_ADDRESS 0 READ_WRITE /end MEASUREMENT
/begin MEASUREMENT Rte_FaultLog_FaultLog.CTCPassData[54].Byte2_Cnt_u08 "MICROSAR RTE" UBYTE NO_COMPU_METHOD 0 0 0 255 ECU_ADDRESS 0 READ_WRITE /end MEASUREMENT
/begin MEASUREMENT Rte_FaultLog_FaultLog.CTCPassData[54].Byte3_Cnt_u08 "MICROSAR RTE" UBYTE NO_COMPU_METHOD 0 0 0 255 ECU_ADDRESS 0 READ_WRITE /end MEASUREMENT
/begin MEASUREMENT Rte_FaultLog_FaultLog.CTCPassData[54].Byte4_Cnt_u08 "MICROSAR RTE" UBYTE NO_COMPU_METHOD 0 0 0 255 ECU_ADDRESS 0 READ_WRITE /end MEASUREMENT
/begin MEASUREMENT Rte_FaultLog_FaultLog.CTCPassData[54].Byte5_Cnt_u08 "MICROSAR RTE" UBYTE NO_COMPU_METHOD 0 0 0 255 ECU_ADDRESS 0 READ_WRITE /end MEASUREMENT
/begin MEASUREMENT Rte_FaultLog_FaultLog.CTCPassData[54].Byte6_Cnt_u08 "MICROSAR RTE" UBYTE NO_COMPU_METHOD 0 0 0 255 ECU_ADDRESS 0 READ_WRITE /end MEASUREMENT
/begin MEASUREMENT Rte_FaultLog_FaultLog.CTCPassData[54].Reserved1_Cnt_u08 "MICROSAR RTE" UBYTE NO_COMPU_METHOD 0 0 0 255 ECU_ADDRESS 0 READ_WRITE /end MEASUREMENT
/begin MEASUREMENT Rte_FaultLog_FaultLog.CTCPassData[54].Reserved2_Cnt_u08 "MICROSAR RTE" UBYTE NO_COMPU_METHOD 0 0 0 255 ECU_ADDRESS 0 READ_WRITE /end MEASUREMENT
/begin MEASUREMENT Rte_FaultLog_FaultLog.CTCPassData[55].Byte1_Cnt_u08 "MICROSAR RTE" UBYTE NO_COMPU_METHOD 0 0 0 255 ECU_ADDRESS 0 READ_WRITE /end MEASUREMENT
/begin MEASUREMENT Rte_FaultLog_FaultLog.CTCPassData[55].Byte2_Cnt_u08 "MICROSAR RTE" UBYTE NO_COMPU_METHOD 0 0 0 255 ECU_ADDRESS 0 READ_WRITE /end MEASUREMENT
/begin MEASUREMENT Rte_FaultLog_FaultLog.CTCPassData[55].Byte3_Cnt_u08 "MICROSAR RTE" UBYTE NO_COMPU_METHOD 0 0 0 255 ECU_ADDRESS 0 READ_WRITE /end MEASUREMENT
/begin MEASUREMENT Rte_FaultLog_FaultLog.CTCPassData[55].Byte4_Cnt_u08 "MICROSAR RTE" UBYTE NO_COMPU_METHOD 0 0 0 255 ECU_ADDRESS 0 READ_WRITE /end MEASUREMENT
/begin MEASUREMENT Rte_FaultLog_FaultLog.CTCPassData[55].Byte5_Cnt_u08 "MICROSAR RTE" UBYTE NO_COMPU_METHOD 0 0 0 255 ECU_ADDRESS 0 READ_WRITE /end MEASUREMENT
/begin MEASUREMENT Rte_FaultLog_FaultLog.CTCPassData[55].Byte6_Cnt_u08 "MICROSAR RTE" UBYTE NO_COMPU_METHOD 0 0 0 255 ECU_ADDRESS 0 READ_WRITE /end MEASUREMENT
/begin MEASUREMENT Rte_FaultLog_FaultLog.CTCPassData[55].Reserved1_Cnt_u08 "MICROSAR RTE" UBYTE NO_COMPU_METHOD 0 0 0 255 ECU_ADDRESS 0 READ_WRITE /end MEASUREMENT
/begin MEASUREMENT Rte_FaultLog_FaultLog.CTCPassData[55].Reserved2_Cnt_u08 "MICROSAR RTE" UBYTE NO_COMPU_METHOD 0 0 0 255 ECU_ADDRESS 0 READ_WRITE /end MEASUREMENT
/begin MEASUREMENT Rte_FaultLog_FaultLog.CTCPassData[56].Byte1_Cnt_u08 "MICROSAR RTE" UBYTE NO_COMPU_METHOD 0 0 0 255 ECU_ADDRESS 0 READ_WRITE /end MEASUREMENT
/begin MEASUREMENT Rte_FaultLog_FaultLog.CTCPassData[56].Byte2_Cnt_u08 "MICROSAR RTE" UBYTE NO_COMPU_METHOD 0 0 0 255 ECU_ADDRESS 0 READ_WRITE /end MEASUREMENT
/begin MEASUREMENT Rte_FaultLog_FaultLog.CTCPassData[56].Byte3_Cnt_u08 "MICROSAR RTE" UBYTE NO_COMPU_METHOD 0 0 0 255 ECU_ADDRESS 0 READ_WRITE /end MEASUREMENT
/begin MEASUREMENT Rte_FaultLog_FaultLog.CTCPassData[56].Byte4_Cnt_u08 "MICROSAR RTE" UBYTE NO_COMPU_METHOD 0 0 0 255 ECU_ADDRESS 0 READ_WRITE /end MEASUREMENT
/begin MEASUREMENT Rte_FaultLog_FaultLog.CTCPassData[56].Byte5_Cnt_u08 "MICROSAR RTE" UBYTE NO_COMPU_METHOD 0 0 0 255 ECU_ADDRESS 0 READ_WRITE /end MEASUREMENT
/begin MEASUREMENT Rte_FaultLog_FaultLog.CTCPassData[56].Byte6_Cnt_u08 "MICROSAR RTE" UBYTE NO_COMPU_METHOD 0 0 0 255 ECU_ADDRESS 0 READ_WRITE /end MEASUREMENT
/begin MEASUREMENT Rte_FaultLog_FaultLog.CTCPassData[56].Reserved1_Cnt_u08 "MICROSAR RTE" UBYTE NO_COMPU_METHOD 0 0 0 255 ECU_ADDRESS 0 READ_WRITE /end MEASUREMENT
/begin MEASUREMENT Rte_FaultLog_FaultLog.CTCPassData[56].Reserved2_Cnt_u08 "MICROSAR RTE" UBYTE NO_COMPU_METHOD 0 0 0 255 ECU_ADDRESS 0 READ_WRITE /end MEASUREMENT
/begin MEASUREMENT Rte_FaultLog_FaultLog.CTCPassData[57].Byte1_Cnt_u08 "MICROSAR RTE" UBYTE NO_COMPU_METHOD 0 0 0 255 ECU_ADDRESS 0 READ_WRITE /end MEASUREMENT
/begin MEASUREMENT Rte_FaultLog_FaultLog.CTCPassData[57].Byte2_Cnt_u08 "MICROSAR RTE" UBYTE NO_COMPU_METHOD 0 0 0 255 ECU_ADDRESS 0 READ_WRITE /end MEASUREMENT
/begin MEASUREMENT Rte_FaultLog_FaultLog.CTCPassData[57].Byte3_Cnt_u08 "MICROSAR RTE" UBYTE NO_COMPU_METHOD 0 0 0 255 ECU_ADDRESS 0 READ_WRITE /end MEASUREMENT
/begin MEASUREMENT Rte_FaultLog_FaultLog.CTCPassData[57].Byte4_Cnt_u08 "MICROSAR RTE" UBYTE NO_COMPU_METHOD 0 0 0 255 ECU_ADDRESS 0 READ_WRITE /end MEASUREMENT
/begin MEASUREMENT Rte_FaultLog_FaultLog.CTCPassData[57].Byte5_Cnt_u08 "MICROSAR RTE" UBYTE NO_COMPU_METHOD 0 0 0 255 ECU_ADDRESS 0 READ_WRITE /end MEASUREMENT
/begin MEASUREMENT Rte_FaultLog_FaultLog.CTCPassData[57].Byte6_Cnt_u08 "MICROSAR RTE" UBYTE NO_COMPU_METHOD 0 0 0 255 ECU_ADDRESS 0 READ_WRITE /end MEASUREMENT
/begin MEASUREMENT Rte_FaultLog_FaultLog.CTCPassData[57].Reserved1_Cnt_u08 "MICROSAR RTE" UBYTE NO_COMPU_METHOD 0 0 0 255 ECU_ADDRESS 0 READ_WRITE /end MEASUREMENT
/begin MEASUREMENT Rte_FaultLog_FaultLog.CTCPassData[57].Reserved2_Cnt_u08 "MICROSAR RTE" UBYTE NO_COMPU_METHOD 0 0 0 255 ECU_ADDRESS 0 READ_WRITE /end MEASUREMENT
/begin MEASUREMENT Rte_FaultLog_FaultLog.CTCPassData[58].Byte1_Cnt_u08 "MICROSAR RTE" UBYTE NO_COMPU_METHOD 0 0 0 255 ECU_ADDRESS 0 READ_WRITE /end MEASUREMENT
/begin MEASUREMENT Rte_FaultLog_FaultLog.CTCPassData[58].Byte2_Cnt_u08 "MICROSAR RTE" UBYTE NO_COMPU_METHOD 0 0 0 255 ECU_ADDRESS 0 READ_WRITE /end MEASUREMENT
/begin MEASUREMENT Rte_FaultLog_FaultLog.CTCPassData[58].Byte3_Cnt_u08 "MICROSAR RTE" UBYTE NO_COMPU_METHOD 0 0 0 255 ECU_ADDRESS 0 READ_WRITE /end MEASUREMENT
/begin MEASUREMENT Rte_FaultLog_FaultLog.CTCPassData[58].Byte4_Cnt_u08 "MICROSAR RTE" UBYTE NO_COMPU_METHOD 0 0 0 255 ECU_ADDRESS 0 READ_WRITE /end MEASUREMENT
/begin MEASUREMENT Rte_FaultLog_FaultLog.CTCPassData[58].Byte5_Cnt_u08 "MICROSAR RTE" UBYTE NO_COMPU_METHOD 0 0 0 255 ECU_ADDRESS 0 READ_WRITE /end MEASUREMENT
/begin MEASUREMENT Rte_FaultLog_FaultLog.CTCPassData[58].Byte6_Cnt_u08 "MICROSAR RTE" UBYTE NO_COMPU_METHOD 0 0 0 255 ECU_ADDRESS 0 READ_WRITE /end MEASUREMENT
/begin MEASUREMENT Rte_FaultLog_FaultLog.CTCPassData[58].Reserved1_Cnt_u08 "MICROSAR RTE" UBYTE NO_COMPU_METHOD 0 0 0 255 ECU_ADDRESS 0 READ_WRITE /end MEASUREMENT
/begin MEASUREMENT Rte_FaultLog_FaultLog.CTCPassData[58].Reserved2_Cnt_u08 "MICROSAR RTE" UBYTE NO_COMPU_METHOD 0 0 0 255 ECU_ADDRESS 0 READ_WRITE /end MEASUREMENT
/begin MEASUREMENT Rte_FaultLog_FaultLog.CTCPassData[59].Byte1_Cnt_u08 "MICROSAR RTE" UBYTE NO_COMPU_METHOD 0 0 0 255 ECU_ADDRESS 0 READ_WRITE /end MEASUREMENT
/begin MEASUREMENT Rte_FaultLog_FaultLog.CTCPassData[59].Byte2_Cnt_u08 "MICROSAR RTE" UBYTE NO_COMPU_METHOD 0 0 0 255 ECU_ADDRESS 0 READ_WRITE /end MEASUREMENT
/begin MEASUREMENT Rte_FaultLog_FaultLog.CTCPassData[59].Byte3_Cnt_u08 "MICROSAR RTE" UBYTE NO_COMPU_METHOD 0 0 0 255 ECU_ADDRESS 0 READ_WRITE /end MEASUREMENT
/begin MEASUREMENT Rte_FaultLog_FaultLog.CTCPassData[59].Byte4_Cnt_u08 "MICROSAR RTE" UBYTE NO_COMPU_METHOD 0 0 0 255 ECU_ADDRESS 0 READ_WRITE /end MEASUREMENT
/begin MEASUREMENT Rte_FaultLog_FaultLog.CTCPassData[59].Byte5_Cnt_u08 "MICROSAR RTE" UBYTE NO_COMPU_METHOD 0 0 0 255 ECU_ADDRESS 0 READ_WRITE /end MEASUREMENT
/begin MEASUREMENT Rte_FaultLog_FaultLog.CTCPassData[59].Byte6_Cnt_u08 "MICROSAR RTE" UBYTE NO_COMPU_METHOD 0 0 0 255 ECU_ADDRESS 0 READ_WRITE /end MEASUREMENT
/begin MEASUREMENT Rte_FaultLog_FaultLog.CTCPassData[59].Reserved1_Cnt_u08 "MICROSAR RTE" UBYTE NO_COMPU_METHOD 0 0 0 255 ECU_ADDRESS 0 READ_WRITE /end MEASUREMENT
/begin MEASUREMENT Rte_FaultLog_FaultLog.CTCPassData[59].Reserved2_Cnt_u08 "MICROSAR RTE" UBYTE NO_COMPU_METHOD 0 0 0 255 ECU_ADDRESS 0 READ_WRITE /end MEASUREMENT
/begin MEASUREMENT Rte_FaultLog_FaultLog.CTCPassData[5].Byte1_Cnt_u08 "MICROSAR RTE" UBYTE NO_COMPU_METHOD 0 0 0 255 ECU_ADDRESS 0 READ_WRITE /end MEASUREMENT
/begin MEASUREMENT Rte_FaultLog_FaultLog.CTCPassData[5].Byte2_Cnt_u08 "MICROSAR RTE" UBYTE NO_COMPU_METHOD 0 0 0 255 ECU_ADDRESS 0 READ_WRITE /end MEASUREMENT
/begin MEASUREMENT Rte_FaultLog_FaultLog.CTCPassData[5].Byte3_Cnt_u08 "MICROSAR RTE" UBYTE NO_COMPU_METHOD 0 0 0 255 ECU_ADDRESS 0 READ_WRITE /end MEASUREMENT
/begin MEASUREMENT Rte_FaultLog_FaultLog.CTCPassData[5].Byte4_Cnt_u08 "MICROSAR RTE" UBYTE NO_COMPU_METHOD 0 0 0 255 ECU_ADDRESS 0 READ_WRITE /end MEASUREMENT
/begin MEASUREMENT Rte_FaultLog_FaultLog.CTCPassData[5].Byte5_Cnt_u08 "MICROSAR RTE" UBYTE NO_COMPU_METHOD 0 0 0 255 ECU_ADDRESS 0 READ_WRITE /end MEASUREMENT
/begin MEASUREMENT Rte_FaultLog_FaultLog.CTCPassData[5].Byte6_Cnt_u08 "MICROSAR RTE" UBYTE NO_COMPU_METHOD 0 0 0 255 ECU_ADDRESS 0 READ_WRITE /end MEASUREMENT
/begin MEASUREMENT Rte_FaultLog_FaultLog.CTCPassData[5].Reserved1_Cnt_u08 "MICROSAR RTE" UBYTE NO_COMPU_METHOD 0 0 0 255 ECU_ADDRESS 0 READ_WRITE /end MEASUREMENT
/begin MEASUREMENT Rte_FaultLog_FaultLog.CTCPassData[5].Reserved2_Cnt_u08 "MICROSAR RTE" UBYTE NO_COMPU_METHOD 0 0 0 255 ECU_ADDRESS 0 READ_WRITE /end MEASUREMENT
/begin MEASUREMENT Rte_FaultLog_FaultLog.CTCPassData[6].Byte1_Cnt_u08 "MICROSAR RTE" UBYTE NO_COMPU_METHOD 0 0 0 255 ECU_ADDRESS 0 READ_WRITE /end MEASUREMENT
/begin MEASUREMENT Rte_FaultLog_FaultLog.CTCPassData[6].Byte2_Cnt_u08 "MICROSAR RTE" UBYTE NO_COMPU_METHOD 0 0 0 255 ECU_ADDRESS 0 READ_WRITE /end MEASUREMENT
/begin MEASUREMENT Rte_FaultLog_FaultLog.CTCPassData[6].Byte3_Cnt_u08 "MICROSAR RTE" UBYTE NO_COMPU_METHOD 0 0 0 255 ECU_ADDRESS 0 READ_WRITE /end MEASUREMENT
/begin MEASUREMENT Rte_FaultLog_FaultLog.CTCPassData[6].Byte4_Cnt_u08 "MICROSAR RTE" UBYTE NO_COMPU_METHOD 0 0 0 255 ECU_ADDRESS 0 READ_WRITE /end MEASUREMENT
/begin MEASUREMENT Rte_FaultLog_FaultLog.CTCPassData[6].Byte5_Cnt_u08 "MICROSAR RTE" UBYTE NO_COMPU_METHOD 0 0 0 255 ECU_ADDRESS 0 READ_WRITE /end MEASUREMENT
/begin MEASUREMENT Rte_FaultLog_FaultLog.CTCPassData[6].Byte6_Cnt_u08 "MICROSAR RTE" UBYTE NO_COMPU_METHOD 0 0 0 255 ECU_ADDRESS 0 READ_WRITE /end MEASUREMENT
/begin MEASUREMENT Rte_FaultLog_FaultLog.CTCPassData[6].Reserved1_Cnt_u08 "MICROSAR RTE" UBYTE NO_COMPU_METHOD 0 0 0 255 ECU_ADDRESS 0 READ_WRITE /end MEASUREMENT
/begin MEASUREMENT Rte_FaultLog_FaultLog.CTCPassData[6].Reserved2_Cnt_u08 "MICROSAR RTE" UBYTE NO_COMPU_METHOD 0 0 0 255 ECU_ADDRESS 0 READ_WRITE /end MEASUREMENT
/begin MEASUREMENT Rte_FaultLog_FaultLog.CTCPassData[7].Byte1_Cnt_u08 "MICROSAR RTE" UBYTE NO_COMPU_METHOD 0 0 0 255 ECU_ADDRESS 0 READ_WRITE /end MEASUREMENT
/begin MEASUREMENT Rte_FaultLog_FaultLog.CTCPassData[7].Byte2_Cnt_u08 "MICROSAR RTE" UBYTE NO_COMPU_METHOD 0 0 0 255 ECU_ADDRESS 0 READ_WRITE /end MEASUREMENT
/begin MEASUREMENT Rte_FaultLog_FaultLog.CTCPassData[7].Byte3_Cnt_u08 "MICROSAR RTE" UBYTE NO_COMPU_METHOD 0 0 0 255 ECU_ADDRESS 0 READ_WRITE /end MEASUREMENT
/begin MEASUREMENT Rte_FaultLog_FaultLog.CTCPassData[7].Byte4_Cnt_u08 "MICROSAR RTE" UBYTE NO_COMPU_METHOD 0 0 0 255 ECU_ADDRESS 0 READ_WRITE /end MEASUREMENT
/begin MEASUREMENT Rte_FaultLog_FaultLog.CTCPassData[7].Byte5_Cnt_u08 "MICROSAR RTE" UBYTE NO_COMPU_METHOD 0 0 0 255 ECU_ADDRESS 0 READ_WRITE /end MEASUREMENT
/begin MEASUREMENT Rte_FaultLog_FaultLog.CTCPassData[7].Byte6_Cnt_u08 "MICROSAR RTE" UBYTE NO_COMPU_METHOD 0 0 0 255 ECU_ADDRESS 0 READ_WRITE /end MEASUREMENT
/begin MEASUREMENT Rte_FaultLog_FaultLog.CTCPassData[7].Reserved1_Cnt_u08 "MICROSAR RTE" UBYTE NO_COMPU_METHOD 0 0 0 255 ECU_ADDRESS 0 READ_WRITE /end MEASUREMENT
/begin MEASUREMENT Rte_FaultLog_FaultLog.CTCPassData[7].Reserved2_Cnt_u08 "MICROSAR RTE" UBYTE NO_COMPU_METHOD 0 0 0 255 ECU_ADDRESS 0 READ_WRITE /end MEASUREMENT
/begin MEASUREMENT Rte_FaultLog_FaultLog.CTCPassData[8].Byte1_Cnt_u08 "MICROSAR RTE" UBYTE NO_COMPU_METHOD 0 0 0 255 ECU_ADDRESS 0 READ_WRITE /end MEASUREMENT
/begin MEASUREMENT Rte_FaultLog_FaultLog.CTCPassData[8].Byte2_Cnt_u08 "MICROSAR RTE" UBYTE NO_COMPU_METHOD 0 0 0 255 ECU_ADDRESS 0 READ_WRITE /end MEASUREMENT
/begin MEASUREMENT Rte_FaultLog_FaultLog.CTCPassData[8].Byte3_Cnt_u08 "MICROSAR RTE" UBYTE NO_COMPU_METHOD 0 0 0 255 ECU_ADDRESS 0 READ_WRITE /end MEASUREMENT
/begin MEASUREMENT Rte_FaultLog_FaultLog.CTCPassData[8].Byte4_Cnt_u08 "MICROSAR RTE" UBYTE NO_COMPU_METHOD 0 0 0 255 ECU_ADDRESS 0 READ_WRITE /end MEASUREMENT
/begin MEASUREMENT Rte_FaultLog_FaultLog.CTCPassData[8].Byte5_Cnt_u08 "MICROSAR RTE" UBYTE NO_COMPU_METHOD 0 0 0 255 ECU_ADDRESS 0 READ_WRITE /end MEASUREMENT
/begin MEASUREMENT Rte_FaultLog_FaultLog.CTCPassData[8].Byte6_Cnt_u08 "MICROSAR RTE" UBYTE NO_COMPU_METHOD 0 0 0 255 ECU_ADDRESS 0 READ_WRITE /end MEASUREMENT
/begin MEASUREMENT Rte_FaultLog_FaultLog.CTCPassData[8].Reserved1_Cnt_u08 "MICROSAR RTE" UBYTE NO_COMPU_METHOD 0 0 0 255 ECU_ADDRESS 0 READ_WRITE /end MEASUREMENT
/begin MEASUREMENT Rte_FaultLog_FaultLog.CTCPassData[8].Reserved2_Cnt_u08 "MICROSAR RTE" UBYTE NO_COMPU_METHOD 0 0 0 255 ECU_ADDRESS 0 READ_WRITE /end MEASUREMENT
/begin MEASUREMENT Rte_FaultLog_FaultLog.CTCPassData[9].Byte1_Cnt_u08 "MICROSAR RTE" UBYTE NO_COMPU_METHOD 0 0 0 255 ECU_ADDRESS 0 READ_WRITE /end MEASUREMENT
/begin MEASUREMENT Rte_FaultLog_FaultLog.CTCPassData[9].Byte2_Cnt_u08 "MICROSAR RTE" UBYTE NO_COMPU_METHOD 0 0 0 255 ECU_ADDRESS 0 READ_WRITE /end MEASUREMENT
/begin MEASUREMENT Rte_FaultLog_FaultLog.CTCPassData[9].Byte3_Cnt_u08 "MICROSAR RTE" UBYTE NO_COMPU_METHOD 0 0 0 255 ECU_ADDRESS 0 READ_WRITE /end MEASUREMENT
/begin MEASUREMENT Rte_FaultLog_FaultLog.CTCPassData[9].Byte4_Cnt_u08 "MICROSAR RTE" UBYTE NO_COMPU_METHOD 0 0 0 255 ECU_ADDRESS 0 READ_WRITE /end MEASUREMENT
/begin MEASUREMENT Rte_FaultLog_FaultLog.CTCPassData[9].Byte5_Cnt_u08 "MICROSAR RTE" UBYTE NO_COMPU_METHOD 0 0 0 255 ECU_ADDRESS 0 READ_WRITE /end MEASUREMENT
/begin MEASUREMENT Rte_FaultLog_FaultLog.CTCPassData[9].Byte6_Cnt_u08 "MICROSAR RTE" UBYTE NO_COMPU_METHOD 0 0 0 255 ECU_ADDRESS 0 READ_WRITE /end MEASUREMENT
/begin MEASUREMENT Rte_FaultLog_FaultLog.CTCPassData[9].Reserved1_Cnt_u08 "MICROSAR RTE" UBYTE NO_COMPU_METHOD 0 0 0 255 ECU_ADDRESS 0 READ_WRITE /end MEASUREMENT
/begin MEASUREMENT Rte_FaultLog_FaultLog.CTCPassData[9].Reserved2_Cnt_u08 "MICROSAR RTE" UBYTE NO_COMPU_METHOD 0 0 0 255 ECU_ADDRESS 0 READ_WRITE /end MEASUREMENT
/begin MEASUREMENT Rte_FaultLog_FaultLog.QueueData[0].QueueEventIdx_Cnt_u08 "MICROSAR RTE" UBYTE NO_COMPU_METHOD 0 0 0 255 ECU_ADDRESS 0 READ_WRITE /end MEASUREMENT
/begin MEASUREMENT Rte_FaultLog_FaultLog.QueueData[0].Status_Cnt_u08 "MICROSAR RTE" UBYTE NO_COMPU_METHOD 0 0 0 255 ECU_ADDRESS 0 READ_WRITE /end MEASUREMENT
/begin MEASUREMENT Rte_FaultLog_FaultLog.QueueData[100].QueueEventIdx_Cnt_u08 "MICROSAR RTE" UBYTE NO_COMPU_METHOD 0 0 0 255 ECU_ADDRESS 0 READ_WRITE /end MEASUREMENT
/begin MEASUREMENT Rte_FaultLog_FaultLog.QueueData[100].Status_Cnt_u08 "MICROSAR RTE" UBYTE NO_COMPU_METHOD 0 0 0 255 ECU_ADDRESS 0 READ_WRITE /end MEASUREMENT
/begin MEASUREMENT Rte_FaultLog_FaultLog.QueueData[101].QueueEventIdx_Cnt_u08 "MICROSAR RTE" UBYTE NO_COMPU_METHOD 0 0 0 255 ECU_ADDRESS 0 READ_WRITE /end MEASUREMENT
/begin MEASUREMENT Rte_FaultLog_FaultLog.QueueData[101].Status_Cnt_u08 "MICROSAR RTE" UBYTE NO_COMPU_METHOD 0 0 0 255 ECU_ADDRESS 0 READ_WRITE /end MEASUREMENT
/begin MEASUREMENT Rte_FaultLog_FaultLog.QueueData[102].QueueEventIdx_Cnt_u08 "MICROSAR RTE" UBYTE NO_COMPU_METHOD 0 0 0 255 ECU_ADDRESS 0 READ_WRITE /end MEASUREMENT
/begin MEASUREMENT Rte_FaultLog_FaultLog.QueueData[102].Status_Cnt_u08 "MICROSAR RTE" UBYTE NO_COMPU_METHOD 0 0 0 255 ECU_ADDRESS 0 READ_WRITE /end MEASUREMENT
/begin MEASUREMENT Rte_FaultLog_FaultLog.QueueData[103].QueueEventIdx_Cnt_u08 "MICROSAR RTE" UBYTE NO_COMPU_METHOD 0 0 0 255 ECU_ADDRESS 0 READ_WRITE /end MEASUREMENT
/begin MEASUREMENT Rte_FaultLog_FaultLog.QueueData[103].Status_Cnt_u08 "MICROSAR RTE" UBYTE NO_COMPU_METHOD 0 0 0 255 ECU_ADDRESS 0 READ_WRITE /end MEASUREMENT
/begin MEASUREMENT Rte_FaultLog_FaultLog.QueueData[104].QueueEventIdx_Cnt_u08 "MICROSAR RTE" UBYTE NO_COMPU_METHOD 0 0 0 255 ECU_ADDRESS 0 READ_WRITE /end MEASUREMENT
/begin MEASUREMENT Rte_FaultLog_FaultLog.QueueData[104].Status_Cnt_u08 "MICROSAR RTE" UBYTE NO_COMPU_METHOD 0 0 0 255 ECU_ADDRESS 0 READ_WRITE /end MEASUREMENT
/begin MEASUREMENT Rte_FaultLog_FaultLog.QueueData[105].QueueEventIdx_Cnt_u08 "MICROSAR RTE" UBYTE NO_COMPU_METHOD 0 0 0 255 ECU_ADDRESS 0 READ_WRITE /end MEASUREMENT
/begin MEASUREMENT Rte_FaultLog_FaultLog.QueueData[105].Status_Cnt_u08 "MICROSAR RTE" UBYTE NO_COMPU_METHOD 0 0 0 255 ECU_ADDRESS 0 READ_WRITE /end MEASUREMENT
/begin MEASUREMENT Rte_FaultLog_FaultLog.QueueData[106].QueueEventIdx_Cnt_u08 "MICROSAR RTE" UBYTE NO_COMPU_METHOD 0 0 0 255 ECU_ADDRESS 0 READ_WRITE /end MEASUREMENT
/begin MEASUREMENT Rte_FaultLog_FaultLog.QueueData[106].Status_Cnt_u08 "MICROSAR RTE" UBYTE NO_COMPU_METHOD 0 0 0 255 ECU_ADDRESS 0 READ_WRITE /end MEASUREMENT
/begin MEASUREMENT Rte_FaultLog_FaultLog.QueueData[107].QueueEventIdx_Cnt_u08 "MICROSAR RTE" UBYTE NO_COMPU_METHOD 0 0 0 255 ECU_ADDRESS 0 READ_WRITE /end MEASUREMENT
/begin MEASUREMENT Rte_FaultLog_FaultLog.QueueData[107].Status_Cnt_u08 "MICROSAR RTE" UBYTE NO_COMPU_METHOD 0 0 0 255 ECU_ADDRESS 0 READ_WRITE /end MEASUREMENT
/begin MEASUREMENT Rte_FaultLog_FaultLog.QueueData[108].QueueEventIdx_Cnt_u08 "MICROSAR RTE" UBYTE NO_COMPU_METHOD 0 0 0 255 ECU_ADDRESS 0 READ_WRITE /end MEASUREMENT
/begin MEASUREMENT Rte_FaultLog_FaultLog.QueueData[108].Status_Cnt_u08 "MICROSAR RTE" UBYTE NO_COMPU_METHOD 0 0 0 255 ECU_ADDRESS 0 READ_WRITE /end MEASUREMENT
/begin MEASUREMENT Rte_FaultLog_FaultLog.QueueData[109].QueueEventIdx_Cnt_u08 "MICROSAR RTE" UBYTE NO_COMPU_METHOD 0 0 0 255 ECU_ADDRESS 0 READ_WRITE /end MEASUREMENT
/begin MEASUREMENT Rte_FaultLog_FaultLog.QueueData[109].Status_Cnt_u08 "MICROSAR RTE" UBYTE NO_COMPU_METHOD 0 0 0 255 ECU_ADDRESS 0 READ_WRITE /end MEASUREMENT
/begin MEASUREMENT Rte_FaultLog_FaultLog.QueueData[10].QueueEventIdx_Cnt_u08 "MICROSAR RTE" UBYTE NO_COMPU_METHOD 0 0 0 255 ECU_ADDRESS 0 READ_WRITE /end MEASUREMENT
/begin MEASUREMENT Rte_FaultLog_FaultLog.QueueData[10].Status_Cnt_u08 "MICROSAR RTE" UBYTE NO_COMPU_METHOD 0 0 0 255 ECU_ADDRESS 0 READ_WRITE /end MEASUREMENT
/begin MEASUREMENT Rte_FaultLog_FaultLog.QueueData[110].QueueEventIdx_Cnt_u08 "MICROSAR RTE" UBYTE NO_COMPU_METHOD 0 0 0 255 ECU_ADDRESS 0 READ_WRITE /end MEASUREMENT
/begin MEASUREMENT Rte_FaultLog_FaultLog.QueueData[110].Status_Cnt_u08 "MICROSAR RTE" UBYTE NO_COMPU_METHOD 0 0 0 255 ECU_ADDRESS 0 READ_WRITE /end MEASUREMENT
/begin MEASUREMENT Rte_FaultLog_FaultLog.QueueData[111].QueueEventIdx_Cnt_u08 "MICROSAR RTE" UBYTE NO_COMPU_METHOD 0 0 0 255 ECU_ADDRESS 0 READ_WRITE /end MEASUREMENT
/begin MEASUREMENT Rte_FaultLog_FaultLog.QueueData[111].Status_Cnt_u08 "MICROSAR RTE" UBYTE NO_COMPU_METHOD 0 0 0 255 ECU_ADDRESS 0 READ_WRITE /end MEASUREMENT
/begin MEASUREMENT Rte_FaultLog_FaultLog.QueueData[112].QueueEventIdx_Cnt_u08 "MICROSAR RTE" UBYTE NO_COMPU_METHOD 0 0 0 255 ECU_ADDRESS 0 READ_WRITE /end MEASUREMENT
/begin MEASUREMENT Rte_FaultLog_FaultLog.QueueData[112].Status_Cnt_u08 "MICROSAR RTE" UBYTE NO_COMPU_METHOD 0 0 0 255 ECU_ADDRESS 0 READ_WRITE /end MEASUREMENT
/begin MEASUREMENT Rte_FaultLog_FaultLog.QueueData[113].QueueEventIdx_Cnt_u08 "MICROSAR RTE" UBYTE NO_COMPU_METHOD 0 0 0 255 ECU_ADDRESS 0 READ_WRITE /end MEASUREMENT
/begin MEASUREMENT Rte_FaultLog_FaultLog.QueueData[113].Status_Cnt_u08 "MICROSAR RTE" UBYTE NO_COMPU_METHOD 0 0 0 255 ECU_ADDRESS 0 READ_WRITE /end MEASUREMENT
/begin MEASUREMENT Rte_FaultLog_FaultLog.QueueData[114].QueueEventIdx_Cnt_u08 "MICROSAR RTE" UBYTE NO_COMPU_METHOD 0 0 0 255 ECU_ADDRESS 0 READ_WRITE /end MEASUREMENT
/begin MEASUREMENT Rte_FaultLog_FaultLog.QueueData[114].Status_Cnt_u08 "MICROSAR RTE" UBYTE NO_COMPU_METHOD 0 0 0 255 ECU_ADDRESS 0 READ_WRITE /end MEASUREMENT
/begin MEASUREMENT Rte_FaultLog_FaultLog.QueueData[115].QueueEventIdx_Cnt_u08 "MICROSAR RTE" UBYTE NO_COMPU_METHOD 0 0 0 255 ECU_ADDRESS 0 READ_WRITE /end MEASUREMENT
/begin MEASUREMENT Rte_FaultLog_FaultLog.QueueData[115].Status_Cnt_u08 "MICROSAR RTE" UBYTE NO_COMPU_METHOD 0 0 0 255 ECU_ADDRESS 0 READ_WRITE /end MEASUREMENT
/begin MEASUREMENT Rte_FaultLog_FaultLog.QueueData[116].QueueEventIdx_Cnt_u08 "MICROSAR RTE" UBYTE NO_COMPU_METHOD 0 0 0 255 ECU_ADDRESS 0 READ_WRITE /end MEASUREMENT
/begin MEASUREMENT Rte_FaultLog_FaultLog.QueueData[116].Status_Cnt_u08 "MICROSAR RTE" UBYTE NO_COMPU_METHOD 0 0 0 255 ECU_ADDRESS 0 READ_WRITE /end MEASUREMENT
/begin MEASUREMENT Rte_FaultLog_FaultLog.QueueData[117].QueueEventIdx_Cnt_u08 "MICROSAR RTE" UBYTE NO_COMPU_METHOD 0 0 0 255 ECU_ADDRESS 0 READ_WRITE /end MEASUREMENT
/begin MEASUREMENT Rte_FaultLog_FaultLog.QueueData[117].Status_Cnt_u08 "MICROSAR RTE" UBYTE NO_COMPU_METHOD 0 0 0 255 ECU_ADDRESS 0 READ_WRITE /end MEASUREMENT
/begin MEASUREMENT Rte_FaultLog_FaultLog.QueueData[118].QueueEventIdx_Cnt_u08 "MICROSAR RTE" UBYTE NO_COMPU_METHOD 0 0 0 255 ECU_ADDRESS 0 READ_WRITE /end MEASUREMENT
/begin MEASUREMENT Rte_FaultLog_FaultLog.QueueData[118].Status_Cnt_u08 "MICROSAR RTE" UBYTE NO_COMPU_METHOD 0 0 0 255 ECU_ADDRESS 0 READ_WRITE /end MEASUREMENT
/begin MEASUREMENT Rte_FaultLog_FaultLog.QueueData[119].QueueEventIdx_Cnt_u08 "MICROSAR RTE" UBYTE NO_COMPU_METHOD 0 0 0 255 ECU_ADDRESS 0 READ_WRITE /end MEASUREMENT
/begin MEASUREMENT Rte_FaultLog_FaultLog.QueueData[119].Status_Cnt_u08 "MICROSAR RTE" UBYTE NO_COMPU_METHOD 0 0 0 255 ECU_ADDRESS 0 READ_WRITE /end MEASUREMENT
/begin MEASUREMENT Rte_FaultLog_FaultLog.QueueData[11].QueueEventIdx_Cnt_u08 "MICROSAR RTE" UBYTE NO_COMPU_METHOD 0 0 0 255 ECU_ADDRESS 0 READ_WRITE /end MEASUREMENT
/begin MEASUREMENT Rte_FaultLog_FaultLog.QueueData[11].Status_Cnt_u08 "MICROSAR RTE" UBYTE NO_COMPU_METHOD 0 0 0 255 ECU_ADDRESS 0 READ_WRITE /end MEASUREMENT
/begin MEASUREMENT Rte_FaultLog_FaultLog.QueueData[12].QueueEventIdx_Cnt_u08 "MICROSAR RTE" UBYTE NO_COMPU_METHOD 0 0 0 255 ECU_ADDRESS 0 READ_WRITE /end MEASUREMENT
/begin MEASUREMENT Rte_FaultLog_FaultLog.QueueData[12].Status_Cnt_u08 "MICROSAR RTE" UBYTE NO_COMPU_METHOD 0 0 0 255 ECU_ADDRESS 0 READ_WRITE /end MEASUREMENT
/begin MEASUREMENT Rte_FaultLog_FaultLog.QueueData[13].QueueEventIdx_Cnt_u08 "MICROSAR RTE" UBYTE NO_COMPU_METHOD 0 0 0 255 ECU_ADDRESS 0 READ_WRITE /end MEASUREMENT
/begin MEASUREMENT Rte_FaultLog_FaultLog.QueueData[13].Status_Cnt_u08 "MICROSAR RTE" UBYTE NO_COMPU_METHOD 0 0 0 255 ECU_ADDRESS 0 READ_WRITE /end MEASUREMENT
/begin MEASUREMENT Rte_FaultLog_FaultLog.QueueData[14].QueueEventIdx_Cnt_u08 "MICROSAR RTE" UBYTE NO_COMPU_METHOD 0 0 0 255 ECU_ADDRESS 0 READ_WRITE /end MEASUREMENT
/begin MEASUREMENT Rte_FaultLog_FaultLog.QueueData[14].Status_Cnt_u08 "MICROSAR RTE" UBYTE NO_COMPU_METHOD 0 0 0 255 ECU_ADDRESS 0 READ_WRITE /end MEASUREMENT
/begin MEASUREMENT Rte_FaultLog_FaultLog.QueueData[15].QueueEventIdx_Cnt_u08 "MICROSAR RTE" UBYTE NO_COMPU_METHOD 0 0 0 255 ECU_ADDRESS 0 READ_WRITE /end MEASUREMENT
/begin MEASUREMENT Rte_FaultLog_FaultLog.QueueData[15].Status_Cnt_u08 "MICROSAR RTE" UBYTE NO_COMPU_METHOD 0 0 0 255 ECU_ADDRESS 0 READ_WRITE /end MEASUREMENT
/begin MEASUREMENT Rte_FaultLog_FaultLog.QueueData[16].QueueEventIdx_Cnt_u08 "MICROSAR RTE" UBYTE NO_COMPU_METHOD 0 0 0 255 ECU_ADDRESS 0 READ_WRITE /end MEASUREMENT
/begin MEASUREMENT Rte_FaultLog_FaultLog.QueueData[16].Status_Cnt_u08 "MICROSAR RTE" UBYTE NO_COMPU_METHOD 0 0 0 255 ECU_ADDRESS 0 READ_WRITE /end MEASUREMENT
/begin MEASUREMENT Rte_FaultLog_FaultLog.QueueData[17].QueueEventIdx_Cnt_u08 "MICROSAR RTE" UBYTE NO_COMPU_METHOD 0 0 0 255 ECU_ADDRESS 0 READ_WRITE /end MEASUREMENT
/begin MEASUREMENT Rte_FaultLog_FaultLog.QueueData[17].Status_Cnt_u08 "MICROSAR RTE" UBYTE NO_COMPU_METHOD 0 0 0 255 ECU_ADDRESS 0 READ_WRITE /end MEASUREMENT
/begin MEASUREMENT Rte_FaultLog_FaultLog.QueueData[18].QueueEventIdx_Cnt_u08 "MICROSAR RTE" UBYTE NO_COMPU_METHOD 0 0 0 255 ECU_ADDRESS 0 READ_WRITE /end MEASUREMENT
/begin MEASUREMENT Rte_FaultLog_FaultLog.QueueData[18].Status_Cnt_u08 "MICROSAR RTE" UBYTE NO_COMPU_METHOD 0 0 0 255 ECU_ADDRESS 0 READ_WRITE /end MEASUREMENT
/begin MEASUREMENT Rte_FaultLog_FaultLog.QueueData[19].QueueEventIdx_Cnt_u08 "MICROSAR RTE" UBYTE NO_COMPU_METHOD 0 0 0 255 ECU_ADDRESS 0 READ_WRITE /end MEASUREMENT
/begin MEASUREMENT Rte_FaultLog_FaultLog.QueueData[19].Status_Cnt_u08 "MICROSAR RTE" UBYTE NO_COMPU_METHOD 0 0 0 255 ECU_ADDRESS 0 READ_WRITE /end MEASUREMENT
/begin MEASUREMENT Rte_FaultLog_FaultLog.QueueData[1].QueueEventIdx_Cnt_u08 "MICROSAR RTE" UBYTE NO_COMPU_METHOD 0 0 0 255 ECU_ADDRESS 0 READ_WRITE /end MEASUREMENT
/begin MEASUREMENT Rte_FaultLog_FaultLog.QueueData[1].Status_Cnt_u08 "MICROSAR RTE" UBYTE NO_COMPU_METHOD 0 0 0 255 ECU_ADDRESS 0 READ_WRITE /end MEASUREMENT
/begin MEASUREMENT Rte_FaultLog_FaultLog.QueueData[20].QueueEventIdx_Cnt_u08 "MICROSAR RTE" UBYTE NO_COMPU_METHOD 0 0 0 255 ECU_ADDRESS 0 READ_WRITE /end MEASUREMENT
/begin MEASUREMENT Rte_FaultLog_FaultLog.QueueData[20].Status_Cnt_u08 "MICROSAR RTE" UBYTE NO_COMPU_METHOD 0 0 0 255 ECU_ADDRESS 0 READ_WRITE /end MEASUREMENT
/begin MEASUREMENT Rte_FaultLog_FaultLog.QueueData[21].QueueEventIdx_Cnt_u08 "MICROSAR RTE" UBYTE NO_COMPU_METHOD 0 0 0 255 ECU_ADDRESS 0 READ_WRITE /end MEASUREMENT
/begin MEASUREMENT Rte_FaultLog_FaultLog.QueueData[21].Status_Cnt_u08 "MICROSAR RTE" UBYTE NO_COMPU_METHOD 0 0 0 255 ECU_ADDRESS 0 READ_WRITE /end MEASUREMENT
/begin MEASUREMENT Rte_FaultLog_FaultLog.QueueData[22].QueueEventIdx_Cnt_u08 "MICROSAR RTE" UBYTE NO_COMPU_METHOD 0 0 0 255 ECU_ADDRESS 0 READ_WRITE /end MEASUREMENT
/begin MEASUREMENT Rte_FaultLog_FaultLog.QueueData[22].Status_Cnt_u08 "MICROSAR RTE" UBYTE NO_COMPU_METHOD 0 0 0 255 ECU_ADDRESS 0 READ_WRITE /end MEASUREMENT
/begin MEASUREMENT Rte_FaultLog_FaultLog.QueueData[23].QueueEventIdx_Cnt_u08 "MICROSAR RTE" UBYTE NO_COMPU_METHOD 0 0 0 255 ECU_ADDRESS 0 READ_WRITE /end MEASUREMENT
/begin MEASUREMENT Rte_FaultLog_FaultLog.QueueData[23].Status_Cnt_u08 "MICROSAR RTE" UBYTE NO_COMPU_METHOD 0 0 0 255 ECU_ADDRESS 0 READ_WRITE /end MEASUREMENT
/begin MEASUREMENT Rte_FaultLog_FaultLog.QueueData[24].QueueEventIdx_Cnt_u08 "MICROSAR RTE" UBYTE NO_COMPU_METHOD 0 0 0 255 ECU_ADDRESS 0 READ_WRITE /end MEASUREMENT
/begin MEASUREMENT Rte_FaultLog_FaultLog.QueueData[24].Status_Cnt_u08 "MICROSAR RTE" UBYTE NO_COMPU_METHOD 0 0 0 255 ECU_ADDRESS 0 READ_WRITE /end MEASUREMENT
/begin MEASUREMENT Rte_FaultLog_FaultLog.QueueData[25].QueueEventIdx_Cnt_u08 "MICROSAR RTE" UBYTE NO_COMPU_METHOD 0 0 0 255 ECU_ADDRESS 0 READ_WRITE /end MEASUREMENT
/begin MEASUREMENT Rte_FaultLog_FaultLog.QueueData[25].Status_Cnt_u08 "MICROSAR RTE" UBYTE NO_COMPU_METHOD 0 0 0 255 ECU_ADDRESS 0 READ_WRITE /end MEASUREMENT
/begin MEASUREMENT Rte_FaultLog_FaultLog.QueueData[26].QueueEventIdx_Cnt_u08 "MICROSAR RTE" UBYTE NO_COMPU_METHOD 0 0 0 255 ECU_ADDRESS 0 READ_WRITE /end MEASUREMENT
/begin MEASUREMENT Rte_FaultLog_FaultLog.QueueData[26].Status_Cnt_u08 "MICROSAR RTE" UBYTE NO_COMPU_METHOD 0 0 0 255 ECU_ADDRESS 0 READ_WRITE /end MEASUREMENT
/begin MEASUREMENT Rte_FaultLog_FaultLog.QueueData[27].QueueEventIdx_Cnt_u08 "MICROSAR RTE" UBYTE NO_COMPU_METHOD 0 0 0 255 ECU_ADDRESS 0 READ_WRITE /end MEASUREMENT
/begin MEASUREMENT Rte_FaultLog_FaultLog.QueueData[27].Status_Cnt_u08 "MICROSAR RTE" UBYTE NO_COMPU_METHOD 0 0 0 255 ECU_ADDRESS 0 READ_WRITE /end MEASUREMENT
/begin MEASUREMENT Rte_FaultLog_FaultLog.QueueData[28].QueueEventIdx_Cnt_u08 "MICROSAR RTE" UBYTE NO_COMPU_METHOD 0 0 0 255 ECU_ADDRESS 0 READ_WRITE /end MEASUREMENT
/begin MEASUREMENT Rte_FaultLog_FaultLog.QueueData[28].Status_Cnt_u08 "MICROSAR RTE" UBYTE NO_COMPU_METHOD 0 0 0 255 ECU_ADDRESS 0 READ_WRITE /end MEASUREMENT
/begin MEASUREMENT Rte_FaultLog_FaultLog.QueueData[29].QueueEventIdx_Cnt_u08 "MICROSAR RTE" UBYTE NO_COMPU_METHOD 0 0 0 255 ECU_ADDRESS 0 READ_WRITE /end MEASUREMENT
/begin MEASUREMENT Rte_FaultLog_FaultLog.QueueData[29].Status_Cnt_u08 "MICROSAR RTE" UBYTE NO_COMPU_METHOD 0 0 0 255 ECU_ADDRESS 0 READ_WRITE /end MEASUREMENT
/begin MEASUREMENT Rte_FaultLog_FaultLog.QueueData[2].QueueEventIdx_Cnt_u08 "MICROSAR RTE" UBYTE NO_COMPU_METHOD 0 0 0 255 ECU_ADDRESS 0 READ_WRITE /end MEASUREMENT
/begin MEASUREMENT Rte_FaultLog_FaultLog.QueueData[2].Status_Cnt_u08 "MICROSAR RTE" UBYTE NO_COMPU_METHOD 0 0 0 255 ECU_ADDRESS 0 READ_WRITE /end MEASUREMENT
/begin MEASUREMENT Rte_FaultLog_FaultLog.QueueData[30].QueueEventIdx_Cnt_u08 "MICROSAR RTE" UBYTE NO_COMPU_METHOD 0 0 0 255 ECU_ADDRESS 0 READ_WRITE /end MEASUREMENT
/begin MEASUREMENT Rte_FaultLog_FaultLog.QueueData[30].Status_Cnt_u08 "MICROSAR RTE" UBYTE NO_COMPU_METHOD 0 0 0 255 ECU_ADDRESS 0 READ_WRITE /end MEASUREMENT
/begin MEASUREMENT Rte_FaultLog_FaultLog.QueueData[31].QueueEventIdx_Cnt_u08 "MICROSAR RTE" UBYTE NO_COMPU_METHOD 0 0 0 255 ECU_ADDRESS 0 READ_WRITE /end MEASUREMENT
/begin MEASUREMENT Rte_FaultLog_FaultLog.QueueData[31].Status_Cnt_u08 "MICROSAR RTE" UBYTE NO_COMPU_METHOD 0 0 0 255 ECU_ADDRESS 0 READ_WRITE /end MEASUREMENT
/begin MEASUREMENT Rte_FaultLog_FaultLog.QueueData[32].QueueEventIdx_Cnt_u08 "MICROSAR RTE" UBYTE NO_COMPU_METHOD 0 0 0 255 ECU_ADDRESS 0 READ_WRITE /end MEASUREMENT
/begin MEASUREMENT Rte_FaultLog_FaultLog.QueueData[32].Status_Cnt_u08 "MICROSAR RTE" UBYTE NO_COMPU_METHOD 0 0 0 255 ECU_ADDRESS 0 READ_WRITE /end MEASUREMENT
/begin MEASUREMENT Rte_FaultLog_FaultLog.QueueData[33].QueueEventIdx_Cnt_u08 "MICROSAR RTE" UBYTE NO_COMPU_METHOD 0 0 0 255 ECU_ADDRESS 0 READ_WRITE /end MEASUREMENT
/begin MEASUREMENT Rte_FaultLog_FaultLog.QueueData[33].Status_Cnt_u08 "MICROSAR RTE" UBYTE NO_COMPU_METHOD 0 0 0 255 ECU_ADDRESS 0 READ_WRITE /end MEASUREMENT
/begin MEASUREMENT Rte_FaultLog_FaultLog.QueueData[34].QueueEventIdx_Cnt_u08 "MICROSAR RTE" UBYTE NO_COMPU_METHOD 0 0 0 255 ECU_ADDRESS 0 READ_WRITE /end MEASUREMENT
/begin MEASUREMENT Rte_FaultLog_FaultLog.QueueData[34].Status_Cnt_u08 "MICROSAR RTE" UBYTE NO_COMPU_METHOD 0 0 0 255 ECU_ADDRESS 0 READ_WRITE /end MEASUREMENT
/begin MEASUREMENT Rte_FaultLog_FaultLog.QueueData[35].QueueEventIdx_Cnt_u08 "MICROSAR RTE" UBYTE NO_COMPU_METHOD 0 0 0 255 ECU_ADDRESS 0 READ_WRITE /end MEASUREMENT
/begin MEASUREMENT Rte_FaultLog_FaultLog.QueueData[35].Status_Cnt_u08 "MICROSAR RTE" UBYTE NO_COMPU_METHOD 0 0 0 255 ECU_ADDRESS 0 READ_WRITE /end MEASUREMENT
/begin MEASUREMENT Rte_FaultLog_FaultLog.QueueData[36].QueueEventIdx_Cnt_u08 "MICROSAR RTE" UBYTE NO_COMPU_METHOD 0 0 0 255 ECU_ADDRESS 0 READ_WRITE /end MEASUREMENT
/begin MEASUREMENT Rte_FaultLog_FaultLog.QueueData[36].Status_Cnt_u08 "MICROSAR RTE" UBYTE NO_COMPU_METHOD 0 0 0 255 ECU_ADDRESS 0 READ_WRITE /end MEASUREMENT
/begin MEASUREMENT Rte_FaultLog_FaultLog.QueueData[37].QueueEventIdx_Cnt_u08 "MICROSAR RTE" UBYTE NO_COMPU_METHOD 0 0 0 255 ECU_ADDRESS 0 READ_WRITE /end MEASUREMENT
/begin MEASUREMENT Rte_FaultLog_FaultLog.QueueData[37].Status_Cnt_u08 "MICROSAR RTE" UBYTE NO_COMPU_METHOD 0 0 0 255 ECU_ADDRESS 0 READ_WRITE /end MEASUREMENT
/begin MEASUREMENT Rte_FaultLog_FaultLog.QueueData[38].QueueEventIdx_Cnt_u08 "MICROSAR RTE" UBYTE NO_COMPU_METHOD 0 0 0 255 ECU_ADDRESS 0 READ_WRITE /end MEASUREMENT
/begin MEASUREMENT Rte_FaultLog_FaultLog.QueueData[38].Status_Cnt_u08 "MICROSAR RTE" UBYTE NO_COMPU_METHOD 0 0 0 255 ECU_ADDRESS 0 READ_WRITE /end MEASUREMENT
/begin MEASUREMENT Rte_FaultLog_FaultLog.QueueData[39].QueueEventIdx_Cnt_u08 "MICROSAR RTE" UBYTE NO_COMPU_METHOD 0 0 0 255 ECU_ADDRESS 0 READ_WRITE /end MEASUREMENT
/begin MEASUREMENT Rte_FaultLog_FaultLog.QueueData[39].Status_Cnt_u08 "MICROSAR RTE" UBYTE NO_COMPU_METHOD 0 0 0 255 ECU_ADDRESS 0 READ_WRITE /end MEASUREMENT
/begin MEASUREMENT Rte_FaultLog_FaultLog.QueueData[3].QueueEventIdx_Cnt_u08 "MICROSAR RTE" UBYTE NO_COMPU_METHOD 0 0 0 255 ECU_ADDRESS 0 READ_WRITE /end MEASUREMENT
/begin MEASUREMENT Rte_FaultLog_FaultLog.QueueData[3].Status_Cnt_u08 "MICROSAR RTE" UBYTE NO_COMPU_METHOD 0 0 0 255 ECU_ADDRESS 0 READ_WRITE /end MEASUREMENT
/begin MEASUREMENT Rte_FaultLog_FaultLog.QueueData[40].QueueEventIdx_Cnt_u08 "MICROSAR RTE" UBYTE NO_COMPU_METHOD 0 0 0 255 ECU_ADDRESS 0 READ_WRITE /end MEASUREMENT
/begin MEASUREMENT Rte_FaultLog_FaultLog.QueueData[40].Status_Cnt_u08 "MICROSAR RTE" UBYTE NO_COMPU_METHOD 0 0 0 255 ECU_ADDRESS 0 READ_WRITE /end MEASUREMENT
/begin MEASUREMENT Rte_FaultLog_FaultLog.QueueData[41].QueueEventIdx_Cnt_u08 "MICROSAR RTE" UBYTE NO_COMPU_METHOD 0 0 0 255 ECU_ADDRESS 0 READ_WRITE /end MEASUREMENT
/begin MEASUREMENT Rte_FaultLog_FaultLog.QueueData[41].Status_Cnt_u08 "MICROSAR RTE" UBYTE NO_COMPU_METHOD 0 0 0 255 ECU_ADDRESS 0 READ_WRITE /end MEASUREMENT
/begin MEASUREMENT Rte_FaultLog_FaultLog.QueueData[42].QueueEventIdx_Cnt_u08 "MICROSAR RTE" UBYTE NO_COMPU_METHOD 0 0 0 255 ECU_ADDRESS 0 READ_WRITE /end MEASUREMENT
/begin GROUP FaultLog.FaultLog "MICROSAR RTE"
 /begin REF_MEASUREMENT Rte_FaultLog_FaultLog.CTCFailData[32].Byte2_Cnt_u08 Rte_FaultLog_FaultLog.CTCFailData[32].Byte3_Cnt_u08 Rte_FaultLog_FaultLog.CTCFailData[32].Byte4_Cnt_u08 Rte_FaultLog_FaultLog.CTCFailData[32].Byte5_Cnt_u08 Rte_FaultLog_FaultLog.CTCFailData[32].Byte6_Cnt_u08 Rte_FaultLog_FaultLog.CTCFailData[32].Reserved1_Cnt_u08 Rte_FaultLog_FaultLog.CTCFailData[32].Reserved2_Cnt_u08 Rte_FaultLog_FaultLog.CTCFailData[33].Byte1_Cnt_u08 Rte_FaultLog_FaultLog.CTCFailData[33].Byte2_Cnt_u08 Rte_FaultLog_FaultLog.CTCFailData[33].Byte3_Cnt_u08 Rte_FaultLog_FaultLog.CTCFailData[33].Byte4_Cnt_u08 Rte_FaultLog_FaultLog.CTCFailData[33].Byte5_Cnt_u08 Rte_FaultLog_FaultLog.CTCFailData[33].Byte6_Cnt_u08 Rte_FaultLog_FaultLog.CTCFailData[33].Reserved1_Cnt_u08 Rte_FaultLog_FaultLog.CTCFailData[33].Reserved2_Cnt_u08 Rte_FaultLog_FaultLog.CTCFailData[34].Byte1_Cnt_u08 Rte_FaultLog_FaultLog.CTCFailData[34].Byte2_Cnt_u08 Rte_FaultLog_FaultLog.CTCFailData[34].Byte3_Cnt_u08 Rte_FaultLog_FaultLog.CTCFailData[34].Byte4_Cnt_u08 Rte_FaultLog_FaultLog.CTCFailData[34].Byte5_Cnt_u08 Rte_FaultLog_FaultLog.CTCFailData[34].Byte6_Cnt_u08 Rte_FaultLog_FaultLog.CTCFailData[34].Reserved1_Cnt_u08 Rte_FaultLog_FaultLog.CTCFailData[34].Reserved2_Cnt_u08 Rte_FaultLog_FaultLog.CTCFailData[35].Byte1_Cnt_u08 Rte_FaultLog_FaultLog.CTCFailData[35].Byte2_Cnt_u08 Rte_FaultLog_FaultLog.CTCFailData[35].Byte3_Cnt_u08 Rte_FaultLog_FaultLog.CTCFailData[35].Byte4_Cnt_u08 Rte_FaultLog_FaultLog.CTCFailData[35].Byte5_Cnt_u08 Rte_FaultLog_FaultLog.CTCFailData[35].Byte6_Cnt_u08 Rte_FaultLog_FaultLog.CTCFailData[35].Reserved1_Cnt_u08 Rte_FaultLog_FaultLog.CTCFailData[35].Reserved2_Cnt_u08 Rte_FaultLog_FaultLog.CTCFailData[36].Byte1_Cnt_u08 Rte_FaultLog_FaultLog.CTCFailData[36].Byte2_Cnt_u08 Rte_FaultLog_FaultLog.CTCFailData[36].Byte3_Cnt_u08 Rte_FaultLog_FaultLog.CTCFailData[36].Byte4_Cnt_u08 Rte_FaultLog_FaultLog.CTCFailData[36].Byte5_Cnt_u08 Rte_FaultLog_FaultLog.CTCFailData[36].Byte6_Cnt_u08 Rte_FaultLog_FaultLog.CTCFailData[36].Reserved1_Cnt_u08 Rte_FaultLog_FaultLog.CTCFailData[36].Reserved2_Cnt_u08 Rte_FaultLog_FaultLog.CTCFailData[37].Byte1_Cnt_u08 Rte_FaultLog_FaultLog.CTCFailData[37].Byte2_Cnt_u08 Rte_FaultLog_FaultLog.CTCFailData[37].Byte3_Cnt_u08 Rte_FaultLog_FaultLog.CTCFailData[37].Byte4_Cnt_u08 Rte_FaultLog_FaultLog.CTCFailData[37].Byte5_Cnt_u08 Rte_FaultLog_FaultLog.CTCFailData[37].Byte6_Cnt_u08 Rte_FaultLog_FaultLog.CTCFailData[37].Reserved1_Cnt_u08 Rte_FaultLog_FaultLog.CTCFailData[37].Reserved2_Cnt_u08 Rte_FaultLog_FaultLog.CTCFailData[38].Byte1_Cnt_u08 Rte_FaultLog_FaultLog.CTCFailData[38].Byte2_Cnt_u08 Rte_FaultLog_FaultLog.CTCFailData[38].Byte3_Cnt_u08 Rte_FaultLog_FaultLog.CTCFailData[38].Byte4_Cnt_u08 Rte_FaultLog_FaultLog.CTCFailData[38].Byte5_Cnt_u08 Rte_FaultLog_FaultLog.CTCFailData[38].Byte6_Cnt_u08 Rte_FaultLog_FaultLog.CTCFailData[38].Reserved1_Cnt_u08 Rte_FaultLog_FaultLog.CTCFailData[38].Reserved2_Cnt_u08 Rte_FaultLog_FaultLog.CTCFailData[39].Byte1_Cnt_u08 Rte_FaultLog_FaultLog.CTCFailData[39].Byte2_Cnt_u08 Rte_FaultLog_FaultLog.CTCFailData[39].Byte3_Cnt_u08 Rte_FaultLog_FaultLog.CTCFailData[39].Byte4_Cnt_u08 Rte_FaultLog_FaultLog.CTCFailData[39].Byte5_Cnt_u08 Rte_FaultLog_FaultLog.CTCFailData[39].Byte6_Cnt_u08 Rte_FaultLog_FaultLog.CTCFailData[39].Reserved1_Cnt_u08 Rte_FaultLog_FaultLog.CTCFailData[39].Reserved2_Cnt_u08 Rte_FaultLog_FaultLog.CTCFailData[3].Byte1_Cnt_u08 Rte_FaultLog_FaultLog.CTCFailData[3].Byte2_Cnt_u08 Rte_FaultLog_FaultLog.CTCFailData[3].Byte3_Cnt_u08 Rte_FaultLog_FaultLog.CTCFailData[3].Byte4_Cnt_u08 Rte_FaultLog_FaultLog.CTCFailData[3].Byte5_Cnt_u08 Rte_FaultLog_FaultLog.CTCFailData[3].Byte6_Cnt_u08 Rte_FaultLog_FaultLog.CTCFailData[3].Reserved1_Cnt_u08 Rte_FaultLog_FaultLog.CTCFailData[3].Reserved2_Cnt_u08 Rte_FaultLog_FaultLog.CTCFailData[40].Byte1_Cnt_u08 Rte_FaultLog_FaultLog.CTCFailData[40].Byte2_Cnt_u08 Rte_FaultLog_FaultLog.CTCFailData[40].Byte3_Cnt_u08 Rte_FaultLog_FaultLog.CTCFailData[40].Byte4_Cnt_u08 Rte_FaultLog_FaultLog.CTCFailData[40].Byte5_Cnt_u08 Rte_FaultLog_FaultLog.CTCFailData[40].Byte6_Cnt_u08 Rte_FaultLog_FaultLog.CTCFailData[40].Reserved1_Cnt_u08 Rte_FaultLog_FaultLog.CTCFailData[40].Reserved2_Cnt_u08 Rte_FaultLog_FaultLog.CTCFailData[41].Byte1_Cnt_u08 Rte_FaultLog_FaultLog.CTCFailData[41].Byte2_Cnt_u08 Rte_FaultLog_FaultLog.CTCFailData[41].Byte3_Cnt_u08 Rte_FaultLog_FaultLog.CTCFailData[41].Byte4_Cnt_u08 Rte_FaultLog_FaultLog.CTCFailData[41].Byte5_Cnt_u08 Rte_FaultLog_FaultLog.CTCFailData[41].Byte6_Cnt_u08 Rte_FaultLog_FaultLog.CTCFailData[41].Reserved1_Cnt_u08 Rte_FaultLog_FaultLog.CTCFailData[41].Reserved2_Cnt_u08 Rte_FaultLog_FaultLog.CTCFailData[42].Byte1_Cnt_u08 Rte_FaultLog_FaultLog.CTCFailData[42].Byte2_Cnt_u08 Rte_FaultLog_FaultLog.CTCFailData[42].Byte3_Cnt_u08 Rte_FaultLog_FaultLog.CTCFailData[42].Byte4_Cnt_u08 Rte_FaultLog_FaultLog.CTCFailData[42].Byte5_Cnt_u08 Rte_FaultLog_FaultLog.CTCFailData[42].Byte6_Cnt_u08 Rte_FaultLog_FaultLog.CTCFailData[42].Reserved1_Cnt_u08 Rte_FaultLog_FaultLog.CTCFailData[42].Reserved2_Cnt_u08 Rte_FaultLog_FaultLog.CTCFailData[43].Byte1_Cnt_u08 Rte_FaultLog_FaultLog.CTCFailData[43].Byte2_Cnt_u08 Rte_FaultLog_FaultLog.CTCFailData[43].Byte3_Cnt_u08 Rte_FaultLog_FaultLog.CTCFailData[43].Byte4_Cnt_u08 Rte_FaultLog_FaultLog.CTCFailData[43].Byte5_Cnt_u08 Rte_FaultLog_FaultLog.CTCFailData[43].Byte6_Cnt_u08 Rte_FaultLog_FaultLog.CTCFailData[43].Reserved1_Cnt_u08 Rte_FaultLog_FaultLog.CTCFailData[43].Reserved2_Cnt_u08 Rte_FaultLog_FaultLog.CTCFailData[44].Byte1_Cnt_u08 Rte_FaultLog_FaultLog.CTCFailData[44].Byte2_Cnt_u08 Rte_FaultLog_FaultLog.CTCFailData[44].Byte3_Cnt_u08 Rte_FaultLog_FaultLog.CTCFailData[44].Byte4_Cnt_u08 Rte_FaultLog_FaultLog.CTCFailData[44].Byte5_Cnt_u08 Rte_FaultLog_FaultLog.CTCFailData[44].Byte6_Cnt_u08 Rte_FaultLog_FaultLog.CTCFailData[44].Reserved1_Cnt_u08 Rte_FaultLog_FaultLog.CTCFailData[44].Reserved2_Cnt_u08 Rte_FaultLog_FaultLog.CTCFailData[45].Byte1_Cnt_u08 Rte_FaultLog_FaultLog.CTCFailData[45].Byte2_Cnt_u08 Rte_FaultLog_FaultLog.CTCFailData[45].Byte3_Cnt_u08 Rte_FaultLog_FaultLog.CTCFailData[45].Byte4_Cnt_u08 Rte_FaultLog_FaultLog.CTCFailData[45].Byte5_Cnt_u08 Rte_FaultLog_FaultLog.CTCFailData[45].Byte6_Cnt_u08 Rte_FaultLog_FaultLog.CTCFailData[45].Reserved1_Cnt_u08 Rte_FaultLog_FaultLog.CTCFailData[45].Reserved2_Cnt_u08 Rte_FaultLog_FaultLog.CTCFailData[46].Byte1_Cnt_u08 Rte_FaultLog_FaultLog.CTCFailData[46].Byte2_Cnt_u08 Rte_FaultLog_FaultLog.CTCFailData[46].Byte3_Cnt_u08 Rte_FaultLog_FaultLog.CTCFailData[46].Byte4_Cnt_u08 Rte_FaultLog_FaultLog.CTCFailData[46].Byte5_Cnt_u08 Rte_FaultLog_FaultLog.CTCFailData[46].Byte6_Cnt_u08 Rte_FaultLog_FaultLog.CTCFailData[46].Reserved1_Cnt_u08 Rte_FaultLog_FaultLog.CTCFailData[46].Reserved2_Cnt_u08 Rte_FaultLog_FaultLog.CTCFailData[47].Byte1_Cnt_u08 Rte_FaultLog_FaultLog.CTCFailData[47].Byte2_Cnt_u08 Rte_FaultLog_FaultLog.CTCFailData[47].Byte3_Cnt_u08 Rte_FaultLog_FaultLog.CTCFailData[47].Byte4_Cnt_u08 Rte_FaultLog_FaultLog.CTCFailData[47].Byte5_Cnt_u08 Rte_FaultLog_FaultLog.CTCFailData[47].Byte6_Cnt_u08 Rte_FaultLog_FaultLog.CTCFailData[47].Reserved1_Cnt_u08 Rte_FaultLog_FaultLog.CTCFailData[47].Reserved2_Cnt_u08 Rte_FaultLog_FaultLog.CTCFailData[48].Byte1_Cnt_u08 Rte_FaultLog_FaultLog.CTCFailData[48].Byte2_Cnt_u08 Rte_FaultLog_FaultLog.CTCFailData[48].Byte3_Cnt_u08 Rte_FaultLog_FaultLog.CTCFailData[48].Byte4_Cnt_u08 Rte_FaultLog_FaultLog.CTCFailData[48].Byte5_Cnt_u08 Rte_FaultLog_FaultLog.CTCFailData[48].Byte6_Cnt_u08 Rte_FaultLog_FaultLog.CTCFailData[48].Reserved1_Cnt_u08 Rte_FaultLog_FaultLog.CTCFailData[48].Reserved2_Cnt_u08 Rte_FaultLog_FaultLog.CTCFailData[49].Byte1_Cnt_u08 Rte_FaultLog_FaultLog.CTCFailData[49].Byte2_Cnt_u08 Rte_FaultLog_FaultLog.CTCFailData[49].Byte3_Cnt_u08 Rte_FaultLog_FaultLog.CTCFailData[49].Byte4_Cnt_u08 Rte_FaultLog_FaultLog.CTCFailData[49].Byte5_Cnt_u08 Rte_FaultLog_FaultLog.CTCFailData[49].Byte6_Cnt_u08 Rte_FaultLog_FaultLog.CTCFailData[49].Reserved1_Cnt_u08 Rte_FaultLog_FaultLog.CTCFailData[49].Reserved2_Cnt_u08 Rte_FaultLog_FaultLog.CTCFailData[4].Byte1_Cnt_u08 Rte_FaultLog_FaultLog.CTCFailData[4].Byte2_Cnt_u08 Rte_FaultLog_FaultLog.CTCFailData[4].Byte3_Cnt_u08 Rte_FaultLog_FaultLog.CTCFailData[4].Byte4_Cnt_u08 Rte_FaultLog_FaultLog.CTCFailData[4].Byte5_Cnt_u08 Rte_FaultLog_FaultLog.CTCFailData[4].Byte6_Cnt_u08 Rte_FaultLog_FaultLog.CTCFailData[4].Reserved1_Cnt_u08 Rte_FaultLog_FaultLog.CTCFailData[4].Reserved2_Cnt_u08 Rte_FaultLog_FaultLog.CTCFailData[50].Byte1_Cnt_u08 Rte_FaultLog_FaultLog.CTCFailData[50].Byte2_Cnt_u08 Rte_FaultLog_FaultLog.CTCFailData[50].Byte3_Cnt_u08 Rte_FaultLog_FaultLog.CTCFailData[50].Byte4_Cnt_u08 Rte_FaultLog_FaultLog.CTCFailData[50].Byte5_Cnt_u08 Rte_FaultLog_FaultLog.CTCFailData[50].Byte6_Cnt_u08 Rte_FaultLog_FaultLog.CTCFailData[50].Reserved1_Cnt_u08 Rte_FaultLog_FaultLog.CTCFailData[50].Reserved2_Cnt_u08 Rte_FaultLog_FaultLog.CTCFailData[51].Byte1_Cnt_u08 Rte_FaultLog_FaultLog.CTCFailData[51].Byte2_Cnt_u08 Rte_FaultLog_FaultLog.CTCFailData[51].Byte3_Cnt_u08 Rte_FaultLog_FaultLog.CTCFailData[51].Byte4_Cnt_u08 Rte_FaultLog_FaultLog.CTCFailData[51].Byte5_Cnt_u08 Rte_FaultLog_FaultLog.CTCFailData[51].Byte6_Cnt_u08 Rte_FaultLog_FaultLog.CTCFailData[51].Reserved1_Cnt_u08 Rte_FaultLog_FaultLog.CTCFailData[51].Reserved2_Cnt_u08 Rte_FaultLog_FaultLog.CTCFailData[52].Byte1_Cnt_u08 Rte_FaultLog_FaultLog.CTCFailData[52].Byte2_Cnt_u08 Rte_FaultLog_FaultLog.CTCFailData[52].Byte3_Cnt_u08 Rte_FaultLog_FaultLog.CTCFailData[52].Byte4_Cnt_u08 Rte_FaultLog_FaultLog.CTCFailData[52].Byte5_Cnt_u08 Rte_FaultLog_FaultLog.CTCFailData[52].Byte6_Cnt_u08 Rte_FaultLog_FaultLog.CTCFailData[52].Reserved1_Cnt_u08 Rte_FaultLog_FaultLog.CTCFailData[52].Reserved2_Cnt_u08 Rte_FaultLog_FaultLog.CTCFailData[53].Byte1_Cnt_u08 Rte_FaultLog_FaultLog.CTCFailData[53].Byte2_Cnt_u08 Rte_FaultLog_FaultLog.CTCFailData[53].Byte3_Cnt_u08 Rte_FaultLog_FaultLog.CTCFailData[53].Byte4_Cnt_u08 Rte_FaultLog_FaultLog.CTCFailData[53].Byte5_Cnt_u08 Rte_FaultLog_FaultLog.CTCFailData[53].Byte6_Cnt_u08 Rte_FaultLog_FaultLog.CTCFailData[53].Reserved1_Cnt_u08 Rte_FaultLog_FaultLog.CTCFailData[53].Reserved2_Cnt_u08 Rte_FaultLog_FaultLog.CTCFailData[54].Byte1_Cnt_u08 Rte_FaultLog_FaultLog.CTCFailData[54].Byte2_Cnt_u08 Rte_FaultLog_FaultLog.CTCFailData[54].Byte3_Cnt_u08 Rte_FaultLog_FaultLog.CTCFailData[54].Byte4_Cnt_u08 Rte_FaultLog_FaultLog.CTCFailData[54].Byte5_Cnt_u08 Rte_FaultLog_FaultLog.CTCFailData[54].Byte6_Cnt_u08 Rte_FaultLog_FaultLog.CTCFailData[54].Reserved1_Cnt_u08 Rte_FaultLog_FaultLog.CTCFailData[54].Reserved2_Cnt_u08 Rte_FaultLog_FaultLog.CTCFailData[55].Byte1_Cnt_u08 Rte_FaultLog_FaultLog.CTCFailData[55].Byte2_Cnt_u08 Rte_FaultLog_FaultLog.CTCFailData[55].Byte3_Cnt_u08 Rte_FaultLog_FaultLog.CTCFailData[55].Byte4_Cnt_u08 Rte_FaultLog_FaultLog.CTCFailData[55].Byte5_Cnt_u08 Rte_FaultLog_FaultLog.CTCFailData[55].Byte6_Cnt_u08 Rte_FaultLog_FaultLog.CTCFailData[55].Reserved1_Cnt_u08 Rte_FaultLog_FaultLog.CTCFailData[55].Reserved2_Cnt_u08 Rte_FaultLog_FaultLog.CTCFailData[56].Byte1_Cnt_u08 Rte_FaultLog_FaultLog.CTCFailData[56].Byte2_Cnt_u08 Rte_FaultLog_FaultLog.CTCFailData[56].Byte3_Cnt_u08 Rte_FaultLog_FaultLog.CTCFailData[56].Byte4_Cnt_u08 Rte_FaultLog_FaultLog.CTCFailData[56].Byte5_Cnt_u08 Rte_FaultLog_FaultLog.CTCFailData[56].Byte6_Cnt_u08 Rte_FaultLog_FaultLog.CTCFailData[56].Reserved1_Cnt_u08 Rte_FaultLog_FaultLog.CTCFailData[56].Reserved2_Cnt_u08 Rte_FaultLog_FaultLog.CTCFailData[57].Byte1_Cnt_u08 Rte_FaultLog_FaultLog.CTCFailData[57].Byte2_Cnt_u08 Rte_FaultLog_FaultLog.CTCFailData[57].Byte3_Cnt_u08 Rte_FaultLog_FaultLog.CTCFailData[57].Byte4_Cnt_u08 Rte_FaultLog_FaultLog.CTCFailData[57].Byte5_Cnt_u08 Rte_FaultLog_FaultLog.CTCFailData[57].Byte6_Cnt_u08 Rte_FaultLog_FaultLog.CTCFailData[57].Reserved1_Cnt_u08 Rte_FaultLog_FaultLog.CTCFailData[57].Reserved2_Cnt_u08 Rte_FaultLog_FaultLog.CTCFailData[58].Byte1_Cnt_u08 Rte_FaultLog_FaultLog.CTCFailData[58].Byte2_Cnt_u08 Rte_FaultLog_FaultLog.CTCFailData[58].Byte3_Cnt_u08 Rte_FaultLog_FaultLog.CTCFailData[58].Byte4_Cnt_u08 Rte_FaultLog_FaultLog.CTCFailData[58].Byte5_Cnt_u08 Rte_FaultLog_FaultLog.CTCFailData[58].Byte6_Cnt_u08 Rte_FaultLog_FaultLog.CTCFailData[58].Reserved1_Cnt_u08 Rte_FaultLog_FaultLog.CTCFailData[58].Reserved2_Cnt_u08 Rte_FaultLog_FaultLog.CTCFailData[59].Byte1_Cnt_u08 Rte_FaultLog_FaultLog.CTCFailData[59].Byte2_Cnt_u08 Rte_FaultLog_FaultLog.CTCFailData[59].Byte3_Cnt_u08 Rte_FaultLog_FaultLog.CTCFailData[59].Byte4_Cnt_u08 Rte_FaultLog_FaultLog.CTCFailData[59].Byte5_Cnt_u08 Rte_FaultLog_FaultLog.CTCFailData[59].Byte6_Cnt_u08 Rte_FaultLog_FaultLog.CTCFailData[59].Reserved1_Cnt_u08 Rte_FaultLog_FaultLog.CTCFailData[59].Reserved2_Cnt_u08 Rte_FaultLog_FaultLog.CTCFailData[5].Byte1_Cnt_u08 Rte_FaultLog_FaultLog.CTCFailData[5].Byte2_Cnt_u08 Rte_FaultLog_FaultLog.CTCFailData[5].Byte3_Cnt_u08 Rte_FaultLog_FaultLog.CTCFailData[5].Byte4_Cnt_u08 Rte_FaultLog_FaultLog.CTCFailData[5].Byte5_Cnt_u08 Rte_FaultLog_FaultLog.CTCFailData[5].Byte6_Cnt_u08 Rte_FaultLog_FaultLog.CTCFailData[5].Reserved1_Cnt_u08 Rte_FaultLog_FaultLog.CTCFailData[5].Reserved2_Cnt_u08 Rte_FaultLog_FaultLog.CTCFailData[6].Byte1_Cnt_u08 Rte_FaultLog_FaultLog.CTCFailData[6].Byte2_Cnt_u08 Rte_FaultLog_FaultLog.CTCFailData[6].Byte3_Cnt_u08 Rte_FaultLog_FaultLog.CTCFailData[6].Byte4_Cnt_u08 Rte_FaultLog_FaultLog.CTCFailData[6].Byte5_Cnt_u08 Rte_FaultLog_FaultLog.CTCFailData[6].Byte6_Cnt_u08 Rte_FaultLog_FaultLog.CTCFailData[6].Reserved1_Cnt_u08 Rte_FaultLog_FaultLog.CTCFailData[6].Reserved2_Cnt_u08 Rte_FaultLog_FaultLog.CTCFailData[7].Byte1_Cnt_u08 Rte_FaultLog_FaultLog.CTCFailData[7].Byte2_Cnt_u08 Rte_FaultLog_FaultLog.CTCFailData[7].Byte3_Cnt_u08 Rte_FaultLog_FaultLog.CTCFailData[7].Byte4_Cnt_u08 Rte_FaultLog_FaultLog.CTCFailData[7].Byte5_Cnt_u08 Rte_FaultLog_FaultLog.CTCFailData[7].Byte6_Cnt_u08 Rte_FaultLog_FaultLog.CTCFailData[7].Reserved1_Cnt_u08 Rte_FaultLog_FaultLog.CTCFailData[7].Reserved2_Cnt_u08 Rte_FaultLog_FaultLog.CTCFailData[8].Byte1_Cnt_u08 Rte_FaultLog_FaultLog.CTCFailData[8].Byte2_Cnt_u08 Rte_FaultLog_FaultLog.CTCFailData[8].Byte3_Cnt_u08 Rte_FaultLog_FaultLog.CTCFailData[8].Byte4_Cnt_u08 Rte_FaultLog_FaultLog.CTCFailData[8].Byte5_Cnt_u08 Rte_FaultLog_FaultLog.CTCFailData[8].Byte6_Cnt_u08 Rte_FaultLog_FaultLog.CTCFailData[8].Reserved1_Cnt_u08 Rte_FaultLog_FaultLog.CTCFailData[8].Reserved2_Cnt_u08 Rte_FaultLog_FaultLog.CTCFailData[9].Byte1_Cnt_u08 Rte_FaultLog_FaultLog.CTCFailData[9].Byte2_Cnt_u08 Rte_FaultLog_FaultLog.CTCFailData[9].Byte3_Cnt_u08 Rte_FaultLog_FaultLog.CTCFailData[9].Byte4_Cnt_u08 Rte_FaultLog_FaultLog.CTCFailData[9].Byte5_Cnt_u08 Rte_FaultLog_FaultLog.CTCFailData[9].Byte6_Cnt_u08 Rte_FaultLog_FaultLog.CTCFailData[9].Reserved1_Cnt_u08 Rte_FaultLog_FaultLog.CTCFailData[9].Reserved2_Cnt_u08 Rte_FaultLog_FaultLog.CTCPassData[0].Byte1_Cnt_u08 Rte_FaultLog_FaultLog.CTCPassData[0].Byte2_Cnt_u08 Rte_FaultLog_FaultLog.CTCPassData[0].Byte3_Cnt_u08 Rte_FaultLog_FaultLog.CTCPassData[0].Byte4_Cnt_u08 Rte_FaultLog_FaultLog.CTCPassData[0].Byte5_Cnt_u08 Rte_FaultLog_FaultLog.CTCPassData[0].Byte6_Cnt_u08 Rte_FaultLog_FaultLog.CTCPassData[0].Reserved1_Cnt_u08 Rte_FaultLog_FaultLog.CTCPassData[0].Reserved2_Cnt_u08 Rte_FaultLog_FaultLog.CTCPassData[10].Byte1_Cnt_u08 Rte_FaultLog_FaultLog.CTCPassData[10].Byte2_Cnt_u08 Rte_FaultLog_FaultLog.CTCPassData[10].Byte3_Cnt_u08 Rte_FaultLog_FaultLog.CTCPassData[10].Byte4_Cnt_u08 Rte_FaultLog_FaultLog.CTCPassData[10].Byte5_Cnt_u08 Rte_FaultLog_FaultLog.CTCPassData[10].Byte6_Cnt_u08 Rte_FaultLog_FaultLog.CTCPassData[10].Reserved1_Cnt_u08 Rte_FaultLog_FaultLog.CTCPassData[10].Reserved2_Cnt_u08 Rte_FaultLog_FaultLog.CTCPassData[11].Byte1_Cnt_u08 Rte_FaultLog_FaultLog.CTCPassData[11].Byte2_Cnt_u08 Rte_FaultLog_FaultLog.CTCPassData[11].Byte3_Cnt_u08 Rte_FaultLog_FaultLog.CTCPassData[11].Byte4_Cnt_u08 Rte_FaultLog_FaultLog.CTCPassData[11].Byte5_Cnt_u08 Rte_FaultLog_FaultLog.CTCPassData[11].Byte6_Cnt_u08 Rte_FaultLog_FaultLog.CTCPassData[11].Reserved1_Cnt_u08 Rte_FaultLog_FaultLog.CTCPassData[11].Reserved2_Cnt_u08 Rte_FaultLog_FaultLog.CTCPassData[12].Byte1_Cnt_u08 Rte_FaultLog_FaultLog.CTCPassData[12].Byte2_Cnt_u08 Rte_FaultLog_FaultLog.CTCPassData[12].Byte3_Cnt_u08 Rte_FaultLog_FaultLog.CTCPassData[12].Byte4_Cnt_u08 Rte_FaultLog_FaultLog.CTCPassData[12].Byte5_Cnt_u08 Rte_FaultLog_FaultLog.CTCPassData[12].Byte6_Cnt_u08 Rte_FaultLog_FaultLog.CTCPassData[12].Reserved1_Cnt_u08 Rte_FaultLog_FaultLog.CTCPassData[12].Reserved2_Cnt_u08 Rte_FaultLog_FaultLog.CTCPassData[13].Byte1_Cnt_u08 Rte_FaultLog_FaultLog.CTCPassData[13].Byte2_Cnt_u08 Rte_FaultLog_FaultLog.CTCPassData[13].Byte3_Cnt_u08 Rte_FaultLog_FaultLog.CTCPassData[13].Byte4_Cnt_u08 Rte_FaultLog_FaultLog.CTCPassData[13].Byte5_Cnt_u08 Rte_FaultLog_FaultLog.CTCPassData[13].Byte6_Cnt_u08 Rte_FaultLog_FaultLog.CTCPassData[13].Reserved1_Cnt_u08 Rte_FaultLog_FaultLog.CTCPassData[13].Reserved2_Cnt_u08 Rte_FaultLog_FaultLog.CTCPassData[14].Byte1_Cnt_u08 Rte_FaultLog_FaultLog.CTCPassData[14].Byte2_Cnt_u08 Rte_FaultLog_FaultLog.CTCPassData[14].Byte3_Cnt_u08 Rte_FaultLog_FaultLog.CTCPassData[14].Byte4_Cnt_u08 Rte_FaultLog_FaultLog.CTCPassData[14].Byte5_Cnt_u08 Rte_FaultLog_FaultLog.CTCPassData[14].Byte6_Cnt_u08 Rte_FaultLog_FaultLog.CTCPassData[14].Reserved1_Cnt_u08 Rte_FaultLog_FaultLog.CTCPassData[14].Reserved2_Cnt_u08 Rte_FaultLog_FaultLog.CTCPassData[15].Byte1_Cnt_u08 Rte_FaultLog_FaultLog.CTCPassData[15].Byte2_Cnt_u08 Rte_FaultLog_FaultLog.CTCPassData[15].Byte3_Cnt_u08 Rte_FaultLog_FaultLog.CTCPassData[15].Byte4_Cnt_u08 Rte_FaultLog_FaultLog.CTCPassData[15].Byte5_Cnt_u08 Rte_FaultLog_FaultLog.CTCPassData[15].Byte6_Cnt_u08 Rte_FaultLog_FaultLog.CTCPassData[15].Reserved1_Cnt_u08 Rte_FaultLog_FaultLog.CTCPassData[15].Reserved2_Cnt_u08 Rte_FaultLog_FaultLog.CTCPassData[16].Byte1_Cnt_u08 Rte_FaultLog_FaultLog.CTCPassData[16].Byte2_Cnt_u08 Rte_FaultLog_FaultLog.CTCPassData[16].Byte3_Cnt_u08 Rte_FaultLog_FaultLog.CTCPassData[16].Byte4_Cnt_u08 Rte_FaultLog_FaultLog.CTCPassData[16].Byte5_Cnt_u08 Rte_FaultLog_FaultLog.CTCPassData[16].Byte6_Cnt_u08 Rte_FaultLog_FaultLog.CTCPassData[16].Reserved1_Cnt_u08 Rte_FaultLog_FaultLog.CTCPassData[16].Reserved2_Cnt_u08 Rte_FaultLog_FaultLog.CTCPassData[17].Byte1_Cnt_u08 Rte_FaultLog_FaultLog.CTCPassData[17].Byte2_Cnt_u08 Rte_FaultLog_FaultLog.CTCPassData[17].Byte3_Cnt_u08 Rte_FaultLog_FaultLog.CTCPassData[17].Byte4_Cnt_u08 Rte_FaultLog_FaultLog.CTCPassData[17].Byte5_Cnt_u08 Rte_FaultLog_FaultLog.CTCPassData[17].Byte6_Cnt_u08 Rte_FaultLog_FaultLog.CTCPassData[17].Reserved1_Cnt_u08 Rte_FaultLog_FaultLog.CTCPassData[17].Reserved2_Cnt_u08 Rte_FaultLog_FaultLog.CTCPassData[18].Byte1_Cnt_u08 Rte_FaultLog_FaultLog.CTCPassData[18].Byte2_Cnt_u08 Rte_FaultLog_FaultLog.CTCPassData[18].Byte3_Cnt_u08 Rte_FaultLog_FaultLog.CTCPassData[18].Byte4_Cnt_u08 Rte_FaultLog_FaultLog.CTCPassData[18].Byte5_Cnt_u08 Rte_FaultLog_FaultLog.CTCPassData[18].Byte6_Cnt_u08 Rte_FaultLog_FaultLog.CTCPassData[18].Reserved1_Cnt_u08 Rte_FaultLog_FaultLog.CTCPassData[18].Reserved2_Cnt_u08 Rte_FaultLog_FaultLog.CTCPassData[19].Byte1_Cnt_u08 Rte_FaultLog_FaultLog.CTCPassData[19].Byte2_Cnt_u08 Rte_FaultLog_FaultLog.CTCPassData[19].Byte3_Cnt_u08 Rte_FaultLog_FaultLog.CTCPassData[19].Byte4_Cnt_u08 Rte_FaultLog_FaultLog.CTCPassData[19].Byte5_Cnt_u08 Rte_FaultLog_FaultLog.CTCPassData[19].Byte6_Cnt_u08 Rte_FaultLog_FaultLog.CTCPassData[19].Reserved1_Cnt_u08 Rte_FaultLog_FaultLog.CTCPassData[19].Reserved2_Cnt_u08 Rte_FaultLog_FaultLog.CTCPassData[1].Byte1_Cnt_u08 Rte_FaultLog_FaultLog.CTCPassData[1].Byte2_Cnt_u08 Rte_FaultLog_FaultLog.CTCPassData[1].Byte3_Cnt_u08 Rte_FaultLog_FaultLog.CTCPassData[1].Byte4_Cnt_u08 Rte_FaultLog_FaultLog.CTCPassData[1].Byte5_Cnt_u08 Rte_FaultLog_FaultLog.CTCPassData[1].Byte6_Cnt_u08 Rte_FaultLog_FaultLog.CTCPassData[1].Reserved1_Cnt_u08 Rte_FaultLog_FaultLog.CTCPassData[1].Reserved2_Cnt_u08 Rte_FaultLog_FaultLog.CTCPassData[20].Byte1_Cnt_u08 Rte_FaultLog_FaultLog.CTCPassData[20].Byte2_Cnt_u08 Rte_FaultLog_FaultLog.CTCPassData[20].Byte3_Cnt_u08 Rte_FaultLog_FaultLog.CTCPassData[20].Byte4_Cnt_u08 Rte_FaultLog_FaultLog.CTCPassData[20].Byte5_Cnt_u08 Rte_FaultLog_FaultLog.CTCPassData[20].Byte6_Cnt_u08 Rte_FaultLog_FaultLog.CTCPassData[20].Reserved1_Cnt_u08 Rte_FaultLog_FaultLog.CTCPassData[20].Reserved2_Cnt_u08 Rte_FaultLog_FaultLog.CTCPassData[21].Byte1_Cnt_u08 Rte_FaultLog_FaultLog.CTCPassData[21].Byte2_Cnt_u08 Rte_FaultLog_FaultLog.CTCPassData[21].Byte3_Cnt_u08 Rte_FaultLog_FaultLog.CTCPassData[21].Byte4_Cnt_u08 Rte_FaultLog_FaultLog.CTCPassData[21].Byte5_Cnt_u08 Rte_FaultLog_FaultLog.CTCPassData[21].Byte6_Cnt_u08 Rte_FaultLog_FaultLog.CTCPassData[21].Reserved1_Cnt_u08 Rte_FaultLog_FaultLog.CTCPassData[21].Reserved2_Cnt_u08 Rte_FaultLog_FaultLog.CTCPassData[22].Byte1_Cnt_u08 Rte_FaultLog_FaultLog.CTCPassData[22].Byte2_Cnt_u08 Rte_FaultLog_FaultLog.CTCPassData[22].Byte3_Cnt_u08 Rte_FaultLog_FaultLog.CTCPassData[22].Byte4_Cnt_u08 Rte_FaultLog_FaultLog.CTCPassData[22].Byte5_Cnt_u08 Rte_FaultLog_FaultLog.CTCPassData[22].Byte6_Cnt_u08 Rte_FaultLog_FaultLog.CTCPassData[22].Reserved1_Cnt_u08 Rte_FaultLog_FaultLog.CTCPassData[22].Reserved2_Cnt_u08 Rte_FaultLog_FaultLog.CTCPassData[23].Byte1_Cnt_u08 Rte_FaultLog_FaultLog.CTCPassData[23].Byte2_Cnt_u08 Rte_FaultLog_FaultLog.CTCPassData[23].Byte3_Cnt_u08 Rte_FaultLog_FaultLog.CTCPassData[23].Byte4_Cnt_u08 Rte_FaultLog_FaultLog.CTCPassData[23].Byte5_Cnt_u08 Rte_FaultLog_FaultLog.CTCPassData[23].Byte6_Cnt_u08 Rte_FaultLog_FaultLog.CTCPassData[23].Reserved1_Cnt_u08 Rte_FaultLog_FaultLog.CTCPassData[23].Reserved2_Cnt_u08 Rte_FaultLog_FaultLog.CTCPassData[24].Byte1_Cnt_u08 Rte_FaultLog_FaultLog.CTCPassData[24].Byte2_Cnt_u08 Rte_FaultLog_FaultLog.CTCPassData[24].Byte3_Cnt_u08 Rte_FaultLog_FaultLog.CTCPassData[24].Byte4_Cnt_u08 Rte_FaultLog_FaultLog.CTCPassData[24].Byte5_Cnt_u08 Rte_FaultLog_FaultLog.CTCPassData[24].Byte6_Cnt_u08 Rte_FaultLog_FaultLog.CTCPassData[24].Reserved1_Cnt_u08 Rte_FaultLog_FaultLog.CTCPassData[24].Reserved2_Cnt_u08 Rte_FaultLog_FaultLog.CTCPassData[25].Byte1_Cnt_u08 Rte_FaultLog_FaultLog.CTCPassData[25].Byte2_Cnt_u08 Rte_FaultLog_FaultLog.CTCPassData[25].Byte3_Cnt_u08 Rte_FaultLog_FaultLog.CTCPassData[25].Byte4_Cnt_u08 Rte_FaultLog_FaultLog.CTCPassData[25].Byte5_Cnt_u08 Rte_FaultLog_FaultLog.CTCPassData[25].Byte6_Cnt_u08 Rte_FaultLog_FaultLog.CTCPassData[25].Reserved1_Cnt_u08 Rte_FaultLog_FaultLog.CTCPassData[25].Reserved2_Cnt_u08 Rte_FaultLog_FaultLog.CTCPassData[26].Byte1_Cnt_u08 Rte_FaultLog_FaultLog.CTCPassData[26].Byte2_Cnt_u08 Rte_FaultLog_FaultLog.CTCPassData[26].Byte3_Cnt_u08 Rte_FaultLog_FaultLog.CTCPassData[26].Byte4_Cnt_u08 Rte_FaultLog_FaultLog.CTCPassData[26].Byte5_Cnt_u08 Rte_FaultLog_FaultLog.CTCPassData[26].Byte6_Cnt_u08 Rte_FaultLog_FaultLog.CTCPassData[26].Reserved1_Cnt_u08 Rte_FaultLog_FaultLog.CTCPassData[26].Reserved2_Cnt_u08 Rte_FaultLog_FaultLog.CTCPassData[27].Byte1_Cnt_u08 Rte_FaultLog_FaultLog.CTCPassData[27].Byte2_Cnt_u08 Rte_FaultLog_FaultLog.CTCPassData[27].Byte3_Cnt_u08 Rte_FaultLog_FaultLog.CTCPassData[27].Byte4_Cnt_u08 Rte_FaultLog_FaultLog.CTCPassData[27].Byte5_Cnt_u08 Rte_FaultLog_FaultLog.CTCPassData[27].Byte6_Cnt_u08 Rte_FaultLog_FaultLog.CTCPassData[27].Reserved1_Cnt_u08 Rte_FaultLog_FaultLog.CTCPassData[27].Reserved2_Cnt_u08 Rte_FaultLog_FaultLog.CTCPassData[28].Byte1_Cnt_u08 Rte_FaultLog_FaultLog.CTCPassData[28].Byte2_Cnt_u08 Rte_FaultLog_FaultLog.CTCPassData[28].Byte3_Cnt_u08 Rte_FaultLog_FaultLog.CTCPassData[28].Byte4_Cnt_u08 Rte_FaultLog_FaultLog.CTCPassData[28].Byte5_Cnt_u08 Rte_FaultLog_FaultLog.CTCPassData[28].Byte6_Cnt_u08 Rte_FaultLog_FaultLog.CTCPassData[28].Reserved1_Cnt_u08 Rte_FaultLog_FaultLog.CTCPassData[28].Reserved2_Cnt_u08 Rte_FaultLog_FaultLog.CTCPassData[29].Byte1_Cnt_u08 Rte_FaultLog_FaultLog.CTCPassData[29].Byte2_Cnt_u08 Rte_FaultLog_FaultLog.CTCPassData[29].Byte3_Cnt_u08 Rte_FaultLog_FaultLog.CTCPassData[29].Byte4_Cnt_u08 Rte_FaultLog_FaultLog.CTCPassData[29].Byte5_Cnt_u08 Rte_FaultLog_FaultLog.CTCPassData[29].Byte6_Cnt_u08 Rte_FaultLog_FaultLog.CTCPassData[29].Reserved1_Cnt_u08 Rte_FaultLog_FaultLog.CTCPassData[29].Reserved2_Cnt_u08 Rte_FaultLog_FaultLog.CTCPassData[2].Byte1_Cnt_u08 Rte_FaultLog_FaultLog.CTCPassData[2].Byte2_Cnt_u08 Rte_FaultLog_FaultLog.CTCPassData[2].Byte3_Cnt_u08 Rte_FaultLog_FaultLog.CTCPassData[2].Byte4_Cnt_u08 Rte_FaultLog_FaultLog.CTCPassData[2].Byte5_Cnt_u08 Rte_FaultLog_FaultLog.CTCPassData[2].Byte6_Cnt_u08 Rte_FaultLog_FaultLog.CTCPassData[2].Reserved1_Cnt_u08 Rte_FaultLog_FaultLog.CTCPassData[2].Reserved2_Cnt_u08 Rte_FaultLog_FaultLog.CTCPassData[30].Byte1_Cnt_u08 Rte_FaultLog_FaultLog.CTCPassData[30].Byte2_Cnt_u08 Rte_FaultLog_FaultLog.CTCPassData[30].Byte3_Cnt_u08 Rte_FaultLog_FaultLog.CTCPassData[30].Byte4_Cnt_u08 Rte_FaultLog_FaultLog.CTCPassData[30].Byte5_Cnt_u08 Rte_FaultLog_FaultLog.CTCPassData[30].Byte6_Cnt_u08 Rte_FaultLog_FaultLog.CTCPassData[30].Reserved1_Cnt_u08 Rte_FaultLog_FaultLog.CTCPassData[30].Reserved2_Cnt_u08 Rte_FaultLog_FaultLog.CTCPassData[31].Byte1_Cnt_u08 Rte_FaultLog_FaultLog.CTCPassData[31].Byte2_Cnt_u08 Rte_FaultLog_FaultLog.CTCPassData[31].Byte3_Cnt_u08 Rte_FaultLog_FaultLog.CTCPassData[31].Byte4_Cnt_u08 Rte_FaultLog_FaultLog.CTCPassData[31].Byte5_Cnt_u08 Rte_FaultLog_FaultLog.CTCPassData[31].Byte6_Cnt_u08 Rte_FaultLog_FaultLog.CTCPassData[31].Reserved1_Cnt_u08 Rte_FaultLog_FaultLog.CTCPassData[31].Reserved2_Cnt_u08 Rte_FaultLog_FaultLog.CTCPassData[32].Byte1_Cnt_u08 Rte_FaultLog_FaultLog.CTCPassData[32].Byte2_Cnt_u08 Rte_FaultLog_FaultLog.CTCPassData[32].Byte3_Cnt_u08 Rte_FaultLog_FaultLog.CTCPassData[32].Byte4_Cnt_u08 Rte_FaultLog_FaultLog.CTCPassData[32].Byte5_Cnt_u08 Rte_FaultLog_FaultLog.CTCPassData[32].Byte6_Cnt_u08 Rte_FaultLog_FaultLog.CTCPassData[32].Reserved1_Cnt_u08 Rte_FaultLog_FaultLog.CTCPassData[32].Reserved2_Cnt_u08 Rte_FaultLog_FaultLog.CTCPassData[33].Byte1_Cnt_u08 Rte_FaultLog_FaultLog.CTCPassData[33].Byte2_Cnt_u08 Rte_FaultLog_FaultLog.CTCPassData[33].Byte3_Cnt_u08 Rte_FaultLog_FaultLog.CTCPassData[33].Byte4_Cnt_u08 Rte_FaultLog_FaultLog.CTCPassData[33].Byte5_Cnt_u08 Rte_FaultLog_FaultLog.CTCPassData[33].Byte6_Cnt_u08 Rte_FaultLog_FaultLog.CTCPassData[33].Reserved1_Cnt_u08 Rte_FaultLog_FaultLog.CTCPassData[33].Reserved2_Cnt_u08 Rte_FaultLog_FaultLog.CTCPassData[34].Byte1_Cnt_u08 Rte_FaultLog_FaultLog.CTCPassData[34].Byte2_Cnt_u08 Rte_FaultLog_FaultLog.CTCPassData[34].Byte3_Cnt_u08 Rte_FaultLog_FaultLog.CTCPassData[34].Byte4_Cnt_u08 Rte_FaultLog_FaultLog.CTCPassData[34].Byte5_Cnt_u08 Rte_FaultLog_FaultLog.CTCPassData[34].Byte6_Cnt_u08 Rte_FaultLog_FaultLog.CTCPassData[34].Reserved1_Cnt_u08 Rte_FaultLog_FaultLog.CTCPassData[34].Reserved2_Cnt_u08 Rte_FaultLog_FaultLog.CTCPassData[35].Byte1_Cnt_u08 Rte_FaultLog_FaultLog.CTCPassData[35].Byte2_Cnt_u08 Rte_FaultLog_FaultLog.CTCPassData[35].Byte3_Cnt_u08 Rte_FaultLog_FaultLog.CTCPassData[35].Byte4_Cnt_u08 Rte_FaultLog_FaultLog.CTCPassData[35].Byte5_Cnt_u08 Rte_FaultLog_FaultLog.CTCPassData[35].Byte6_Cnt_u08 Rte_FaultLog_FaultLog.CTCPassData[35].Reserved1_Cnt_u08 Rte_FaultLog_FaultLog.CTCPassData[35].Reserved2_Cnt_u08 Rte_FaultLog_FaultLog.CTCPassData[36].Byte1_Cnt_u08 Rte_FaultLog_FaultLog.CTCPassData[36].Byte2_Cnt_u08 Rte_FaultLog_FaultLog.CTCPassData[36].Byte3_Cnt_u08 Rte_FaultLog_FaultLog.CTCPassData[36].Byte4_Cnt_u08 Rte_FaultLog_FaultLog.CTCPassData[36].Byte5_Cnt_u08 Rte_FaultLog_FaultLog.CTCPassData[36].Byte6_Cnt_u08 Rte_FaultLog_FaultLog.CTCPassData[36].Reserved1_Cnt_u08 Rte_FaultLog_FaultLog.CTCPassData[36].Reserved2_Cnt_u08 Rte_FaultLog_FaultLog.CTCPassData[37].Byte1_Cnt_u08 Rte_FaultLog_FaultLog.CTCPassData[37].Byte2_Cnt_u08 Rte_FaultLog_FaultLog.CTCPassData[37].Byte3_Cnt_u08 Rte_FaultLog_FaultLog.CTCPassData[37].Byte4_Cnt_u08 Rte_FaultLog_FaultLog.CTCPassData[37].Byte5_Cnt_u08 Rte_FaultLog_FaultLog.CTCPassData[37].Byte6_Cnt_u08 Rte_FaultLog_FaultLog.CTCPassData[37].Reserved1_Cnt_u08 Rte_FaultLog_FaultLog.CTCPassData[37].Reserved2_Cnt_u08 Rte_FaultLog_FaultLog.CTCPassData[38].Byte1_Cnt_u08 Rte_FaultLog_FaultLog.CTCPassData[38].Byte2_Cnt_u08 Rte_FaultLog_FaultLog.CTCPassData[38].Byte3_Cnt_u08 Rte_FaultLog_FaultLog.CTCPassData[38].Byte4_Cnt_u08 Rte_FaultLog_FaultLog.CTCPassData[38].Byte5_Cnt_u08 Rte_FaultLog_FaultLog.CTCPassData[38].Byte6_Cnt_u08 Rte_FaultLog_FaultLog.CTCPassData[38].Reserved1_Cnt_u08 Rte_FaultLog_FaultLog.CTCPassData[38].Reserved2_Cnt_u08 Rte_FaultLog_FaultLog.CTCPassData[39].Byte1_Cnt_u08 Rte_FaultLog_FaultLog.CTCPassData[39].Byte2_Cnt_u08 Rte_FaultLog_FaultLog.CTCPassData[39].Byte3_Cnt_u08 Rte_FaultLog_FaultLog.CTCPassData[39].Byte4_Cnt_u08 Rte_FaultLog_FaultLog.CTCPassData[39].Byte5_Cnt_u08 Rte_FaultLog_FaultLog.CTCPassData[39].Byte6_Cnt_u08 Rte_FaultLog_FaultLog.CTCPassData[39].Reserved1_Cnt_u08 Rte_FaultLog_FaultLog.CTCPassData[39].Reserved2_Cnt_u08 Rte_FaultLog_FaultLog.CTCPassData[3].Byte1_Cnt_u08 Rte_FaultLog_FaultLog.CTCPassData[3].Byte2_Cnt_u08 Rte_FaultLog_FaultLog.CTCPassData[3].Byte3_Cnt_u08 Rte_FaultLog_FaultLog.CTCPassData[3].Byte4_Cnt_u08 Rte_FaultLog_FaultLog.CTCPassData[3].Byte5_Cnt_u08 Rte_FaultLog_FaultLog.CTCPassData[3].Byte6_Cnt_u08 Rte_FaultLog_FaultLog.CTCPassData[3].Reserved1_Cnt_u08 Rte_FaultLog_FaultLog.CTCPassData[3].Reserved2_Cnt_u08 Rte_FaultLog_FaultLog.CTCPassData[40].Byte1_Cnt_u08 Rte_FaultLog_FaultLog.CTCPassData[40].Byte2_Cnt_u08 Rte_FaultLog_FaultLog.CTCPassData[40].Byte3_Cnt_u08 Rte_FaultLog_FaultLog.CTCPassData[40].Byte4_Cnt_u08 Rte_FaultLog_FaultLog.CTCPassData[40].Byte5_Cnt_u08 Rte_FaultLog_FaultLog.CTCPassData[40].Byte6_Cnt_u08 Rte_FaultLog_FaultLog.CTCPassData[40].Reserved1_Cnt_u08 Rte_FaultLog_FaultLog.CTCPassData[40].Reserved2_Cnt_u08 Rte_FaultLog_FaultLog.CTCPassData[41].Byte1_Cnt_u08 Rte_FaultLog_FaultLog.CTCPassData[41].Byte2_Cnt_u08 Rte_FaultLog_FaultLog.CTCPassData[41].Byte3_Cnt_u08 Rte_FaultLog_FaultLog.CTCPassData[41].Byte4_Cnt_u08 Rte_FaultLog_FaultLog.CTCPassData[41].Byte5_Cnt_u08 Rte_FaultLog_FaultLog.CTCPassData[41].Byte6_Cnt_u08 Rte_FaultLog_FaultLog.CTCPassData[41].Reserved1_Cnt_u08 Rte_FaultLog_FaultLog.CTCPassData[41].Reserved2_Cnt_u08 Rte_FaultLog_FaultLog.CTCPassData[42].Byte1_Cnt_u08 Rte_FaultLog_FaultLog.CTCPassData[42].Byte2_Cnt_u08 Rte_FaultLog_FaultLog.CTCPassData[42].Byte3_Cnt_u08 Rte_FaultLog_FaultLog.CTCPassData[42].Byte4_Cnt_u08 Rte_FaultLog_FaultLog.CTCPassData[42].Byte5_Cnt_u08 Rte_FaultLog_FaultLog.CTCPassData[42].Byte6_Cnt_u08 Rte_FaultLog_FaultLog.CTCPassData[42].Reserved1_Cnt_u08 Rte_FaultLog_FaultLog.CTCPassData[42].Reserved2_Cnt_u08 Rte_FaultLog_FaultLog.CTCPassData[43].Byte1_Cnt_u08 Rte_FaultLog_FaultLog.CTCPassData[43].Byte2_Cnt_u08 Rte_FaultLog_FaultLog.CTCPassData[43].Byte3_Cnt_u08 Rte_FaultLog_FaultLog.CTCPassData[43].Byte4_Cnt_u08 Rte_FaultLog_FaultLog.CTCPassData[43].Byte5_Cnt_u08 Rte_FaultLog_FaultLog.CTCPassData[43].Byte6_Cnt_u08 Rte_FaultLog_FaultLog.CTCPassData[43].Reserved1_Cnt_u08 Rte_FaultLog_FaultLog.CTCPassData[43].Reserved2_Cnt_u08 Rte_FaultLog_FaultLog.CTCPassData[44].Byte1_Cnt_u08 Rte_FaultLog_FaultLog.CTCPassData[44].Byte2_Cnt_u08 Rte_FaultLog_FaultLog.CTCPassData[44].Byte3_Cnt_u08 Rte_FaultLog_FaultLog.CTCPassData[44].Byte4_Cnt_u08 Rte_FaultLog_FaultLog.CTCPassData[44].Byte5_Cnt_u08 Rte_FaultLog_FaultLog.CTCPassData[44].Byte6_Cnt_u08 Rte_FaultLog_FaultLog.CTCPassData[44].Reserved1_Cnt_u08 Rte_FaultLog_FaultLog.CTCPassData[44].Reserved2_Cnt_u08 Rte_FaultLog_FaultLog.CTCPassData[45].Byte1_Cnt_u08 Rte_FaultLog_FaultLog.CTCPassData[45].Byte2_Cnt_u08 Rte_FaultLog_FaultLog.CTCPassData[45].Byte3_Cnt_u08 Rte_FaultLog_FaultLog.CTCPassData[45].Byte4_Cnt_u08 Rte_FaultLog_FaultLog.CTCPassData[45].Byte5_Cnt_u08 Rte_FaultLog_FaultLog.CTCPassData[45].Byte6_Cnt_u08 Rte_FaultLog_FaultLog.CTCPassData[45].Reserved1_Cnt_u08 Rte_FaultLog_FaultLog.CTCPassData[45].Reserved2_Cnt_u08 Rte_FaultLog_FaultLog.CTCPassData[46].Byte1_Cnt_u08 Rte_FaultLog_FaultLog.CTCPassData[46].Byte2_Cnt_u08 Rte_FaultLog_FaultLog.CTCPassData[46].Byte3_Cnt_u08 Rte_FaultLog_FaultLog.CTCPassData[46].Byte4_Cnt_u08 Rte_FaultLog_FaultLog.CTCPassData[46].Byte5_Cnt_u08 Rte_FaultLog_FaultLog.CTCPassData[46].Byte6_Cnt_u08 Rte_FaultLog_FaultLog.CTCPassData[46].Reserved1_Cnt_u08 Rte_FaultLog_FaultLog.CTCPassData[46].Reserved2_Cnt_u08 Rte_FaultLog_FaultLog.CTCPassData[47].Byte1_Cnt_u08 Rte_FaultLog_FaultLog.CTCPassData[47].Byte2_Cnt_u08 Rte_FaultLog_FaultLog.CTCPassData[47].Byte3_Cnt_u08 Rte_FaultLog_FaultLog.CTCPassData[47].Byte4_Cnt_u08 Rte_FaultLog_FaultLog.CTCPassData[47].Byte5_Cnt_u08 Rte_FaultLog_FaultLog.CTCPassData[47].Byte6_Cnt_u08 Rte_FaultLog_FaultLog.CTCPassData[47].Reserved1_Cnt_u08 Rte_FaultLog_FaultLog.CTCPassData[47].Reserved2_Cnt_u08 Rte_FaultLog_FaultLog.CTCPassData[48].Byte1_Cnt_u08 Rte_FaultLog_FaultLog.CTCPassData[48].Byte2_Cnt_u08 Rte_FaultLog_FaultLog.CTCPassData[48].Byte3_Cnt_u08 Rte_FaultLog_FaultLog.CTCPassData[48].Byte4_Cnt_u08 Rte_FaultLog_FaultLog.CTCPassData[48].Byte5_Cnt_u08 Rte_FaultLog_FaultLog.CTCPassData[48].Byte6_Cnt_u08 Rte_FaultLog_FaultLog.CTCPassData[48].Reserved1_Cnt_u08 Rte_FaultLog_FaultLog.CTCPassData[48].Reserved2_Cnt_u08 Rte_FaultLog_FaultLog.CTCPassData[49].Byte1_Cnt_u08 Rte_FaultLog_FaultLog.CTCPassData[49].Byte2_Cnt_u08 Rte_FaultLog_FaultLog.CTCPassData[49].Byte3_Cnt_u08 Rte_FaultLog_FaultLog.CTCPassData[49].Byte4_Cnt_u08 Rte_FaultLog_FaultLog.CTCPassData[49].Byte5_Cnt_u08 Rte_FaultLog_FaultLog.CTCPassData[49].Byte6_Cnt_u08 Rte_FaultLog_FaultLog.CTCPassData[49].Reserved1_Cnt_u08 Rte_FaultLog_FaultLog.CTCPassData[49].Reserved2_Cnt_u08 Rte_FaultLog_FaultLog.CTCPassData[4].Byte1_Cnt_u08 Rte_FaultLog_FaultLog.CTCPassData[4].Byte2_Cnt_u08 Rte_FaultLog_FaultLog.CTCPassData[4].Byte3_Cnt_u08 Rte_FaultLog_FaultLog.CTCPassData[4].Byte4_Cnt_u08 Rte_FaultLog_FaultLog.CTCPassData[4].Byte5_Cnt_u08 Rte_FaultLog_FaultLog.CTCPassData[4].Byte6_Cnt_u08 Rte_FaultLog_FaultLog.CTCPassData[4].Reserved1_Cnt_u08 Rte_FaultLog_FaultLog.CTCPassData[4].Reserved2_Cnt_u08 Rte_FaultLog_FaultLog.CTCPassData[50].Byte1_Cnt_u08 Rte_FaultLog_FaultLog.CTCPassData[50].Byte2_Cnt_u08 Rte_FaultLog_FaultLog.CTCPassData[50].Byte3_Cnt_u08 Rte_FaultLog_FaultLog.CTCPassData[50].Byte4_Cnt_u08 Rte_FaultLog_FaultLog.CTCPassData[50].Byte5_Cnt_u08 Rte_FaultLog_FaultLog.CTCPassData[50].Byte6_Cnt_u08 Rte_FaultLog_FaultLog.CTCPassData[50].Reserved1_Cnt_u08 Rte_FaultLog_FaultLog.CTCPassData[50].Reserved2_Cnt_u08 Rte_FaultLog_FaultLog.CTCPassData[51].Byte1_Cnt_u08 Rte_FaultLog_FaultLog.CTCPassData[51].Byte2_Cnt_u08 Rte_FaultLog_FaultLog.CTCPassData[51].Byte3_Cnt_u08 Rte_FaultLog_FaultLog.CTCPassData[51].Byte4_Cnt_u08 Rte_FaultLog_FaultLog.CTCPassData[51].Byte5_Cnt_u08 Rte_FaultLog_FaultLog.CTCPassData[51].Byte6_Cnt_u08 Rte_FaultLog_FaultLog.CTCPassData[51].Reserved1_Cnt_u08 Rte_FaultLog_FaultLog.CTCPassData[51].Reserved2_Cnt_u08 Rte_FaultLog_FaultLog.CTCPassData[52].Byte1_Cnt_u08 Rte_FaultLog_FaultLog.CTCPassData[52].Byte2_Cnt_u08 Rte_FaultLog_FaultLog.CTCPassData[52].Byte3_Cnt_u08 Rte_FaultLog_FaultLog.CTCPassData[52].Byte4_Cnt_u08 Rte_FaultLog_FaultLog.CTCPassData[52].Byte5_Cnt_u08 Rte_FaultLog_FaultLog.CTCPassData[52].Byte6_Cnt_u08 Rte_FaultLog_FaultLog.CTCPassData[52].Reserved1_Cnt_u08 Rte_FaultLog_FaultLog.CTCPassData[52].Reserved2_Cnt_u08 Rte_FaultLog_FaultLog.CTCPassData[53].Byte1_Cnt_u08 Rte_FaultLog_FaultLog.CTCPassData[53].Byte2_Cnt_u08 Rte_FaultLog_FaultLog.CTCPassData[53].Byte3_Cnt_u08 Rte_FaultLog_FaultLog.CTCPassData[53].Byte4_Cnt_u08 Rte_FaultLog_FaultLog.CTCPassData[53].Byte5_Cnt_u08 Rte_FaultLog_FaultLog.CTCPassData[53].Byte6_Cnt_u08 Rte_FaultLog_FaultLog.CTCPassData[53].Reserved1_Cnt_u08 Rte_FaultLog_FaultLog.CTCPassData[53].Reserved2_Cnt_u08 Rte_FaultLog_FaultLog.CTCPassData[54].Byte1_Cnt_u08 Rte_FaultLog_FaultLog.CTCPassData[54].Byte2_Cnt_u08 Rte_FaultLog_FaultLog.CTCPassData[54].Byte3_Cnt_u08 Rte_FaultLog_FaultLog.CTCPassData[54].Byte4_Cnt_u08 Rte_FaultLog_FaultLog.CTCPassData[54].Byte5_Cnt_u08 Rte_FaultLog_FaultLog.CTCPassData[54].Byte6_Cnt_u08 Rte_FaultLog_FaultLog.CTCPassData[54].Reserved1_Cnt_u08 Rte_FaultLog_FaultLog.CTCPassData[54].Reserved2_Cnt_u08 Rte_FaultLog_FaultLog.CTCPassData[55].Byte1_Cnt_u08 Rte_FaultLog_FaultLog.CTCPassData[55].Byte2_Cnt_u08 Rte_FaultLog_FaultLog.CTCPassData[55].Byte3_Cnt_u08 Rte_FaultLog_FaultLog.CTCPassData[55].Byte4_Cnt_u08 Rte_FaultLog_FaultLog.CTCPassData[55].Byte5_Cnt_u08 Rte_FaultLog_FaultLog.CTCPassData[55].Byte6_Cnt_u08 Rte_FaultLog_FaultLog.CTCPassData[55].Reserved1_Cnt_u08 Rte_FaultLog_FaultLog.CTCPassData[55].Reserved2_Cnt_u08 Rte_FaultLog_FaultLog.CTCPassData[56].Byte1_Cnt_u08 Rte_FaultLog_FaultLog.CTCPassData[56].Byte2_Cnt_u08 Rte_FaultLog_FaultLog.CTCPassData[56].Byte3_Cnt_u08 Rte_FaultLog_FaultLog.CTCPassData[56].Byte4_Cnt_u08 Rte_FaultLog_FaultLog.CTCPassData[56].Byte5_Cnt_u08 Rte_FaultLog_FaultLog.CTCPassData[56].Byte6_Cnt_u08 Rte_FaultLog_FaultLog.CTCPassData[56].Reserved1_Cnt_u08 Rte_FaultLog_FaultLog.CTCPassData[56].Reserved2_Cnt_u08 Rte_FaultLog_FaultLog.CTCPassData[57].Byte1_Cnt_u08 Rte_FaultLog_FaultLog.CTCPassData[57].Byte2_Cnt_u08 Rte_FaultLog_FaultLog.CTCPassData[57].Byte3_Cnt_u08 Rte_FaultLog_FaultLog.CTCPassData[57].Byte4_Cnt_u08 Rte_FaultLog_FaultLog.CTCPassData[57].Byte5_Cnt_u08 Rte_FaultLog_FaultLog.CTCPassData[57].Byte6_Cnt_u08 Rte_FaultLog_FaultLog.CTCPassData[57].Reserved1_Cnt_u08 Rte_FaultLog_FaultLog.CTCPassData[57].Reserved2_Cnt_u08 Rte_FaultLog_FaultLog.CTCPassData[58].Byte1_Cnt_u08 Rte_FaultLog_FaultLog.CTCPassData[58].Byte2_Cnt_u08 Rte_FaultLog_FaultLog.CTCPassData[58].Byte3_Cnt_u08 Rte_FaultLog_FaultLog.CTCPassData[58].Byte4_Cnt_u08 Rte_FaultLog_FaultLog.CTCPassData[58].Byte5_Cnt_u08 Rte_FaultLog_FaultLog.CTCPassData[58].Byte6_Cnt_u08 Rte_FaultLog_FaultLog.CTCPassData[58].Reserved1_Cnt_u08 Rte_FaultLog_FaultLog.CTCPassData[58].Reserved2_Cnt_u08 Rte_FaultLog_FaultLog.CTCPassData[59].Byte1_Cnt_u08 Rte_FaultLog_FaultLog.CTCPassData[59].Byte2_Cnt_u08 Rte_FaultLog_FaultLog.CTCPassData[59].Byte3_Cnt_u08 Rte_FaultLog_FaultLog.CTCPassData[59].Byte4_Cnt_u08 Rte_FaultLog_FaultLog.CTCPassData[59].Byte5_Cnt_u08 Rte_FaultLog_FaultLog.CTCPassData[59].Byte6_Cnt_u08 Rte_FaultLog_FaultLog.CTCPassData[59].Reserved1_Cnt_u08 Rte_FaultLog_FaultLog.CTCPassData[59].Reserved2_Cnt_u08 Rte_FaultLog_FaultLog.CTCPassData[5].Byte1_Cnt_u08 Rte_FaultLog_FaultLog.CTCPassData[5].Byte2_Cnt_u08 Rte_FaultLog_FaultLog.CTCPassData[5].Byte3_Cnt_u08 Rte_FaultLog_FaultLog.CTCPassData[5].Byte4_Cnt_u08 Rte_FaultLog_FaultLog.CTCPassData[5].Byte5_Cnt_u08 Rte_FaultLog_FaultLog.CTCPassData[5].Byte6_Cnt_u08 Rte_FaultLog_FaultLog.CTCPassData[5].Reserved1_Cnt_u08 Rte_FaultLog_FaultLog.CTCPassData[5].Reserved2_Cnt_u08 Rte_FaultLog_FaultLog.CTCPassData[6].Byte1_Cnt_u08 Rte_FaultLog_FaultLog.CTCPassData[6].Byte2_Cnt_u08 Rte_FaultLog_FaultLog.CTCPassData[6].Byte3_Cnt_u08 Rte_FaultLog_FaultLog.CTCPassData[6].Byte4_Cnt_u08 Rte_FaultLog_FaultLog.CTCPassData[6].Byte5_Cnt_u08 Rte_FaultLog_FaultLog.CTCPassData[6].Byte6_Cnt_u08 Rte_FaultLog_FaultLog.CTCPassData[6].Reserved1_Cnt_u08 Rte_FaultLog_FaultLog.CTCPassData[6].Reserved2_Cnt_u08 Rte_FaultLog_FaultLog.CTCPassData[7].Byte1_Cnt_u08 Rte_FaultLog_FaultLog.CTCPassData[7].Byte2_Cnt_u08 Rte_FaultLog_FaultLog.CTCPassData[7].Byte3_Cnt_u08 Rte_FaultLog_FaultLog.CTCPassData[7].Byte4_Cnt_u08 Rte_FaultLog_FaultLog.CTCPassData[7].Byte5_Cnt_u08 Rte_FaultLog_FaultLog.CTCPassData[7].Byte6_Cnt_u08 Rte_FaultLog_FaultLog.CTCPassData[7].Reserved1_Cnt_u08 Rte_FaultLog_FaultLog.CTCPassData[7].Reserved2_Cnt_u08 Rte_FaultLog_FaultLog.CTCPassData[8].Byte1_Cnt_u08 Rte_FaultLog_FaultLog.CTCPassData[8].Byte2_Cnt_u08 Rte_FaultLog_FaultLog.CTCPassData[8].Byte3_Cnt_u08 Rte_FaultLog_FaultLog.CTCPassData[8].Byte4_Cnt_u08 Rte_FaultLog_FaultLog.CTCPassData[8].Byte5_Cnt_u08 Rte_FaultLog_FaultLog.CTCPassData[8].Byte6_Cnt_u08 Rte_FaultLog_FaultLog.CTCPassData[8].Reserved1_Cnt_u08 Rte_FaultLog_FaultLog.CTCPassData[8].Reserved2_Cnt_u08 Rte_FaultLog_FaultLog.CTCPassData[9].Byte1_Cnt_u08 Rte_FaultLog_FaultLog.CTCPassData[9].Byte2_Cnt_u08 Rte_FaultLog_FaultLog.CTCPassData[9].Byte3_Cnt_u08 Rte_FaultLog_FaultLog.CTCPassData[9].Byte4_Cnt_u08 Rte_FaultLog_FaultLog.CTCPassData[9].Byte5_Cnt_u08 Rte_FaultLog_FaultLog.CTCPassData[9].Byte6_Cnt_u08 Rte_FaultLog_FaultLog.CTCPassData[9].Reserved1_Cnt_u08 Rte_FaultLog_FaultLog.CTCPassData[9].Reserved2_Cnt_u08 Rte_FaultLog_FaultLog.QueueData[0].QueueEventIdx_Cnt_u08 Rte_FaultLog_FaultLog.QueueData[0].Status_Cnt_u08 Rte_FaultLog_FaultLog.QueueData[100].QueueEventIdx_Cnt_u08 Rte_FaultLog_FaultLog.QueueData[100].Status_Cnt_u08 Rte_FaultLog_FaultLog.QueueData[101].QueueEventIdx_Cnt_u08 Rte_FaultLog_FaultLog.QueueData[101].Status_Cnt_u08 Rte_FaultLog_FaultLog.QueueData[102].QueueEventIdx_Cnt_u08 Rte_FaultLog_FaultLog.QueueData[102].Status_Cnt_u08 Rte_FaultLog_FaultLog.QueueData[103].QueueEventIdx_Cnt_u08 Rte_FaultLog_FaultLog.QueueData[103].Status_Cnt_u08 Rte_FaultLog_FaultLog.QueueData[104].QueueEventIdx_Cnt_u08 Rte_FaultLog_FaultLog.QueueData[104].Status_Cnt_u08 Rte_FaultLog_FaultLog.QueueData[105].QueueEventIdx_Cnt_u08 Rte_FaultLog_FaultLog.QueueData[105].Status_Cnt_u08 Rte_FaultLog_FaultLog.QueueData[106].QueueEventIdx_Cnt_u08 Rte_FaultLog_FaultLog.QueueData[106].Status_Cnt_u08 Rte_FaultLog_FaultLog.QueueData[107].QueueEventIdx_Cnt_u08 Rte_FaultLog_FaultLog.QueueData[107].Status_Cnt_u08 Rte_FaultLog_FaultLog.QueueData[108].QueueEventIdx_Cnt_u08 Rte_FaultLog_FaultLog.QueueData[108].Status_Cnt_u08 Rte_FaultLog_FaultLog.QueueData[109].QueueEventIdx_Cnt_u08 Rte_FaultLog_FaultLog.QueueData[109].Status_Cnt_u08 Rte_FaultLog_FaultLog.QueueData[10].QueueEventIdx_Cnt_u08 Rte_FaultLog_FaultLog.QueueData[10].Status_Cnt_u08 Rte_FaultLog_FaultLog.QueueData[110].QueueEventIdx_Cnt_u08 Rte_FaultLog_FaultLog.QueueData[110].Status_Cnt_u08 Rte_FaultLog_FaultLog.QueueData[111].QueueEventIdx_Cnt_u08 Rte_FaultLog_FaultLog.QueueData[111].Status_Cnt_u08 Rte_FaultLog_FaultLog.QueueData[112].QueueEventIdx_Cnt_u08 Rte_FaultLog_FaultLog.QueueData[112].Status_Cnt_u08 Rte_FaultLog_FaultLog.QueueData[113].QueueEventIdx_Cnt_u08 Rte_FaultLog_FaultLog.QueueData[113].Status_Cnt_u08 Rte_FaultLog_FaultLog.QueueData[114].QueueEventIdx_Cnt_u08 Rte_FaultLog_FaultLog.QueueData[114].Status_Cnt_u08 Rte_FaultLog_FaultLog.QueueData[115].QueueEventIdx_Cnt_u08 Rte_FaultLog_FaultLog.QueueData[115].Status_Cnt_u08 Rte_FaultLog_FaultLog.QueueData[116].QueueEventIdx_Cnt_u08 Rte_FaultLog_FaultLog.QueueData[116].Status_Cnt_u08 Rte_FaultLog_FaultLog.QueueData[117].QueueEventIdx_Cnt_u08 Rte_FaultLog_FaultLog.QueueData[117].Status_Cnt_u08 Rte_FaultLog_FaultLog.QueueData[118].QueueEventIdx_Cnt_u08 Rte_FaultLog_FaultLog.QueueData[118].Status_Cnt_u08 Rte_FaultLog_FaultLog.QueueData[119].QueueEventIdx_Cnt_u08 Rte_FaultLog_FaultLog.QueueData[119].Status_Cnt_u08 Rte_FaultLog_FaultLog.QueueData[11].QueueEventIdx_Cnt_u08 Rte_FaultLog_FaultLog.QueueData[11].Status_Cnt_u08 Rte_FaultLog_FaultLog.QueueData[12].QueueEventIdx_Cnt_u08 Rte_FaultLog_FaultLog.QueueData[12].Status_Cnt_u08 Rte_FaultLog_FaultLog.QueueData[13].QueueEventIdx_Cnt_u08 Rte_FaultLog_FaultLog.QueueData[13].Status_Cnt_u08 Rte_FaultLog_FaultLog.QueueData[14].QueueEventIdx_Cnt_u08 Rte_FaultLog_FaultLog.QueueData[14].Status_Cnt_u08 Rte_FaultLog_FaultLog.QueueData[15].QueueEventIdx_Cnt_u08 Rte_FaultLog_FaultLog.QueueData[15].Status_Cnt_u08 Rte_FaultLog_FaultLog.QueueData[16].QueueEventIdx_Cnt_u08 Rte_FaultLog_FaultLog.QueueData[16].Status_Cnt_u08 Rte_FaultLog_FaultLog.QueueData[17].QueueEventIdx_Cnt_u08 Rte_FaultLog_FaultLog.QueueData[17].Status_Cnt_u08 Rte_FaultLog_FaultLog.QueueData[18].QueueEventIdx_Cnt_u08 Rte_FaultLog_FaultLog.QueueData[18].Status_Cnt_u08 Rte_FaultLog_FaultLog.QueueData[19].QueueEventIdx_Cnt_u08 Rte_FaultLog_FaultLog.QueueData[19].Status_Cnt_u08 Rte_FaultLog_FaultLog.QueueData[1].QueueEventIdx_Cnt_u08 Rte_FaultLog_FaultLog.QueueData[1].Status_Cnt_u08 Rte_FaultLog_FaultLog.QueueData[20].QueueEventIdx_Cnt_u08 Rte_FaultLog_FaultLog.QueueData[20].Status_Cnt_u08 Rte_FaultLog_FaultLog.QueueData[21].QueueEventIdx_Cnt_u08 Rte_FaultLog_FaultLog.QueueData[21].Status_Cnt_u08 Rte_FaultLog_FaultLog.QueueData[22].QueueEventIdx_Cnt_u08 Rte_FaultLog_FaultLog.QueueData[22].Status_Cnt_u08 Rte_FaultLog_FaultLog.QueueData[23].QueueEventIdx_Cnt_u08 Rte_FaultLog_FaultLog.QueueData[23].Status_Cnt_u08 Rte_FaultLog_FaultLog.QueueData[24].QueueEventIdx_Cnt_u08 Rte_FaultLog_FaultLog.QueueData[24].Status_Cnt_u08 Rte_FaultLog_FaultLog.QueueData[25].QueueEventIdx_Cnt_u08 Rte_FaultLog_FaultLog.QueueData[25].Status_Cnt_u08 Rte_FaultLog_FaultLog.QueueData[26].QueueEventIdx_Cnt_u08 Rte_FaultLog_FaultLog.QueueData[26].Status_Cnt_u08 Rte_FaultLog_FaultLog.QueueData[27].QueueEventIdx_Cnt_u08 Rte_FaultLog_FaultLog.QueueData[27].Status_Cnt_u08 Rte_FaultLog_FaultLog.QueueData[28].QueueEventIdx_Cnt_u08 Rte_FaultLog_FaultLog.QueueData[28].Status_Cnt_u08 Rte_FaultLog_FaultLog.QueueData[29].QueueEventIdx_Cnt_u08 Rte_FaultLog_FaultLog.QueueData[29].Status_Cnt_u08 Rte_FaultLog_FaultLog.QueueData[2].QueueEventIdx_Cnt_u08 Rte_FaultLog_FaultLog.QueueData[2].Status_Cnt_u08 Rte_FaultLog_FaultLog.QueueData[30].QueueEventIdx_Cnt_u08 Rte_FaultLog_FaultLog.QueueData[30].Status_Cnt_u08 Rte_FaultLog_FaultLog.QueueData[31].QueueEventIdx_Cnt_u08 Rte_FaultLog_FaultLog.QueueData[31].Status_Cnt_u08 Rte_FaultLog_FaultLog.QueueData[32].QueueEventIdx_Cnt_u08 Rte_FaultLog_FaultLog.QueueData[32].Status_Cnt_u08 Rte_FaultLog_FaultLog.QueueData[33].QueueEventIdx_Cnt_u08 Rte_FaultLog_FaultLog.QueueData[33].Status_Cnt_u08 Rte_FaultLog_FaultLog.QueueData[34].QueueEventIdx_Cnt_u08 Rte_FaultLog_FaultLog.QueueData[34].Status_Cnt_u08 Rte_FaultLog_FaultLog.QueueData[35].QueueEventIdx_Cnt_u08 Rte_FaultLog_FaultLog.QueueData[35].Status_Cnt_u08 Rte_FaultLog_FaultLog.QueueData[36].QueueEventIdx_Cnt_u08 Rte_FaultLog_FaultLog.QueueData[36].Status_Cnt_u08 Rte_FaultLog_FaultLog.QueueData[37].QueueEventIdx_Cnt_u08 Rte_FaultLog_FaultLog.QueueData[37].Status_Cnt_u08 Rte_FaultLog_FaultLog.QueueData[38].QueueEventIdx_Cnt_u08 Rte_FaultLog_FaultLog.QueueData[38].Status_Cnt_u08 Rte_FaultLog_FaultLog.QueueData[39].QueueEventIdx_Cnt_u08 Rte_FaultLog_FaultLog.QueueData[39].Status_Cnt_u08 Rte_FaultLog_FaultLog.QueueData[3].QueueEventIdx_Cnt_u08 Rte_FaultLog_FaultLog.QueueData[3].Status_Cnt_u08 Rte_FaultLog_FaultLog.QueueData[40].QueueEventIdx_Cnt_u08 Rte_FaultLog_FaultLog.QueueData[40].Status_Cnt_u08 Rte_FaultLog_FaultLog.QueueData[41].QueueEventIdx_Cnt_u08 Rte_FaultLog_FaultLog.QueueData[41].Status_Cnt_u08 Rte_FaultLog_FaultLog.QueueData[42].QueueEventIdx_Cnt_u08 /end REF_MEASUREMENT
/end GROUP
