AUTOSAR XML (schema 314)
package /PortInterface
  client server interface NxtrDiagMgr
    4 x operation, all with possible-error=E_NOT_OK:
      GetNTCActive
        arg NTC_Cnt_T_enum: type=NTCNumber, direction=IN
        arg NTCActive_Ptr_T_lgc: type=Boolean, direction=OUT
      GetNTCFailed
        arg NTC_Cnt_T_enum: type=NTCNumber, direction=IN
        arg NTCFailed_Ptr_T_lgc: type=Boolean, direction=OUT
      GetNTCStatus
        arg NTC_Cnt_T_enum: type=NTCNumber, direction=IN
        arg Status_Ptr_T_u08: type=UInt8, direction=OUT
      SetNTCStatus
        arg NTC_Cnt_T_enum: type=NTCNumber, direction=IN
        arg Param_Cnt_T_u08: type=UInt8, direction=IN
        arg Status_Cnt_T_enum: type=NxtrDiagMgrStatus, direction=IN
    error E_NOT_OK: error-code=1
  9 x sender receiver interface:
    BoolStatusFlag_Cnt_lgc
      data Cnt_lgc: sw-calibration-access=READ-ONLY, type=Boolean
    HwTrq_HwNm_f32
      data HwNm_f32: sw-calibration-access=READ-ONLY, type=Float
    HwTrqRate_HwNmpS_f32
      data HwNmpS_f32: sw-calibration-access=READ-ONLY, type=Float
    HwVel_HwRadpS_f32
      data HwRadpS_f32: sw-calibration-access=READ-ONLY, type=Float
    MtrTrq_MtrNm_f32
      data MtrNm_f32: sw-calibration-access=READ-ONLY, type=Float
    PsaApaSt_Cnt_enum
      data Cnt_enum: sw-calibration-access=READ-ONLY, type=PsaApaSt_Cnt_enum
    PsaEpsStLxa_Cnt_enum
      data Cnt_enum: sw-calibration-access=READ-ONLY, type=PsaEpsStLxa_Cnt_enum
    ScaleFactor_Uls_f32
      data Uls_f32: sw-calibration-access=READ-ONLY, type=Float
    VehSpd_Kph_f32
      data Kph_f32: sw-calibration-access=READ-ONLY, type=Float
