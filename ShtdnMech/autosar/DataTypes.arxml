AUTOSAR XML (schema 314)
standard types defined: UInt32, UInt8
package /DataType
  integer type IoHwAb_BoolType: lower-limit=0, upper-limit=1
