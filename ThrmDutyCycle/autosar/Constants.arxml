AUTOSAR XML (schema 314)
package /Constant
  9 x constant specification:
    D_100MS_SEC_F32
      value:
        real literal D_100MS_SEC_F32: type=Float, value=0.1
    D_FALSE_CNT_LGC
      value:
        boolean literal D_FALSE_CNT_LGC: type=Boolean, value=false
    D_MTRTRQCMDHILMT_MTRNM_F32
      value:
        real literal D_MTRTRQCMDHILMT_MTRNM_F32: type=Float, value=8.8
    D_ONE_CNT_U16
      value:
        integer literal D_ONE_CNT_U16: type=UInt16, value=1
    D_ONE_CNT_U32
      value:
        integer literal D_ONE_CNT_U32: type=UInt32, value=1
    D_ONE_ULS_F32
      value:
        real literal D_ONE_ULS_F32: type=Float, value=1
    D_ZERO_CNT_U32
      value:
        integer literal D_ZERO_CNT_U32: type=UInt32, value=0
    D_ZERO_CNT_U8
      value:
        integer literal D_ZERO_CNT_U8: type=UInt8, value=0
    D_ZERO_ULS_F32
      value:
        real literal D_ZERO_ULS_F32: type=Float, value=0
