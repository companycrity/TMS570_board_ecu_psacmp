AUTOSAR XML (schema 314)
package /Constant
  4 x constant specification:
    D_2MS_SEC_F32
      value:
        real literal D_2MS_SEC_F32: type=Float, value=0.002
    D_MTRTRQCMDHILMT_MTRNM_F32
      value:
        real literal D_MTRTRQCMDHILMT_MTRNM_F32: type=Float, value=8.8
    D_ONE_ULS_F32
      value:
        real literal D_ONE_ULS_F32: type=Float, value=1
    D_ZERO_ULS_F32
      value:
        real literal D_ZERO_ULS_F32: type=Float, value=0
