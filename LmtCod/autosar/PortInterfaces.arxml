AUTOSAR XML (schema 314)
package /PortInterface
  client server interface FaultInjection_SCom
    operation FltInjection
      arg SignalPath_Uls_f32: type=Float, direction=INOUT
      arg LocationKey_Cnt_enum: type=FltInjectionLocType, direction=IN
  sender receiver interface MtrTrq
    data MtrNm_f32: sw-calibration-access=READ-ONLY, type=Float
  sender receiver interface UnityScalar
    data Uls_f32: sw-calibration-access=READ-ONLY, type=Float
  sender receiver interface VehSpd_Kph_f32
    data Kph_f32: sw-calibration-access=READ-ONLY, type=Float
